/******************************************************************************
* ASAP2 file: pwr_computeEnginePower.a2l
* Code generation for model "pwr_computeEnginePower".
* Model version : 5.2
* Simulink Coder version : 9.6 (R2021b) 14-May-2021
* C source code generated on : Sun Mar 5 13:35:21 2023
* Target selection: ert.tlc
* Embedded hardware selection: Intel->x86-64 (Windows64)
* Code generation objectives: Unspecified
* Validation result: Not run
* (add additional file header information here)
******************************************************************************/ ASAP2_VERSION 1 31
/* Version 1.31 */
/begin PROJECT ProjectName "Project Comment Goes Here"
/begin HEADER "Header Comments go here" /end HEADER
/begin MODULE ModuleName "Module Comment Goes Here"
/begin MOD_PAR "MOD PAR Comment Goes Here" /end MOD_PAR
/begin MOD_COMMON "Mod Common Comment Here" BYTE_ORDER MSB_LAST /end MOD_COMMON
/begin RECORD_LAYOUT Scalar_BOOLEAN FNC_VALUES 1 UBYTE COLUMN_DIR DIRECT /end RECORD_LAYOUT
/begin RECORD_LAYOUT Scalar_UBYTE FNC_VALUES 1 UBYTE COLUMN_DIR DIRECT /end RECORD_LAYOUT
/begin RECORD_LAYOUT Scalar_BYTE FNC_VALUES 1 SBYTE COLUMN_DIR DIRECT /end RECORD_LAYOUT
/begin RECORD_LAYOUT Scalar_UWORD FNC_VALUES 1 UWORD COLUMN_DIR DIRECT /end RECORD_LAYOUT
/begin RECORD_LAYOUT Scalar_SWORD FNC_VALUES 1 SWORD COLUMN_DIR DIRECT /end RECORD_LAYOUT
/begin RECORD_LAYOUT Scalar_ULONG FNC_VALUES 1 ULONG COLUMN_DIR DIRECT /end RECORD_LAYOUT
/begin RECORD_LAYOUT Scalar_LONG FNC_VALUES 1 SLONG COLUMN_DIR DIRECT /end RECORD_LAYOUT
/begin RECORD_LAYOUT Scalar_FLOAT32_IEEE FNC_VALUES 1 FLOAT32_IEEE COLUMN_DIR DIRECT /end RECORD_LAYOUT
/begin RECORD_LAYOUT Scalar_FLOAT64_IEEE FNC_VALUES 1 FLOAT64_IEEE COLUMN_DIR DIRECT /end RECORD_LAYOUT
/begin RECORD_LAYOUT Lookup1D_BOOLEAN FNC_VALUES 1 UBYTE COLUMN_DIR DIRECT /end RECORD_LAYOUT
/begin RECORD_LAYOUT Lookup1D_X_BOOLEAN AXIS_PTS_X 1 UBYTE INDEX_INCR DIRECT /end RECORD_LAYOUT
/begin RECORD_LAYOUT Lookup1D_BYTE FNC_VALUES 1 SBYTE COLUMN_DIR DIRECT /end RECORD_LAYOUT
/begin RECORD_LAYOUT Lookup1D_X_BYTE AXIS_PTS_X 1 SBYTE INDEX_INCR DIRECT /end RECORD_LAYOUT
/begin RECORD_LAYOUT Lookup1D_UBYTE FNC_VALUES 1 UBYTE COLUMN_DIR DIRECT /end RECORD_LAYOUT
/begin RECORD_LAYOUT Lookup1D_X_UBYTE AXIS_PTS_X 1 UBYTE INDEX_INCR DIRECT /end RECORD_LAYOUT
/begin RECORD_LAYOUT Lookup1D_UWORD FNC_VALUES 1 UWORD COLUMN_DIR DIRECT /end RECORD_LAYOUT
/begin RECORD_LAYOUT Lookup1D_X_UWORD AXIS_PTS_X 1 UWORD INDEX_INCR DIRECT /end RECORD_LAYOUT
/begin RECORD_LAYOUT Lookup1D_WORD FNC_VALUES 1 SWORD COLUMN_DIR DIRECT /end RECORD_LAYOUT
/begin RECORD_LAYOUT Lookup1D_X_WORD AXIS_PTS_X 1 SWORD INDEX_INCR DIRECT /end RECORD_LAYOUT
/begin RECORD_LAYOUT Lookup1D_ULONG FNC_VALUES 1 ULONG COLUMN_DIR DIRECT /end RECORD_LAYOUT
/begin RECORD_LAYOUT Lookup1D_X_ULONG AXIS_PTS_X 1 ULONG INDEX_INCR DIRECT /end RECORD_LAYOUT
/begin RECORD_LAYOUT Lookup1D_SLONG FNC_VALUES 1 SLONG COLUMN_DIR DIRECT /end RECORD_LAYOUT
/begin RECORD_LAYOUT Lookup1D_X_LONG AXIS_PTS_X 1 SLONG INDEX_INCR DIRECT /end RECORD_LAYOUT
/begin RECORD_LAYOUT Lookup1D_FLOAT32_IEEE FNC_VALUES 1 FLOAT32_IEEE COLUMN_DIR DIRECT /end RECORD_LAYOUT
/begin RECORD_LAYOUT Lookup1D_X_FLOAT32_IEEE AXIS_PTS_X 1 FLOAT32_IEEE INDEX_INCR DIRECT /end RECORD_LAYOUT
/begin RECORD_LAYOUT Lookup1D_FLOAT64_IEEE FNC_VALUES 1 FLOAT64_IEEE COLUMN_DIR DIRECT /end RECORD_LAYOUT
/begin RECORD_LAYOUT Lookup1D_X_FLOAT64_IEEE AXIS_PTS_X 1 FLOAT64_IEEE INDEX_INCR DIRECT /end RECORD_LAYOUT
/begin RECORD_LAYOUT Lookup2D_BOOLEAN FNC_VALUES 1 UBYTE COLUMN_DIR DIRECT /end RECORD_LAYOUT
/begin RECORD_LAYOUT Lookup2D_X_BOOLEAN AXIS_PTS_X 1 UBYTE INDEX_INCR DIRECT /end RECORD_LAYOUT
/begin RECORD_LAYOUT Lookup2D_UBYTE FNC_VALUES 1 UBYTE COLUMN_DIR DIRECT /end RECORD_LAYOUT
/begin RECORD_LAYOUT Lookup2D_X_UBYTE AXIS_PTS_X 1 UBYTE INDEX_INCR DIRECT /end RECORD_LAYOUT
/begin RECORD_LAYOUT Lookup2D_BYTE FNC_VALUES 1 SBYTE COLUMN_DIR DIRECT /end RECORD_LAYOUT
/begin RECORD_LAYOUT Lookup2D_X_BYTE AXIS_PTS_X 1 SBYTE INDEX_INCR DIRECT /end RECORD_LAYOUT
/begin RECORD_LAYOUT Lookup2D_UWORD FNC_VALUES 1 UWORD COLUMN_DIR DIRECT /end RECORD_LAYOUT
/begin RECORD_LAYOUT Lookup2D_X_UWORD AXIS_PTS_X 1 UWORD INDEX_INCR DIRECT /end RECORD_LAYOUT
/begin RECORD_LAYOUT Lookup2D_WORD FNC_VALUES 1 SWORD COLUMN_DIR DIRECT /end RECORD_LAYOUT
/begin RECORD_LAYOUT Lookup2D_X_WORD AXIS_PTS_X 1 SWORD INDEX_INCR DIRECT /end RECORD_LAYOUT
/begin RECORD_LAYOUT Lookup2D_ULONG FNC_VALUES 1 ULONG COLUMN_DIR DIRECT /end RECORD_LAYOUT
/begin RECORD_LAYOUT Lookup2D_X_ULONG AXIS_PTS_X 1 ULONG INDEX_INCR DIRECT /end RECORD_LAYOUT
/begin RECORD_LAYOUT Lookup2D_LONG FNC_VALUES 1 SLONG COLUMN_DIR DIRECT /end RECORD_LAYOUT
/begin RECORD_LAYOUT Lookup2D_X_LONG AXIS_PTS_X 1 SLONG INDEX_INCR DIRECT /end RECORD_LAYOUT
/begin RECORD_LAYOUT Lookup2D_FLOAT32_IEEE FNC_VALUES 1 FLOAT32_IEEE COLUMN_DIR DIRECT /end RECORD_LAYOUT
/begin RECORD_LAYOUT Lookup2D_X_FLOAT32_IEEE AXIS_PTS_X 1 FLOAT32_IEEE INDEX_INCR DIRECT /end RECORD_LAYOUT
/begin RECORD_LAYOUT Lookup2D_FLOAT64_IEEE FNC_VALUES 1 FLOAT64_IEEE COLUMN_DIR DIRECT /end RECORD_LAYOUT
/begin RECORD_LAYOUT Lookup2D_X_FLOAT64_IEEE AXIS_PTS_X 1 FLOAT64_IEEE INDEX_INCR DIRECT /end RECORD_LAYOUT
/begin MEASUREMENT cap_canBus_PT.PT_StateEcu01_1024_sts.signals.checksum "" UBYTE pwr_computeEnginePower_CM_uint8 0 0 0 255 ECU_ADDRESS 0x0000 /* @ECU_Address@cap_canBus_PT.PT_StateEcu01_1024_sts.signals.checksum@ */ /end MEASUREMENT
/begin MEASUREMENT cap_canBus_PT.PT_StateEcu01_1024_sts.signals.speedOfRotation "" UWORD pwr_computeEnginePower_CM_ufix16_Sp1 0 0 0 6553.5 ECU_ADDRESS 0x0000 /* @ECU_Address@cap_canBus_PT.PT_StateEcu01_1024_sts.signals.speedOfRotation@ */ /end MEASUREMENT
/begin MEASUREMENT cap_canBus_PT.PT_StateEcu01_1024_sts.signals.sequenceCounter "" UBYTE pwr_computeEnginePower_CM_uint8 0 0 0 255 ECU_ADDRESS 0x0000 /* @ECU_Address@cap_canBus_PT.PT_StateEcu01_1024_sts.signals.sequenceCounter@ */ /end MEASUREMENT
/begin MEASUREMENT cap_canBus_PT.PT_StateEcu01_1024_sts.stsTransmission "" UBYTE pwr_computeEnginePower_CM_uint8 0 0 0 255 ECU_ADDRESS 0x0000 /* @ECU_Address@cap_canBus_PT.PT_StateEcu01_1024_sts.stsTransmission@ */ /end MEASUREMENT
/begin MEASUREMENT cap_canBus_PT.PT_StateEcu02_1040_sts.signals.checksum "" UBYTE pwr_computeEnginePower_CM_uint8 0 0 0 255 ECU_ADDRESS 0x0000 /* @ECU_Address@cap_canBus_PT.PT_StateEcu02_1040_sts.signals.checksum@ */ /end MEASUREMENT
/begin MEASUREMENT cap_canBus_PT.PT_StateEcu02_1040_sts.signals.sequenceCounter "" UBYTE pwr_computeEnginePower_CM_uint8 0 0 0 255 ECU_ADDRESS 0x0000 /* @ECU_Address@cap_canBus_PT.PT_StateEcu02_1040_sts.signals.sequenceCounter@ */ /end MEASUREMENT
/begin MEASUREMENT cap_canBus_PT.PT_StateEcu02_1040_sts.signals.torque "" SWORD pwr_computeEnginePower_CM_sfix16_En1 0 0 -16384.0 16383.5 ECU_ADDRESS 0x0000 /* @ECU_Address@cap_canBus_PT.PT_StateEcu02_1040_sts.signals.torque@ */ /end MEASUREMENT
/begin MEASUREMENT cap_canBus_PT.PT_StateEcu02_1040_sts.stsTransmission "" UBYTE pwr_computeEnginePower_CM_uint8 0 0 0 255 ECU_ADDRESS 0x0000 /* @ECU_Address@cap_canBus_PT.PT_StateEcu02_1040_sts.stsTransmission@ */ /end MEASUREMENT
/begin MEASUREMENT cap_canBus_PT.PT_UserLimits_2032_sts.signals.sequenceCounter "" UBYTE pwr_computeEnginePower_CM_uint8 0 0 0 255 ECU_ADDRESS 0x0000 /* @ECU_Address@cap_canBus_PT.PT_UserLimits_2032_sts.signals.sequenceCounter@ */ /end MEASUREMENT
/begin MEASUREMENT cap_canBus_PT.PT_UserLimits_2032_sts.signals.minSpeedOfRotation "" UWORD pwr_computeEnginePower_CM_ufix16_S1p6 0 0 0 104856.0 ECU_ADDRESS 0x0000 /* @ECU_Address@cap_canBus_PT.PT_UserLimits_2032_sts.signals.minSpeedOfRotation@ */ /end MEASUREMENT
/begin MEASUREMENT cap_canBus_PT.PT_UserLimits_2032_sts.signals.maxSpeedOfRotation "" UWORD pwr_computeEnginePower_CM_ufix16_S1p6 0 0 0 104856.0 ECU_ADDRESS 0x0000 /* @ECU_Address@cap_canBus_PT.PT_UserLimits_2032_sts.signals.maxSpeedOfRotation@ */ /end MEASUREMENT
/begin MEASUREMENT cap_canBus_PT.PT_UserLimits_2032_sts.signals.checksum "" UBYTE pwr_computeEnginePower_CM_uint8 0 0 0 255 ECU_ADDRESS 0x0000 /* @ECU_Address@cap_canBus_PT.PT_UserLimits_2032_sts.signals.checksum@ */ /end MEASUREMENT
/begin MEASUREMENT cap_canBus_PT.PT_UserLimits_2032_sts.signals.minPower "" UWORD pwr_computeEnginePower_CM_ufix16_En1_Bn10 0 0 -10.0 32757.5 ECU_ADDRESS 0x0000 /* @ECU_Address@cap_canBus_PT.PT_UserLimits_2032_sts.signals.minPower@ */ /end MEASUREMENT
/begin MEASUREMENT cap_canBus_PT.PT_UserLimits_2032_sts.signals.maxPower "" UWORD pwr_computeEnginePower_CM_ufix16_En1_Bn10 0 0 -10.0 32757.5 ECU_ADDRESS 0x0000 /* @ECU_Address@cap_canBus_PT.PT_UserLimits_2032_sts.signals.maxPower@ */ /end MEASUREMENT
/begin MEASUREMENT cap_canBus_PT.PT_UserLimits_2032_sts.stsTransmission "" UBYTE pwr_computeEnginePower_CM_uint8 0 0 0 255 ECU_ADDRESS 0x0000 /* @ECU_Address@cap_canBus_PT.PT_UserLimits_2032_sts.stsTransmission@ */ /end MEASUREMENT
/begin MEASUREMENT cap_canBus_PT.PT_InfoPowerDisplay_1536_sts.signals.checksum "" UBYTE pwr_computeEnginePower_CM_uint8 0 0 0 255 ECU_ADDRESS 0x0000 /* @ECU_Address@cap_canBus_PT.PT_InfoPowerDisplay_1536_sts.signals.checksum@ */ /end MEASUREMENT
/begin MEASUREMENT cap_canBus_PT.PT_InfoPowerDisplay_1536_sts.signals.sequenceCounter "" UBYTE pwr_computeEnginePower_CM_uint8 0 0 0 255 ECU_ADDRESS 0x0000 /* @ECU_Address@cap_canBus_PT.PT_InfoPowerDisplay_1536_sts.signals.sequenceCounter@ */ /end MEASUREMENT
/begin MEASUREMENT cap_canBus_PT.PT_InfoPowerDisplay_1536_sts.signals.power "" UWORD pwr_computeEnginePower_CM_ufix16_E5_Bn500000 0 0 -500000.0 1.59712E+6 ECU_ADDRESS 0x0000 /* @ECU_Address@cap_canBus_PT.PT_InfoPowerDisplay_1536_sts.signals.power@ */ /end MEASUREMENT
/begin MEASUREMENT cap_canBus_PT.PT_InfoPowerDisplay_1536_sts.signals.state "" UBYTE pwr_computeEnginePower_CM_uint8 0 0 0 255 ECU_ADDRESS 0x0000 /* @ECU_Address@cap_canBus_PT.PT_InfoPowerDisplay_1536_sts.signals.state@ */ /end MEASUREMENT
/begin MEASUREMENT cap_canBus_PT.PT_InfoPowerDisplay_1536_sts.stsTransmission "" UBYTE pwr_computeEnginePower_CM_uint8 0 0 0 255 ECU_ADDRESS 0x0000 /* @ECU_Address@cap_canBus_PT.PT_InfoPowerDisplay_1536_sts.stsTransmission@ */ /end MEASUREMENT
/begin MEASUREMENT cap_canBus_PT.PT_StatusPowerDisplay_1537_sts.signals.noDlcErrors "" UWORD pwr_computeEnginePower_CM_uint16 0 0 0 65535 ECU_ADDRESS 0x0000 /* @ECU_Address@cap_canBus_PT.PT_StatusPowerDisplay_1537_sts.signals.noDlcErrors@ */ /end MEASUREMENT
/begin MEASUREMENT cap_canBus_PT.PT_StatusPowerDisplay_1537_sts.signals.noCheckSumErrors "" UWORD pwr_computeEnginePower_CM_uint16 0 0 0 65535 ECU_ADDRESS 0x0000 /* @ECU_Address@cap_canBus_PT.PT_StatusPowerDisplay_1537_sts.signals.noCheckSumErrors@ */ /end MEASUREMENT
/begin MEASUREMENT cap_canBus_PT.PT_StatusPowerDisplay_1537_sts.signals.noSqcErrors "" UWORD pwr_computeEnginePower_CM_uint16 0 0 0 65535 ECU_ADDRESS 0x0000 /* @ECU_Address@cap_canBus_PT.PT_StatusPowerDisplay_1537_sts.signals.noSqcErrors@ */ /end MEASUREMENT
/begin MEASUREMENT cap_canBus_PT.PT_StatusPowerDisplay_1537_sts.signals.sequenceCounter "" UBYTE pwr_computeEnginePower_CM_uint8 0 0 0 255 ECU_ADDRESS 0x0000 /* @ECU_Address@cap_canBus_PT.PT_StatusPowerDisplay_1537_sts.signals.sequenceCounter@ */ /end MEASUREMENT
/begin MEASUREMENT cap_canBus_PT.PT_StatusPowerDisplay_1537_sts.signals.checksum "" UBYTE pwr_computeEnginePower_CM_uint8 0 0 0 255 ECU_ADDRESS 0x0000 /* @ECU_Address@cap_canBus_PT.PT_StatusPowerDisplay_1537_sts.signals.checksum@ */ /end MEASUREMENT
/begin MEASUREMENT cap_canBus_PT.PT_StatusPowerDisplay_1537_sts.stsTransmission "" UBYTE pwr_computeEnginePower_CM_uint8 0 0 0 255 ECU_ADDRESS 0x0000 /* @ECU_Address@cap_canBus_PT.PT_StatusPowerDisplay_1537_sts.stsTransmission@ */ /end MEASUREMENT
/begin MEASUREMENT cap_canBus_PT.PT_LimitsPowerDisplay_1538_sts.signals.sequenceCounter "" UBYTE pwr_computeEnginePower_CM_uint8 0 0 0 255 ECU_ADDRESS 0x0000 /* @ECU_Address@cap_canBus_PT.PT_LimitsPowerDisplay_1538_sts.signals.sequenceCounter@ */ /end MEASUREMENT
/begin MEASUREMENT cap_canBus_PT.PT_LimitsPowerDisplay_1538_sts.signals.belowMinSpeedOfRotation "" UBYTE pwr_computeEnginePower_CM_boolean 0 0 0 1 ECU_ADDRESS 0x0000 /* @ECU_Address@cap_canBus_PT.PT_LimitsPowerDisplay_1538_sts.signals.belowMinSpeedOfRotation@ */ /end MEASUREMENT
/begin MEASUREMENT cap_canBus_PT.PT_LimitsPowerDisplay_1538_sts.signals.aboveMaxSpeedOfRotation "" UBYTE pwr_computeEnginePower_CM_boolean 0 0 0 1 ECU_ADDRESS 0x0000 /* @ECU_Address@cap_canBus_PT.PT_LimitsPowerDisplay_1538_sts.signals.aboveMaxSpeedOfRotation@ */ /end MEASUREMENT
/begin MEASUREMENT cap_canBus_PT.PT_LimitsPowerDisplay_1538_sts.signals.belowMinPower "" UBYTE pwr_computeEnginePower_CM_boolean 0 0 0 1 ECU_ADDRESS 0x0000 /* @ECU_Address@cap_canBus_PT.PT_LimitsPowerDisplay_1538_sts.signals.belowMinPower@ */ /end MEASUREMENT
/begin MEASUREMENT cap_canBus_PT.PT_LimitsPowerDisplay_1538_sts.signals.aboveMaxPower "" UBYTE pwr_computeEnginePower_CM_boolean 0 0 0 1 ECU_ADDRESS 0x0000 /* @ECU_Address@cap_canBus_PT.PT_LimitsPowerDisplay_1538_sts.signals.aboveMaxPower@ */ /end MEASUREMENT
/begin MEASUREMENT cap_canBus_PT.PT_LimitsPowerDisplay_1538_sts.stsTransmission "" UBYTE pwr_computeEnginePower_CM_uint8 0 0 0 255 ECU_ADDRESS 0x0000 /* @ECU_Address@cap_canBus_PT.PT_LimitsPowerDisplay_1538_sts.stsTransmission@ */ /end MEASUREMENT
/begin MEASUREMENT pwr_computeEnginePower_B.tqTimesSOR "" SLONG pwr_computeEnginePower_CM_sfix32_En9 0 0 -3.27675E+6 3.27675E+6 ECU_ADDRESS 0x0000 /* @ECU_Address@pwr_computeEnginePower_B.tqTimesSOR@ */ /end MEASUREMENT
/begin MEASUREMENT pwr_computeEnginePower_B.tqTimSORIsSaturated "" UBYTE pwr_computeEnginePower_CM_boolean 0 0 0 1 ECU_ADDRESS 0x0000 /* @ECU_Address@pwr_computeEnginePower_B.tqTimSORIsSaturated@ */ /end MEASUREMENT
/begin MEASUREMENT cap_pPT_StatusPowerDisplay_1537.noDlcErrors "" UWORD pwr_computeEnginePower_CM_uint16 0 0 0 65535 ECU_ADDRESS 0x0000 /* @ECU_Address@cap_pPT_StatusPowerDisplay_1537.noDlcErrors@ */ /end MEASUREMENT
/begin MEASUREMENT cap_pPT_StatusPowerDisplay_1537.noCheckSumErrors "" UWORD pwr_computeEnginePower_CM_uint16 0 0 0 65535 ECU_ADDRESS 0x0000 /* @ECU_Address@cap_pPT_StatusPowerDisplay_1537.noCheckSumErrors@ */ /end MEASUREMENT
/begin MEASUREMENT cap_pPT_StatusPowerDisplay_1537.noSqcErrors "" UWORD pwr_computeEnginePower_CM_uint16 0 0 0 65535 ECU_ADDRESS 0x0000 /* @ECU_Address@cap_pPT_StatusPowerDisplay_1537.noSqcErrors@ */ /end MEASUREMENT
/begin MEASUREMENT cap_pPT_StatusPowerDisplay_1537.sequenceCounter "" UBYTE pwr_computeEnginePower_CM_uint8 0 0 0 255 ECU_ADDRESS 0x0000 /* @ECU_Address@cap_pPT_StatusPowerDisplay_1537.sequenceCounter@ */ /end MEASUREMENT
/begin MEASUREMENT cap_pPT_StatusPowerDisplay_1537.checksum "" UBYTE pwr_computeEnginePower_CM_uint8 0 0 0 255 ECU_ADDRESS 0x0000 /* @ECU_Address@cap_pPT_StatusPowerDisplay_1537.checksum@ */ /end MEASUREMENT
/begin MEASUREMENT cap_pPT_LimitsPowerDisplay_1538.sequenceCounter "" UBYTE pwr_computeEnginePower_CM_uint8 0 0 0 255 ECU_ADDRESS 0x0000 /* @ECU_Address@cap_pPT_LimitsPowerDisplay_1538.sequenceCounter@ */ /end MEASUREMENT
/begin MEASUREMENT cap_pPT_LimitsPowerDisplay_1538.belowMinSpeedOfRotation "" UBYTE pwr_computeEnginePower_CM_boolean 0 0 0 1 ECU_ADDRESS 0x0000 /* @ECU_Address@cap_pPT_LimitsPowerDisplay_1538.belowMinSpeedOfRotation@ */ /end MEASUREMENT
/begin MEASUREMENT cap_pPT_LimitsPowerDisplay_1538.aboveMaxSpeedOfRotation "" UBYTE pwr_computeEnginePower_CM_boolean 0 0 0 1 ECU_ADDRESS 0x0000 /* @ECU_Address@cap_pPT_LimitsPowerDisplay_1538.aboveMaxSpeedOfRotation@ */ /end MEASUREMENT
/begin MEASUREMENT cap_pPT_LimitsPowerDisplay_1538.belowMinPower "" UBYTE pwr_computeEnginePower_CM_boolean 0 0 0 1 ECU_ADDRESS 0x0000 /* @ECU_Address@cap_pPT_LimitsPowerDisplay_1538.belowMinPower@ */ /end MEASUREMENT
/begin MEASUREMENT cap_pPT_LimitsPowerDisplay_1538.aboveMaxPower "" UBYTE pwr_computeEnginePower_CM_boolean 0 0 0 1 ECU_ADDRESS 0x0000 /* @ECU_Address@cap_pPT_LimitsPowerDisplay_1538.aboveMaxPower@ */ /end MEASUREMENT
/begin MEASUREMENT cap_pPT_InfoPowerDisplay_1536.checksum "" UBYTE pwr_computeEnginePower_CM_uint8 0 0 0 255 ECU_ADDRESS 0x0000 /* @ECU_Address@cap_pPT_InfoPowerDisplay_1536.checksum@ */ /end MEASUREMENT
/begin MEASUREMENT cap_pPT_InfoPowerDisplay_1536.sequenceCounter "" UBYTE pwr_computeEnginePower_CM_uint8 0 0 0 255 ECU_ADDRESS 0x0000 /* @ECU_Address@cap_pPT_InfoPowerDisplay_1536.sequenceCounter@ */ /end MEASUREMENT
/begin MEASUREMENT cap_pPT_InfoPowerDisplay_1536.power "" UWORD pwr_computeEnginePower_CM_ufix16_E5_Bn500000 0 0 -500000.0 1.59712E+6 ECU_ADDRESS 0x0000 /* @ECU_Address@cap_pPT_InfoPowerDisplay_1536.power@ */ /end MEASUREMENT
/begin MEASUREMENT cap_pPT_InfoPowerDisplay_1536.state "" UBYTE pwr_computeEnginePower_CM_uint8 0 0 0 255 ECU_ADDRESS 0x0000 /* @ECU_Address@cap_pPT_InfoPowerDisplay_1536.state@ */ /end MEASUREMENT
/begin MEASUREMENT pwr_transmissionErrAry "" UBYTE pwr_computeEnginePower_CM_boolean 0 0 0 1 /* Array Size */ ARRAY_SIZE 4 ECU_ADDRESS 0x0000 /* @ECU_Address@pwr_transmissionErrAry@ */ /end MEASUREMENT
/begin COMPU_METHOD pwr_computeEnginePower_CM_uint8 "Q = V" RAT_FUNC "%3.0" "" COEFFS 0 1 0 0 0 1 /end COMPU_METHOD
/begin COMPU_METHOD pwr_computeEnginePower_CM_ufix16_Sp1 "Q = V*10.000000" RAT_FUNC "%5.1" "" COEFFS 0 10.000000 0.000000 0 0 1.000000 /end COMPU_METHOD
/begin COMPU_METHOD pwr_computeEnginePower_CM_sfix16_En1 "Q = V*2.000000" RAT_FUNC "%6.1" "" COEFFS 0 2.000000 0.000000 0 0 1.000000 /end COMPU_METHOD
/begin COMPU_METHOD pwr_computeEnginePower_CM_ufix16_S1p6 "Q = V/1.600000" RAT_FUNC "%7.1" "" COEFFS 0 1.000000 0.000000 0 0 1.600000 /end COMPU_METHOD
/begin COMPU_METHOD pwr_computeEnginePower_CM_ufix16_En1_Bn10 "Q = (V+10.000000)*2.000000" RAT_FUNC "%6.1" "" COEFFS 0 2.000000 20.000000 0 0 1.000000 /end COMPU_METHOD
/begin COMPU_METHOD pwr_computeEnginePower_CM_ufix16_E5_Bn500000 "Q = (V+500000.000000)/32.000000" RAT_FUNC "%7.0" "" COEFFS 0 1.000000 500000.000000 0 0 32.000000 /end COMPU_METHOD
/begin COMPU_METHOD pwr_computeEnginePower_CM_uint16 "Q = V" RAT_FUNC "%5.0" "" COEFFS 0 1 0 0 0 1 /end COMPU_METHOD
/begin COMPU_METHOD pwr_computeEnginePower_CM_boolean "Q = V" RAT_FUNC "%1.0" "" COEFFS 0 1 0 0 0 1 /end COMPU_METHOD
/begin COMPU_METHOD pwr_computeEnginePower_CM_sfix32_En9 "Q = V*512.000000" RAT_FUNC "%16.9" "" COEFFS 0 512.000000 0.000000 0 0 1.000000 /end COMPU_METHOD
/begin GROUP pwr_computeEnginePower "pwr_computeEnginePower" /* Root */ ROOT
 /begin SUB_GROUP Root_powerComputation Root_transmissionErrs cap_canBus_PT cap_pPT_InfoPowerDisplay_1536 cap_pPT_LimitsPowerDisplay_1538 cap_pPT_StatusPowerDisplay_1537 /end SUB_GROUP
/end GROUP
/begin GROUP Root_powerComputation "pwr_computeEnginePower/powerComputation" /begin SUB_GROUP S3_normalOperation /end SUB_GROUP /end GROUP
/begin GROUP Root_transmissionErrs "pwr_computeEnginePower/transmissionErrs" /begin SUB_GROUP S4_hold /end SUB_GROUP /end GROUP
/begin GROUP S3_normalOperation "pwr_computeEnginePower/powerComputation/normalOperation" /begin SUB_GROUP S11_isSaturated /end SUB_GROUP /begin REF_MEASUREMENT pwr_computeEnginePower_B.tqTimesSOR /end REF_MEASUREMENT /end GROUP
/begin GROUP S4_hold "pwr_computeEnginePower/transmissionErrs/hold" /begin REF_MEASUREMENT pwr_transmissionErrAry /end REF_MEASUREMENT /end GROUP
/begin GROUP S11_isSaturated "pwr_computeEnginePower/powerComputation/normalOperation/isSaturated" /begin REF_MEASUREMENT pwr_computeEnginePower_B.tqTimSORIsSaturated /end REF_MEASUREMENT /end GROUP
/begin GROUP cap_canBus_PT ""
 /begin SUB_GROUP cap_canBus_PT.PT_InfoPowerDisplay_1536_sts cap_canBus_PT.PT_LimitsPowerDisplay_1538_sts cap_canBus_PT.PT_StateEcu01_1024_sts cap_canBus_PT.PT_StateEcu02_1040_sts cap_canBus_PT.PT_StatusPowerDisplay_1537_sts cap_canBus_PT.PT_UserLimits_2032_sts /end SUB_GROUP
/end GROUP
/begin GROUP cap_canBus_PT.PT_StateEcu01_1024_sts "" /begin SUB_GROUP cap_canBus_PT.PT_StateEcu01_1024_sts.signals /end SUB_GROUP /begin REF_MEASUREMENT cap_canBus_PT.PT_StateEcu01_1024_sts.stsTransmission /end REF_MEASUREMENT /end GROUP
/begin GROUP cap_canBus_PT.PT_StateEcu01_1024_sts.signals ""
 /begin REF_MEASUREMENT cap_canBus_PT.PT_StateEcu01_1024_sts.signals.checksum cap_canBus_PT.PT_StateEcu01_1024_sts.signals.sequenceCounter cap_canBus_PT.PT_StateEcu01_1024_sts.signals.speedOfRotation /end REF_MEASUREMENT
/end GROUP
/begin GROUP cap_canBus_PT.PT_StateEcu02_1040_sts "" /begin SUB_GROUP cap_canBus_PT.PT_StateEcu02_1040_sts.signals /end SUB_GROUP /begin REF_MEASUREMENT cap_canBus_PT.PT_StateEcu02_1040_sts.stsTransmission /end REF_MEASUREMENT /end GROUP
/begin GROUP cap_canBus_PT.PT_StateEcu02_1040_sts.signals ""
 /begin REF_MEASUREMENT cap_canBus_PT.PT_StateEcu02_1040_sts.signals.checksum cap_canBus_PT.PT_StateEcu02_1040_sts.signals.sequenceCounter cap_canBus_PT.PT_StateEcu02_1040_sts.signals.torque /end REF_MEASUREMENT
/end GROUP
/begin GROUP cap_canBus_PT.PT_UserLimits_2032_sts "" /begin SUB_GROUP cap_canBus_PT.PT_UserLimits_2032_sts.signals /end SUB_GROUP /begin REF_MEASUREMENT cap_canBus_PT.PT_UserLimits_2032_sts.stsTransmission /end REF_MEASUREMENT /end GROUP
/begin GROUP cap_canBus_PT.PT_UserLimits_2032_sts.signals ""
 /begin REF_MEASUREMENT cap_canBus_PT.PT_UserLimits_2032_sts.signals.checksum cap_canBus_PT.PT_UserLimits_2032_sts.signals.maxPower cap_canBus_PT.PT_UserLimits_2032_sts.signals.maxSpeedOfRotation cap_canBus_PT.PT_UserLimits_2032_sts.signals.minPower cap_canBus_PT.PT_UserLimits_2032_sts.signals.minSpeedOfRotation cap_canBus_PT.PT_UserLimits_2032_sts.signals.sequenceCounter /end REF_MEASUREMENT
/end GROUP
/begin GROUP cap_canBus_PT.PT_InfoPowerDisplay_1536_sts "" /begin SUB_GROUP cap_canBus_PT.PT_InfoPowerDisplay_1536_sts.signals /end SUB_GROUP /begin REF_MEASUREMENT cap_canBus_PT.PT_InfoPowerDisplay_1536_sts.stsTransmission /end REF_MEASUREMENT /end GROUP
/begin GROUP cap_canBus_PT.PT_InfoPowerDisplay_1536_sts.signals ""
 /begin REF_MEASUREMENT cap_canBus_PT.PT_InfoPowerDisplay_1536_sts.signals.checksum cap_canBus_PT.PT_InfoPowerDisplay_1536_sts.signals.power cap_canBus_PT.PT_InfoPowerDisplay_1536_sts.signals.sequenceCounter cap_canBus_PT.PT_InfoPowerDisplay_1536_sts.signals.state /end REF_MEASUREMENT
/end GROUP
/begin GROUP cap_canBus_PT.PT_StatusPowerDisplay_1537_sts "" /begin SUB_GROUP cap_canBus_PT.PT_StatusPowerDisplay_1537_sts.signals /end SUB_GROUP
 /begin REF_MEASUREMENT cap_canBus_PT.PT_StatusPowerDisplay_1537_sts.stsTransmission /end REF_MEASUREMENT
/end GROUP
/begin GROUP cap_canBus_PT.PT_StatusPowerDisplay_1537_sts.signals ""
 /begin REF_MEASUREMENT cap_canBus_PT.PT_StatusPowerDisplay_1537_sts.signals.checksum cap_canBus_PT.PT_StatusPowerDisplay_1537_sts.signals.noCheckSumErrors cap_canBus_PT.PT_StatusPowerDisplay_1537_sts.signals.noDlcErrors cap_canBus_PT.PT_StatusPowerDisplay_1537_sts.signals.noSqcErrors cap_canBus_PT.PT_StatusPowerDisplay_1537_sts.signals.sequenceCounter /end REF_MEASUREMENT
/end GROUP
/begin GROUP cap_canBus_PT.PT_LimitsPowerDisplay_1538_sts "" /begin SUB_GROUP cap_canBus_PT.PT_LimitsPowerDisplay_1538_sts.signals /end SUB_GROUP
 /begin REF_MEASUREMENT cap_canBus_PT.PT_LimitsPowerDisplay_1538_sts.stsTransmission /end REF_MEASUREMENT
/end GROUP
/begin GROUP cap_canBus_PT.PT_LimitsPowerDisplay_1538_sts.signals ""
 /begin REF_MEASUREMENT cap_canBus_PT.PT_LimitsPowerDisplay_1538_sts.signals.aboveMaxPower cap_canBus_PT.PT_LimitsPowerDisplay_1538_sts.signals.aboveMaxSpeedOfRotation cap_canBus_PT.PT_LimitsPowerDisplay_1538_sts.signals.belowMinPower cap_canBus_PT.PT_LimitsPowerDisplay_1538_sts.signals.belowMinSpeedOfRotation cap_canBus_PT.PT_LimitsPowerDisplay_1538_sts.signals.sequenceCounter /end REF_MEASUREMENT
/end GROUP
/begin GROUP cap_pPT_StatusPowerDisplay_1537 ""
 /begin REF_MEASUREMENT cap_pPT_StatusPowerDisplay_1537.checksum cap_pPT_StatusPowerDisplay_1537.noCheckSumErrors cap_pPT_StatusPowerDisplay_1537.noDlcErrors cap_pPT_StatusPowerDisplay_1537.noSqcErrors cap_pPT_StatusPowerDisplay_1537.sequenceCounter /end REF_MEASUREMENT
/end GROUP
/begin GROUP cap_pPT_LimitsPowerDisplay_1538 ""
 /begin REF_MEASUREMENT cap_pPT_LimitsPowerDisplay_1538.aboveMaxPower cap_pPT_LimitsPowerDisplay_1538.aboveMaxSpeedOfRotation cap_pPT_LimitsPowerDisplay_1538.belowMinPower cap_pPT_LimitsPowerDisplay_1538.belowMinSpeedOfRotation cap_pPT_LimitsPowerDisplay_1538.sequenceCounter /end REF_MEASUREMENT
/end GROUP
/begin GROUP cap_pPT_InfoPowerDisplay_1536 ""
 /begin REF_MEASUREMENT cap_pPT_InfoPowerDisplay_1536.checksum cap_pPT_InfoPowerDisplay_1536.power cap_pPT_InfoPowerDisplay_1536.sequenceCounter cap_pPT_InfoPowerDisplay_1536.state /end REF_MEASUREMENT
/end GROUP
/end MODULE
/end PROJECT
/* (add any file trailer comments here) */
/* EOF pwr_computeEnginePower.a2l */
