[part 4 of 4: packages /cif_swcCanInterface/CANBus_CAN_RT/interfaces to /AUTOSAR_PlatformTypes/SwBaseTypes]
AUTOSAR XML (schema 4-1-3)
package /cif_swcCanInterface/CANBus_CAN_RT/interfaces  # This package contains an interface specification for each frame appearing in bus CAN_RT, which is either sent or received by network node ECU
  215 x sender receiver interface:
    if0d7  # This interface contains a data element for each signal of input frame RT_SB_INS_Vel_Body_Axes, 215 (0x0d7). The frame has 6 normal signals and 3 multiplexed signal sets
      13 x data:
        Validity_INS_Vel_Forwards: type=cif_0x0d7_Validity_INS_Vel_Forwards_t  # Input signal Validity_INS_Vel_Forwards of frame RT_SB_INS_Vel_Body_Axes, 215 (0x0d7).
        Validity_INS_Vel_Sideways: type=cif_0x0d7_Validity_INS_Vel_Sideways_t  # Input signal Validity_INS_Vel_Sideways of frame RT_SB_INS_Vel_Body_Axes, 215 (0x0d7).
        Bit4: type=cif_0x0d7_Bit4_t  # Input signal Bit4 of frame RT_SB_INS_Vel_Body_Axes, 215 (0x0d7).
        Bit7: type=cif_0x0d7_Bit7_t  # Input signal Bit7 of frame RT_SB_INS_Vel_Body_Axes, 215 (0x0d7).
        Byte2_Bit0: type=cif_0x0d7_Byte2_Bit0_t  # Input signal Byte2_Bit0 of frame RT_SB_INS_Vel_Body_Axes, 215 (0x0d7).
        INS_Vel_Sideways_2D: type=cif_0x0d7_INS_Vel_Sideways_2D_t  # Input signal INS_Vel_Sideways_2D of frame RT_SB_INS_Vel_Body_Axes, 215 (0x0d7).
        Byte4_Bits67: type=cif_0x0d7_Byte4_Bits67_t  # Input signal Byte4_Bits67 of frame RT_SB_INS_Vel_Body_Axes, 215 (0x0d7).
        Accuracy_INS_Vel_Body_org: type=cif_0x0d7_Accuracy_INS_Vel_Body_org_t  # Input signal Accuracy_INS_Vel_Body_org of frame RT_SB_INS_Vel_Body_Axes, 215 (0x0d7).
        INS_Vel_Forwards_2D_org: type=cif_0x0d7_INS_Vel_Forwards_2D_org_t  # Input signal INS_Vel_Forwards_2D_org of frame RT_SB_INS_Vel_Body_Axes, 215 (0x0d7).
        Accuracy_INS_Vel_Body_no2: type=cif_0x0d7_Accuracy_INS_Vel_Body_no2_t  # Input signal Accuracy_INS_Vel_Body_no2 of frame RT_SB_INS_Vel_Body_Axes, 215 (0x0d7).
        INS_Vel_Forwards_2D_no2: type=cif_0x0d7_INS_Vel_Forwards_2D_no2_t  # Input signal INS_Vel_Forwards_2D_no2 of frame RT_SB_INS_Vel_Body_Axes, 215 (0x0d7).
        Accuracy_INS_Vel_Body_no3: type=cif_0x0d7_Accuracy_INS_Vel_Body_no3_t  # Input signal Accuracy_INS_Vel_Body_no3 of frame RT_SB_INS_Vel_Body_Axes, 215 (0x0d7).
        INS_Vel_Forwards_2D_no3: type=cif_0x0d7_INS_Vel_Forwards_2D_no3_t  # Input signal INS_Vel_Forwards_2D_no3 of frame RT_SB_INS_Vel_Body_Axes, 215 (0x0d7).
    if801024  # This interface contains a data element for each signal of input frame RT_DL1MK3_Speed, 8392740 (0x801024). The frame has 4 signals
      4 x data:
        Validity_Speed: type=cif_0x801024_Validity_Speed_t  # Input signal Validity_Speed of frame RT_DL1MK3_Speed, 8392740 (0x801024). Valid when bit is set, invalid when bit is clear.
        Accuracy_Speed: type=cif_0x801024_Accuracy_Speed_t  # Input signal Accuracy_Speed of frame RT_DL1MK3_Speed, 8392740 (0x801024). Dimensionless. Lower values imply but do not guarantee better accuracy than higher values.
        Direction: type=cif_0x801024_Direction_t  # Input signal Direction of frame RT_DL1MK3_Speed, 8392740 (0x801024). Dimensionless. Direction of speed. 1 means forward, -1 means reverse
        Speed: type=cif_0x801024_Speed_t  # Input signal Speed of frame RT_DL1MK3_Speed, 8392740 (0x801024).
    if8c0124  # This interface contains a data element for each signal of input frame RT_DL1MK3_GPS_Time, 9175332 (0x8c0124). The frame has 5 signals
      5 x data:
        Validity_GPS_Time: type=cif_0x8c0124_Validity_GPS_Time_t  # Input signal Validity_GPS_Time of frame RT_DL1MK3_GPS_Time, 9175332 (0x8c0124). Valid when bit is set, invalid when bit is clear.
        Validity_GPS_Week: type=cif_0x8c0124_Validity_GPS_Week_t  # Input signal Validity_GPS_Week of frame RT_DL1MK3_GPS_Time, 9175332 (0x8c0124). Valid when bit is set, invalid when bit is clear.
        Accuracy_GPS_Time: type=cif_0x8c0124_Accuracy_GPS_Time_t  # Input signal Accuracy_GPS_Time of frame RT_DL1MK3_GPS_Time, 9175332 (0x8c0124).
        GPS_Time: type=cif_0x8c0124_GPS_Time_t  # Input signal GPS_Time of frame RT_DL1MK3_GPS_Time, 9175332 (0x8c0124). GPS time is the time in seconds since midnight GMT on Saturday night.
        GPS_Week: type=cif_0x8c0124_GPS_Week_t  # Input signal GPS_Week of frame RT_DL1MK3_GPS_Time, 9175332 (0x8c0124).
    if8c0324  # This interface contains a data element for each signal of input frame RT_DL1MK3_GPS_Pos_LLH_2, 9175844 (0x8c0324). The frame has 2 signals
      data GPS_Pos_LLH_Longitude: type=cif_0x8c0324_GPS_Pos_LLH_Longitude_t  # Input signal GPS_Pos_LLH_Longitude of frame RT_DL1MK3_GPS_Pos_LLH_2, 9175844 (0x8c0324).
      data GPS_Pos_LLH_Altitude: type=cif_0x8c0324_GPS_Pos_LLH_Altitude_t  # Input signal GPS_Pos_LLH_Altitude of frame RT_DL1MK3_GPS_Pos_LLH_2, 9175844 (0x8c0324).
    if8c0224  # This interface contains a data element for each signal of input frame RT_DL1MK3_GPS_Pos_LLH_1, 9175588 (0x8c0224). The frame has 7 signals
      7 x data:
        Validity_GPS_Pos_LLH_Latitude: type=cif_0x8c0224_Validity_GPS_Pos_LLH_Latitude_t  # Input signal Validity_GPS_Pos_LLH_Latitude of frame RT_DL1MK3_GPS_Pos_LLH_1, 9175588 (0x8c0224). Valid when bit is set, invalid when bit is clear.
        Validity_GPS_Pos_LLH_Longitude: type=cif_0x8c0224_Validity_GPS_Pos_LLH_Longitude_t  # Input signal Validity_GPS_Pos_LLH_Longitude of frame RT_DL1MK3_GPS_Pos_LLH_1, 9175588 (0x8c0224). Valid when bit is set, invalid when bit is clear.
        Validity_GPS_Pos_LLH_Altitude: type=cif_0x8c0224_Validity_GPS_Pos_LLH_Altitude_t  # Input signal Validity_GPS_Pos_LLH_Altitude of frame RT_DL1MK3_GPS_Pos_LLH_1, 9175588 (0x8c0224). Valid when bit is set, invalid when bit is clear.
        Accuracy_GPS_Pos_LLH_Latitude: type=cif_0x8c0224_Accuracy_GPS_Pos_LLH_Latitude_t  # Input signal Accuracy_GPS_Pos_LLH_Latitude of frame RT_DL1MK3_GPS_Pos_LLH_1, 9175588 (0x8c0224). This accuracy value applies to both 2D and 3D GPS speed.
        Accuracy_GPS_Pos_LLH_Longitude: type=cif_0x8c0224_Accuracy_GPS_Pos_LLH_Longitude_t  # Input signal Accuracy_GPS_Pos_LLH_Longitude of frame RT_DL1MK3_GPS_Pos_LLH_1, 9175588 (0x8c0224). This accuracy value applies to both 2D and 3D GPS speed.
        Accuracy_GPS_Pos_LLH_Altitude: type=cif_0x8c0224_Accuracy_GPS_Pos_LLH_Altitude_t  # Input signal Accuracy_GPS_Pos_LLH_Altitude of frame RT_DL1MK3_GPS_Pos_LLH_1, 9175588 (0x8c0224). This accuracy value applies to both 2D and 3D GPS speed.
        GPS_Pos_LLH_Latitude: type=cif_0x8c0224_GPS_Pos_LLH_Latitude_t  # Input signal GPS_Pos_LLH_Latitude of frame RT_DL1MK3_GPS_Pos_LLH_1, 9175588 (0x8c0224).
    if4d2  # This interface contains a data element for each signal of input frame RT_DL1MK3_GPS_Speed, 1234 (0x4d2). The frame has 5 signals
      5 x data:
        Validity_GPS_Speed_2D: type=cif_0x4d2_Validity_GPS_Speed_2D_t  # Input signal Validity_GPS_Speed_2D of frame RT_DL1MK3_GPS_Speed, 1234 (0x4d2). Valid when bit is set, invalid when bit is clear.
        Validity_GPS_Speed_3D: type=cif_0x4d2_Validity_GPS_Speed_3D_t  # Input signal Validity_GPS_Speed_3D of frame RT_DL1MK3_GPS_Speed, 1234 (0x4d2). Valid when bit is set, invalid when bit is clear.
        Accuracy_GPS_Speed: type=cif_0x4d2_Accuracy_GPS_Speed_t  # Input signal Accuracy_GPS_Speed of frame RT_DL1MK3_GPS_Speed, 1234 (0x4d2). This accuracy value applies to both 2D and 3D GPS speed.
        GPS_Speed_2D: type=cif_0x4d2_GPS_Speed_2D_t  # Input signal GPS_Speed_2D of frame RT_DL1MK3_GPS_Speed, 1234 (0x4d2). This is GPS scalar 2D speed - scalar speed with no local Z axis component included.
        GPS_Speed_3D: type=cif_0x4d2_GPS_Speed_3D_t  # Input signal GPS_Speed_3D of frame RT_DL1MK3_GPS_Speed, 1234 (0x4d2). This is GPS scalar 3D speed - scalar speed with the local Z axis component included.
    if980825  # This interface contains a data element for each signal of input frame RT_IRTemp_Temp_RR_2, 9963557 (0x980825). The frame has 4 signals
      4 x data:
        IR_Temperature_{29..32}: type=cif_0x980825_IR_Temperature_{29..32}_t  # Input signal IR_Temperature_{29..32} of frame RT_IRTemp_Temp_RR_2, 9963557 (0x980825).
    if980625  # This interface contains a data element for each signal of output frame RT_IRTemp_Temp_RL_2, 9963045 (0x980625). The frame has 4 signals
      4 x data:
        IR_Temperature_{21..24}: type=cif_0x980625_IR_Temperature_{21..24}_t  # Output signal IR_Temperature_{21..24} of frame RT_IRTemp_Temp_RL_2, 9963045 (0x980625).
    if980425  # This interface contains a data element for each signal of output frame RT_IRTemp_Temp_FR_2, 9962533 (0x980425). The frame has 4 signals
      4 x data:
        IR_Temperature_{13..16}: type=cif_0x980425_IR_Temperature_{13..16}_t  # Output signal IR_Temperature_{13..16} of frame RT_IRTemp_Temp_FR_2, 9962533 (0x980425).
    if980225  # This interface contains a data element for each signal of input frame RT_IRTemp_Temp_FL_2, 9962021 (0x980225). The frame has 4 signals
      4 x data:
        IR_Temperature_{5..8}: type=cif_0x980225_IR_Temperature_{5..8}_t  # Input signal IR_Temperature_{5..8} of frame RT_IRTemp_Temp_FL_2, 9962021 (0x980225).
    if980725  # This interface contains a data element for each signal of input frame RT_IRTemp_Temp_RR_1, 9963301 (0x980725). The frame has 4 signals
      4 x data:
        IR_Temperature_{25..28}: type=cif_0x980725_IR_Temperature_{25..28}_t  # Input signal IR_Temperature_{25..28} of frame RT_IRTemp_Temp_RR_1, 9963301 (0x980725).
    if980525  # This interface contains a data element for each signal of input frame RT_IRTemp_Temp_RL_1, 9962789 (0x980525). The frame has 4 signals
      4 x data:
        IR_Temperature_{17..20}: type=cif_0x980525_IR_Temperature_{17..20}_t  # Input signal IR_Temperature_{17..20} of frame RT_IRTemp_Temp_RL_1, 9962789 (0x980525).
    if980325  # This interface contains a data element for each signal of input frame RT_IRTemp_Temp_FR_1, 9962277 (0x980325). The frame has 4 signals
      4 x data:
        IR_Temperature_{9..12}: type=cif_0x980325_IR_Temperature_{9..12}_t  # Input signal IR_Temperature_{9..12} of frame RT_IRTemp_Temp_FR_1, 9962277 (0x980325).
    if980125  # This interface contains a data element for each signal of input frame RT_IRTemp_Temp_FL_1, 9961765 (0x980125). The frame has 4 signals
      4 x data:
        IR_Temperature_{1..4}: type=cif_0x980125_IR_Temperature_{1..4}_t  # Input signal IR_Temperature_{1..4} of frame RT_IRTemp_Temp_FL_1, 9961765 (0x980125).
    if912025  # This interface contains a data element for each signal of input frame RT_IRTemp_Temp_32, 9510949 (0x912025). The frame has 1 signals
      data IR_Temperature_32: type=cif_0x912025_IR_Temperature_32_t  # Input signal IR_Temperature_32 of frame RT_IRTemp_Temp_32, 9510949 (0x912025).
    if911f25  # This interface contains a data element for each signal of input frame RT_IRTemp_Temp_31, 9510693 (0x911f25). The frame has 1 signals
      data IR_Temperature_31: type=cif_0x911f25_IR_Temperature_31_t  # Input signal IR_Temperature_31 of frame RT_IRTemp_Temp_31, 9510693 (0x911f25).
    if911e25  # This interface contains a data element for each signal of output frame RT_IRTemp_Temp_30, 9510437 (0x911e25). The frame has 1 signals
      data IR_Temperature_30: type=cif_0x911e25_IR_Temperature_30_t  # Output signal IR_Temperature_30 of frame RT_IRTemp_Temp_30, 9510437 (0x911e25).
    if911d25  # This interface contains a data element for each signal of input frame RT_IRTemp_Temp_29, 9510181 (0x911d25). The frame has 1 signals
      data IR_Temperature_29: type=cif_0x911d25_IR_Temperature_29_t  # Input signal IR_Temperature_29 of frame RT_IRTemp_Temp_29, 9510181 (0x911d25).
    if911c25  # This interface contains a data element for each signal of input frame RT_IRTemp_Temp_28, 9509925 (0x911c25). The frame has 1 signals
      data IR_Temperature_28: type=cif_0x911c25_IR_Temperature_28_t  # Input signal IR_Temperature_28 of frame RT_IRTemp_Temp_28, 9509925 (0x911c25).
    if911b25  # This interface contains a data element for each signal of input frame RT_IRTemp_Temp_27, 9509669 (0x911b25). The frame has 1 signals
      data IR_Temperature_27: type=cif_0x911b25_IR_Temperature_27_t  # Input signal IR_Temperature_27 of frame RT_IRTemp_Temp_27, 9509669 (0x911b25).
    if911a25  # This interface contains a data element for each signal of output frame RT_IRTemp_Temp_26, 9509413 (0x911a25). The frame has 1 signals
      data IR_Temperature_26: type=cif_0x911a25_IR_Temperature_26_t  # Output signal IR_Temperature_26 of frame RT_IRTemp_Temp_26, 9509413 (0x911a25).
    if911925  # This interface contains a data element for each signal of input frame RT_IRTemp_Temp_25, 9509157 (0x911925). The frame has 1 signals
      data IR_Temperature_25: type=cif_0x911925_IR_Temperature_25_t  # Input signal IR_Temperature_25 of frame RT_IRTemp_Temp_25, 9509157 (0x911925).
    if911825  # This interface contains a data element for each signal of input frame RT_IRTemp_Temp_24, 9508901 (0x911825). The frame has 1 signals
      data IR_Temperature_24: type=cif_0x911825_IR_Temperature_24_t  # Input signal IR_Temperature_24 of frame RT_IRTemp_Temp_24, 9508901 (0x911825).
    if911625  # This interface contains a data element for each signal of input frame RT_IRTemp_Temp_22, 9508389 (0x911625). The frame has 1 signals
      data IR_Temperature_22: type=cif_0x911625_IR_Temperature_22_t  # Input signal IR_Temperature_22 of frame RT_IRTemp_Temp_22, 9508389 (0x911625).
    if911725  # This interface contains a data element for each signal of input frame RT_IRTemp_Temp_23, 9508645 (0x911725). The frame has 1 signals
      data IR_Temperature_23: type=cif_0x911725_IR_Temperature_23_t  # Input signal IR_Temperature_23 of frame RT_IRTemp_Temp_23, 9508645 (0x911725).
    if911525  # This interface contains a data element for each signal of input frame RT_IRTemp_Temp_21, 9508133 (0x911525). The frame has 1 signals
      data IR_Temperature_21: type=cif_0x911525_IR_Temperature_21_t  # Input signal IR_Temperature_21 of frame RT_IRTemp_Temp_21, 9508133 (0x911525).
    if911425  # This interface contains a data element for each signal of input frame RT_IRTemp_Temp_20, 9507877 (0x911425). The frame has 1 signals
      data IR_Temperature_20: type=cif_0x911425_IR_Temperature_20_t  # Input signal IR_Temperature_20 of frame RT_IRTemp_Temp_20, 9507877 (0x911425).
    if911325  # This interface contains a data element for each signal of input frame RT_IRTemp_Temp_19, 9507621 (0x911325). The frame has 1 signals
      data IR_Temperature_19: type=cif_0x911325_IR_Temperature_19_t  # Input signal IR_Temperature_19 of frame RT_IRTemp_Temp_19, 9507621 (0x911325).
    if911225  # This interface contains a data element for each signal of input frame RT_IRTemp_Temp_18, 9507365 (0x911225). The frame has 1 signals
      data IR_Temperature_18: type=cif_0x911225_IR_Temperature_18_t  # Input signal IR_Temperature_18 of frame RT_IRTemp_Temp_18, 9507365 (0x911225).
    if911025  # This interface contains a data element for each signal of input frame RT_IRTemp_Temp_16, 9506853 (0x911025). The frame has 1 signals
      data IR_Temperature_16: type=cif_0x911025_IR_Temperature_16_t  # Input signal IR_Temperature_16 of frame RT_IRTemp_Temp_16, 9506853 (0x911025).
    if910f25  # This interface contains a data element for each signal of input frame RT_IRTemp_Temp_15, 9506597 (0x910f25). The frame has 1 signals
      data IR_Temperature_15: type=cif_0x910f25_IR_Temperature_15_t  # Input signal IR_Temperature_15 of frame RT_IRTemp_Temp_15, 9506597 (0x910f25).
    if910e25  # This interface contains a data element for each signal of input frame RT_IRTemp_Temp_14, 9506341 (0x910e25). The frame has 1 signals
      data IR_Temperature_14: type=cif_0x910e25_IR_Temperature_14_t  # Input signal IR_Temperature_14 of frame RT_IRTemp_Temp_14, 9506341 (0x910e25).
    if910d25  # This interface contains a data element for each signal of input frame RT_IRTemp_Temp_13, 9506085 (0x910d25). The frame has 1 signals
      data IR_Temperature_13: type=cif_0x910d25_IR_Temperature_13_t  # Input signal IR_Temperature_13 of frame RT_IRTemp_Temp_13, 9506085 (0x910d25).
    if910c25  # This interface contains a data element for each signal of input frame RT_IRTemp_Temp_12, 9505829 (0x910c25). The frame has 1 signals
      data IR_Temperature_12: type=cif_0x910c25_IR_Temperature_12_t  # Input signal IR_Temperature_12 of frame RT_IRTemp_Temp_12, 9505829 (0x910c25).
    if910b25  # This interface contains a data element for each signal of input frame RT_IRTemp_Temp_11, 9505573 (0x910b25). The frame has 1 signals
      data IR_Temperature_11: type=cif_0x910b25_IR_Temperature_11_t  # Input signal IR_Temperature_11 of frame RT_IRTemp_Temp_11, 9505573 (0x910b25).
    if910a25  # This interface contains a data element for each signal of input frame RT_IRTemp_Temp_10, 9505317 (0x910a25). The frame has 1 signals
      data IR_Temperature_10: type=cif_0x910a25_IR_Temperature_10_t  # Input signal IR_Temperature_10 of frame RT_IRTemp_Temp_10, 9505317 (0x910a25).
    if910825  # This interface contains a data element for each signal of input frame RT_IRTemp_Temp_8, 9504805 (0x910825). The frame has 1 signals
      data IR_Temperature_8: type=cif_0x910825_IR_Temperature_8_t  # Input signal IR_Temperature_8 of frame RT_IRTemp_Temp_8, 9504805 (0x910825).
    if910925  # This interface contains a data element for each signal of input frame RT_IRTemp_Temp_9, 9505061 (0x910925). The frame has 1 signals
      data IR_Temperature_9: type=cif_0x910925_IR_Temperature_9_t  # Input signal IR_Temperature_9 of frame RT_IRTemp_Temp_9, 9505061 (0x910925).
    if911125  # This interface contains a data element for each signal of input frame RT_IRTemp_Temp_17, 9507109 (0x911125). The frame has 1 signals
      data IR_Temperature_17: type=cif_0x911125_IR_Temperature_17_t  # Input signal IR_Temperature_17 of frame RT_IRTemp_Temp_17, 9507109 (0x911125).
    if910625  # This interface contains a data element for each signal of input frame RT_IRTemp_Temp_6, 9504293 (0x910625). The frame has 1 signals
      data IR_Temperature_6: type=cif_0x910625_IR_Temperature_6_t  # Input signal IR_Temperature_6 of frame RT_IRTemp_Temp_6, 9504293 (0x910625).
    if910525  # This interface contains a data element for each signal of input frame RT_IRTemp_Temp_5, 9504037 (0x910525). The frame has 1 signals
      data IR_Temperature_5: type=cif_0x910525_IR_Temperature_5_t  # Input signal IR_Temperature_5 of frame RT_IRTemp_Temp_5, 9504037 (0x910525).
    if910425  # This interface contains a data element for each signal of input frame RT_IRTemp_Temp_4, 9503781 (0x910425). The frame has 1 signals
      data IR_Temperature_4: type=cif_0x910425_IR_Temperature_4_t  # Input signal IR_Temperature_4 of frame RT_IRTemp_Temp_4, 9503781 (0x910425).
    if910325  # This interface contains a data element for each signal of input frame RT_IRTemp_Temp_3, 9503525 (0x910325). The frame has 1 signals
      data IR_Temperature_3: type=cif_0x910325_IR_Temperature_3_t  # Input signal IR_Temperature_3 of frame RT_IRTemp_Temp_3, 9503525 (0x910325).
    if910225  # This interface contains a data element for each signal of input frame RT_IRTemp_Temp_2, 9503269 (0x910225). The frame has 1 signals
      data IR_Temperature_2: type=cif_0x910225_IR_Temperature_2_t  # Input signal IR_Temperature_2 of frame RT_IRTemp_Temp_2, 9503269 (0x910225).
    if910125  # This interface contains a data element for each signal of input frame RT_IRTemp_Temp_1, 9503013 (0x910125). The frame has 2 signals
      data IR_Temperature_1: type=cif_0x910125_IR_Temperature_1_t  # Input signal IR_Temperature_1 of frame RT_IRTemp_Temp_1, 9503013 (0x910125).
      data CRC: type=cif_0x910125_CRC_t  # Input signal CRC of frame RT_IRTemp_Temp_1, 9503013 (0x910125). Checksum
    if8d0722  # This interface contains a data element for each signal of input frame RT_SB_Trig_Final_Condition, 9242402 (0x8d0722). The frame has 2 signals
      data Validity_Final_Speed: type=cif_0x8d0722_Validity_Final_Speed_t  # Input signal Validity_Final_Speed of frame RT_SB_Trig_Final_Condition, 9242402 (0x8d0722). Valid when bit is set, invalid when bit is clear.
      data Final_Speed: type=cif_0x8d0722_Final_Speed_t  # Input signal Final_Speed of frame RT_SB_Trig_Final_Condition, 9242402 (0x8d0722). Speed at end of triggered test
    if31a  # This interface contains a data element for each signal of input frame RT_SB_Trig_Initial_Condition, 794 (0x31a). The frame has 6 signals
      6 x data:
        Validity_Initial_Speed: type=cif_0x31a_Validity_Initial_Speed_t  # Input signal Validity_Initial_Speed of frame RT_SB_Trig_Initial_Condition, 794 (0x31a). Valid when bit is set, invalid when bit is clear. Valid when bit is set, invalid when bit is clear.
        Validity_Initial_Heading: type=cif_0x31a_Validity_Initial_Heading_t  # Input signal Validity_Initial_Heading of frame RT_SB_Trig_Initial_Condition, 794 (0x31a). Valid when bit is set, invalid when bit is clear. Valid when bit is set, invalid when bit is clear.
        Initial_Speed: type=cif_0x31a_Initial_Speed_t  # Input signal Initial_Speed of frame RT_SB_Trig_Initial_Condition, 794 (0x31a). Speed at start of triggered test Speed at start of triggered test
        Initial_Heading: type=cif_0x31a_Initial_Heading_t  # Input signal Initial_Heading of frame RT_SB_Trig_Initial_Condition, 794 (0x31a). Heading (track) at start of triggered test Heading (track) at start of triggered test
        MFDD_Start_Threshold: type=cif_0x31a_MFDD_Start_Threshold_t  # Input signal MFDD_Start_Threshold of frame RT_SB_Trig_Initial_Condition, 794 (0x31a).
        MFDD_End_Threshold: type=cif_0x31a_MFDD_End_Threshold_t  # Input signal MFDD_End_Threshold of frame RT_SB_Trig_Initial_Condition, 794 (0x31a).
    if8d0522  # This interface contains a data element for each signal of input frame RT_SB_Trig_Direct_Dist, 9241890 (0x8d0522). The frame has 2 signals
      data Direct_Distance: type=cif_0x8d0522_Direct_Distance_t  # Input signal Direct_Distance of frame RT_SB_Trig_Direct_Dist, 9241890 (0x8d0522). Direct distance from start of test to current position
      data Path_Distance_2D: type=cif_0x8d0522_Path_Distance_2D_t  # Input signal Path_Distance_2D of frame RT_SB_Trig_Direct_Dist, 9241890 (0x8d0522). 2D path distance (horizontal components only)
    if8d0422  # This interface contains a data element for each signal of output frame RT_SB_Trig_Forward_Dist, 9241634 (0x8d0422). The frame has 2 signals
      data Forward_Distance: type=cif_0x8d0422_Forward_Distance_t  # Output signal Forward_Distance of frame RT_SB_Trig_Forward_Dist, 9241634 (0x8d0422). Current forward distance from start of test in direction of initial heading at start of test
      data Deviation_Distance: type=cif_0x8d0422_Deviation_Distance_t  # Output signal Deviation_Distance of frame RT_SB_Trig_Forward_Dist, 9241634 (0x8d0422). Current deviation distance from a line projected along the initial heading at start of test, +ve for deviation to the right.
    if8d0322  # This interface contains a data element for each signal of input frame RT_SB_Trig_Path_Dist, 9241378 (0x8d0322). The frame has 1 signals
      data Path_Distance_3D: type=cif_0x8d0322_Path_Distance_3D_t  # Input signal Path_Distance_3D of frame RT_SB_Trig_Path_Dist, 9241378 (0x8d0322). 3D path distance
    if8d0222  # This interface contains a data element for each signal of output frame RT_SB_Trig_Accel, 9241122 (0x8d0222). The frame has 6 signals
      6 x data:
        Validity_MFDD: type=cif_0x8d0222_Validity_MFDD_t  # Output signal Validity_MFDD of frame RT_SB_Trig_Accel, 9241122 (0x8d0222). Valid when bit is set, invalid when bit is clear.
        Validity_Average_Accel: type=cif_0x8d0222_Validity_Average_Accel_t  # Output signal Validity_Average_Accel of frame RT_SB_Trig_Accel, 9241122 (0x8d0222). Valid when bit is set, invalid when bit is clear.
        Validity_Triggered_Time: type=cif_0x8d0222_Validity_Triggered_Time_t  # Output signal Validity_Triggered_Time of frame RT_SB_Trig_Accel, 9241122 (0x8d0222). Valid when bit is set, invalid when bit is clear.
        MFDD: type=cif_0x8d0222_MFDD_t  # Output signal MFDD of frame RT_SB_Trig_Accel, 9241122 (0x8d0222). Mean fully-developed decelleration of triggered test. Thresholds used are as set in the logger configuration.
        Average_Accel: type=cif_0x8d0222_Average_Accel_t  # Output signal Average_Accel of frame RT_SB_Trig_Accel, 9241122 (0x8d0222). Average acceleration from start of triggered test to current time.
        Triggered_Time: type=cif_0x8d0222_Triggered_Time_t  # Output signal Triggered_Time of frame RT_SB_Trig_Accel, 9241122 (0x8d0222). Cumulative time from start of triggered test to current time.
    if960b24  # This interface contains a data element for each signal of input frame RT_DL1MK3_Measure_Time_11, 9833252 (0x960b24). The frame has 1 signals
      data Measured_Time_11: type=cif_0x960b24_Measured_Time_11_t  # Input signal Measured_Time_11 of frame RT_DL1MK3_Measure_Time_11, 9833252 (0x960b24).
    if960a24  # This interface contains a data element for each signal of input frame RT_DL1MK3_Measure_Time_10, 9832996 (0x960a24). The frame has 1 signals
      data Measured_Time_10: type=cif_0x960a24_Measured_Time_10_t  # Input signal Measured_Time_10 of frame RT_DL1MK3_Measure_Time_10, 9832996 (0x960a24).
    if960924  # This interface contains a data element for each signal of input frame RT_DL1MK3_Measure_Time_9, 9832740 (0x960924). The frame has 1 signals
      data Measured_Time_9: type=cif_0x960924_Measured_Time_9_t  # Input signal Measured_Time_9 of frame RT_DL1MK3_Measure_Time_9, 9832740 (0x960924).
    if960824  # This interface contains a data element for each signal of input frame RT_DL1MK3_Measure_Time_8, 9832484 (0x960824). The frame has 1 signals
      data Measured_Time_8: type=cif_0x960824_Measured_Time_8_t  # Input signal Measured_Time_8 of frame RT_DL1MK3_Measure_Time_8, 9832484 (0x960824).
    if960724  # This interface contains a data element for each signal of input frame RT_DL1MK3_Measure_Time_7, 9832228 (0x960724). The frame has 1 signals
      data Measured_Time_7: type=cif_0x960724_Measured_Time_7_t  # Input signal Measured_Time_7 of frame RT_DL1MK3_Measure_Time_7, 9832228 (0x960724).
    if960624  # This interface contains a data element for each signal of input frame RT_DL1MK3_Measure_Time_6, 9831972 (0x960624). The frame has 1 signals
      data Measured_Time_6: type=cif_0x960624_Measured_Time_6_t  # Input signal Measured_Time_6 of frame RT_DL1MK3_Measure_Time_6, 9831972 (0x960624).
    if960524  # This interface contains a data element for each signal of input frame RT_DL1MK3_Measure_Time_5, 9831716 (0x960524). The frame has 1 signals
      data Measured_Time_5: type=cif_0x960524_Measured_Time_5_t  # Input signal Measured_Time_5 of frame RT_DL1MK3_Measure_Time_5, 9831716 (0x960524).
    if960424  # This interface contains a data element for each signal of input frame RT_DL1MK3_Measure_Time_4, 9831460 (0x960424). The frame has 1 signals
      data Measured_Time_4: type=cif_0x960424_Measured_Time_4_t  # Input signal Measured_Time_4 of frame RT_DL1MK3_Measure_Time_4, 9831460 (0x960424).
    if960324  # This interface contains a data element for each signal of input frame RT_DL1MK3_Measure_Time_3, 9831204 (0x960324). The frame has 1 signals
      data Measured_Time_3: type=cif_0x960324_Measured_Time_3_t  # Input signal Measured_Time_3 of frame RT_DL1MK3_Measure_Time_3, 9831204 (0x960324).
    if960224  # This interface contains a data element for each signal of input frame RT_DL1MK3_Measure_Time_2, 9830948 (0x960224). The frame has 1 signals
      data Measured_Time_2: type=cif_0x960224_Measured_Time_2_t  # Input signal Measured_Time_2 of frame RT_DL1MK3_Measure_Time_2, 9830948 (0x960224).
    if960124  # This interface contains a data element for each signal of input frame RT_DL1MK3_Measure_Time_1, 9830692 (0x960124). The frame has 1 signals
      data Measured_Time_1: type=cif_0x960124_Measured_Time_1_t  # Input signal Measured_Time_1 of frame RT_DL1MK3_Measure_Time_1, 9830692 (0x960124).
    if950c24  # This interface contains a data element for each signal of input frame RT_DL1MK3_RPM, 9767972 (0x950c24). The frame has 1 signals
      data RPM: type=cif_0x950c24_RPM_t  # Input signal RPM of frame RT_DL1MK3_RPM, 9767972 (0x950c24).
    if950b24  # This interface contains a data element for each signal of input frame RT_DL1MK3_Freq_4, 9767716 (0x950b24). The frame has 1 signals
      data Frequency_4: type=cif_0x950b24_Frequency_4_t  # Input signal Frequency_4 of frame RT_DL1MK3_Freq_4, 9767716 (0x950b24).
    if950a24  # This interface contains a data element for each signal of input frame RT_DL1MK3_Freq_3, 9767460 (0x950a24). The frame has 1 signals
      data Frequency_3: type=cif_0x950a24_Frequency_3_t  # Input signal Frequency_3 of frame RT_DL1MK3_Freq_3, 9767460 (0x950a24).
    if950924  # This interface contains a data element for each signal of input frame RT_DL1MK3_Freq_2, 9767204 (0x950924). The frame has 1 signals
      data Frequency_2: type=cif_0x950924_Frequency_2_t  # Input signal Frequency_2 of frame RT_DL1MK3_Freq_2, 9767204 (0x950924).
    if970324  # This interface contains a data element for each signal of input frame RT_DL1MK3_Misc_3, 9896740 (0x970324). The frame has 1 signals
      data Misc_3: type=cif_0x970324_Misc_3_t  # Input signal Misc_3 of frame RT_DL1MK3_Misc_3, 9896740 (0x970324).
    if970224  # This interface contains a data element for each signal of input frame RT_DL1MK3_Misc_2, 9896484 (0x970224). The frame has 1 signals
      data Misc_2: type=cif_0x970224_Misc_2_t  # Input signal Misc_2 of frame RT_DL1MK3_Misc_2, 9896484 (0x970224).
    if970124  # This interface contains a data element for each signal of input frame RT_DL1MK3_Misc_1, 9896228 (0x970124). The frame has 1 signals
      data Misc_1: type=cif_0x970124_Misc_1_t  # Input signal Misc_1 of frame RT_DL1MK3_Misc_1, 9896228 (0x970124).
    if941f24  # This interface contains a data element for each signal of input frame RT_DL1MK3_Aux_31, 9707300 (0x941f24). The frame has 1 signals
      data AUX_31: type=cif_0x941f24_AUX_31_t  # Input signal AUX_31 of frame RT_DL1MK3_Aux_31, 9707300 (0x941f24).
    if941e24  # This interface contains a data element for each signal of input frame RT_DL1MK3_Aux_30, 9707044 (0x941e24). The frame has 1 signals
      data AUX_30: type=cif_0x941e24_AUX_30_t  # Input signal AUX_30 of frame RT_DL1MK3_Aux_30, 9707044 (0x941e24).
    if941d24  # This interface contains a data element for each signal of input frame RT_DL1MK3_Aux_29, 9706788 (0x941d24). The frame has 1 signals
      data AUX_29: type=cif_0x941d24_AUX_29_t  # Input signal AUX_29 of frame RT_DL1MK3_Aux_29, 9706788 (0x941d24).
    if941c24  # This interface contains a data element for each signal of input frame RT_DL1MK3_Aux_28, 9706532 (0x941c24). The frame has 1 signals
      data AUX_28: type=cif_0x941c24_AUX_28_t  # Input signal AUX_28 of frame RT_DL1MK3_Aux_28, 9706532 (0x941c24).
    if941b24  # This interface contains a data element for each signal of input frame RT_DL1MK3_Aux_27, 9706276 (0x941b24). The frame has 1 signals
      data AUX_27: type=cif_0x941b24_AUX_27_t  # Input signal AUX_27 of frame RT_DL1MK3_Aux_27, 9706276 (0x941b24).
    if941a24  # This interface contains a data element for each signal of input frame RT_DL1MK3_Aux_26, 9706020 (0x941a24). The frame has 1 signals
      data AUX_26: type=cif_0x941a24_AUX_26_t  # Input signal AUX_26 of frame RT_DL1MK3_Aux_26, 9706020 (0x941a24).
    if941924  # This interface contains a data element for each signal of input frame RT_DL1MK3_Aux_25, 9705764 (0x941924). The frame has 1 signals
      data AUX_25: type=cif_0x941924_AUX_25_t  # Input signal AUX_25 of frame RT_DL1MK3_Aux_25, 9705764 (0x941924).
    if941824  # This interface contains a data element for each signal of input frame RT_DL1MK3_Aux_24, 9705508 (0x941824). The frame has 1 signals
      data AUX_24: type=cif_0x941824_AUX_24_t  # Input signal AUX_24 of frame RT_DL1MK3_Aux_24, 9705508 (0x941824).
    if941724  # This interface contains a data element for each signal of input frame RT_DL1MK3_Aux_23, 9705252 (0x941724). The frame has 1 signals
      data AUX_23: type=cif_0x941724_AUX_23_t  # Input signal AUX_23 of frame RT_DL1MK3_Aux_23, 9705252 (0x941724).
    if941624  # This interface contains a data element for each signal of input frame RT_DL1MK3_Aux_22, 9704996 (0x941624). The frame has 1 signals
      data AUX_22: type=cif_0x941624_AUX_22_t  # Input signal AUX_22 of frame RT_DL1MK3_Aux_22, 9704996 (0x941624).
    if941524  # This interface contains a data element for each signal of input frame RT_DL1MK3_Aux_21, 9704740 (0x941524). The frame has 1 signals
      data AUX_21: type=cif_0x941524_AUX_21_t  # Input signal AUX_21 of frame RT_DL1MK3_Aux_21, 9704740 (0x941524).
    if941424  # This interface contains a data element for each signal of input frame RT_DL1MK3_Aux_20, 9704484 (0x941424). The frame has 1 signals
      data AUX_20: type=cif_0x941424_AUX_20_t  # Input signal AUX_20 of frame RT_DL1MK3_Aux_20, 9704484 (0x941424).
    if941324  # This interface contains a data element for each signal of input frame RT_DL1MK3_Aux_19, 9704228 (0x941324). The frame has 1 signals
      data AUX_19: type=cif_0x941324_AUX_19_t  # Input signal AUX_19 of frame RT_DL1MK3_Aux_19, 9704228 (0x941324).
    if941224  # This interface contains a data element for each signal of input frame RT_DL1MK3_Aux_18, 9703972 (0x941224). The frame has 1 signals
      data AUX_18: type=cif_0x941224_AUX_18_t  # Input signal AUX_18 of frame RT_DL1MK3_Aux_18, 9703972 (0x941224).
    if941124  # This interface contains a data element for each signal of input frame RT_DL1MK3_Aux_17, 9703716 (0x941124). The frame has 1 signals
      data AUX_17: type=cif_0x941124_AUX_17_t  # Input signal AUX_17 of frame RT_DL1MK3_Aux_17, 9703716 (0x941124).
    if941024  # This interface contains a data element for each signal of input frame RT_DL1MK3_Aux_16, 9703460 (0x941024). The frame has 1 signals
      data AUX_16: type=cif_0x941024_AUX_16_t  # Input signal AUX_16 of frame RT_DL1MK3_Aux_16, 9703460 (0x941024).
    if940f24  # This interface contains a data element for each signal of input frame RT_DL1MK3_Aux_15, 9703204 (0x940f24). The frame has 1 signals
      data AUX_15: type=cif_0x940f24_AUX_15_t  # Input signal AUX_15 of frame RT_DL1MK3_Aux_15, 9703204 (0x940f24).
    if940e24  # This interface contains a data element for each signal of input frame RT_DL1MK3_Aux_14, 9702948 (0x940e24). The frame has 1 signals
      data AUX_14: type=cif_0x940e24_AUX_14_t  # Input signal AUX_14 of frame RT_DL1MK3_Aux_14, 9702948 (0x940e24).
    if940d24  # This interface contains a data element for each signal of input frame RT_DL1MK3_Aux_13, 9702692 (0x940d24). The frame has 1 signals
      data AUX_13: type=cif_0x940d24_AUX_13_t  # Input signal AUX_13 of frame RT_DL1MK3_Aux_13, 9702692 (0x940d24).
    if940c24  # This interface contains a data element for each signal of input frame RT_DL1MK3_Aux_12, 9702436 (0x940c24). The frame has 1 signals
      data AUX_12: type=cif_0x940c24_AUX_12_t  # Input signal AUX_12 of frame RT_DL1MK3_Aux_12, 9702436 (0x940c24).
    if940b24  # This interface contains a data element for each signal of input frame RT_DL1MK3_Aux_11, 9702180 (0x940b24). The frame has 1 signals
      data AUX_11: type=cif_0x940b24_AUX_11_t  # Input signal AUX_11 of frame RT_DL1MK3_Aux_11, 9702180 (0x940b24).
    if940924  # This interface contains a data element for each signal of input frame RT_DL1MK3_Aux_9, 9701668 (0x940924). The frame has 1 signals
      data AUX_9: type=cif_0x940924_AUX_9_t  # Input signal AUX_9 of frame RT_DL1MK3_Aux_9, 9701668 (0x940924).
    if940a24  # This interface contains a data element for each signal of input frame RT_DL1MK3_Aux_10, 9701924 (0x940a24). The frame has 1 signals
      data AUX_10: type=cif_0x940a24_AUX_10_t  # Input signal AUX_10 of frame RT_DL1MK3_Aux_10, 9701924 (0x940a24).
    if940824  # This interface contains a data element for each signal of input frame RT_DL1MK3_Aux_8, 9701412 (0x940824). The frame has 1 signals
      data AUX_8: type=cif_0x940824_AUX_8_t  # Input signal AUX_8 of frame RT_DL1MK3_Aux_8, 9701412 (0x940824).
    if940724  # This interface contains a data element for each signal of input frame RT_DL1MK3_Aux_7, 9701156 (0x940724). The frame has 1 signals
      data AUX_7: type=cif_0x940724_AUX_7_t  # Input signal AUX_7 of frame RT_DL1MK3_Aux_7, 9701156 (0x940724).
    if940624  # This interface contains a data element for each signal of input frame RT_DL1MK3_Aux_6, 9700900 (0x940624). The frame has 1 signals
      data AUX_6: type=cif_0x940624_AUX_6_t  # Input signal AUX_6 of frame RT_DL1MK3_Aux_6, 9700900 (0x940624).
    if940524  # This interface contains a data element for each signal of input frame RT_DL1MK3_Aux_5, 9700644 (0x940524). The frame has 1 signals
      data AUX_5: type=cif_0x940524_AUX_5_t  # Input signal AUX_5 of frame RT_DL1MK3_Aux_5, 9700644 (0x940524).
    if940424  # This interface contains a data element for each signal of input frame RT_DL1MK3_Aux_4, 9700388 (0x940424). The frame has 1 signals
      data AUX_4: type=cif_0x940424_AUX_4_t  # Input signal AUX_4 of frame RT_DL1MK3_Aux_4, 9700388 (0x940424).
    if940324  # This interface contains a data element for each signal of input frame RT_DL1MK3_Aux_3, 9700132 (0x940324). The frame has 1 signals
      data AUX_3: type=cif_0x940324_AUX_3_t  # Input signal AUX_3 of frame RT_DL1MK3_Aux_3, 9700132 (0x940324).
    if940224  # This interface contains a data element for each signal of input frame RT_DL1MK3_Aux_2, 9699876 (0x940224). The frame has 1 signals
      data AUX_2: type=cif_0x940224_AUX_2_t  # Input signal AUX_2 of frame RT_DL1MK3_Aux_2, 9699876 (0x940224).
    if940124  # This interface contains a data element for each signal of input frame RT_DL1MK3_Aux_1, 9699620 (0x940124). The frame has 1 signals
      data AUX_1: type=cif_0x940124_AUX_1_t  # Input signal AUX_1 of frame RT_DL1MK3_Aux_1, 9699620 (0x940124).
    if900524  # This interface contains a data element for each signal of input frame RT_DL1MK3_Pressure_5, 9438500 (0x900524). The frame has 1 signals
      data Pressure_5: type=cif_0x900524_Pressure_5_t  # Input signal Pressure_5 of frame RT_DL1MK3_Pressure_5, 9438500 (0x900524).
    if900424  # This interface contains a data element for each signal of input frame RT_DL1MK3_Pressure_4, 9438244 (0x900424). The frame has 1 signals
      data Pressure_4: type=cif_0x900424_Pressure_4_t  # Input signal Pressure_4 of frame RT_DL1MK3_Pressure_4, 9438244 (0x900424).
    if900324  # This interface contains a data element for each signal of input frame RT_DL1MK3_Pressure_3, 9437988 (0x900324). The frame has 1 signals
      data Pressure_3: type=cif_0x900324_Pressure_3_t  # Input signal Pressure_3 of frame RT_DL1MK3_Pressure_3, 9437988 (0x900324).
    if900224  # This interface contains a data element for each signal of input frame RT_DL1MK3_Pressure_2, 9437732 (0x900224). The frame has 1 signals
      data Pressure_2: type=cif_0x900224_Pressure_2_t  # Input signal Pressure_2 of frame RT_DL1MK3_Pressure_2, 9437732 (0x900224).
    if900124  # This interface contains a data element for each signal of input frame RT_DL1MK3_Pressure_1, 9437476 (0x900124). The frame has 1 signals
      data Pressure_1: type=cif_0x900124_Pressure_1_t  # Input signal Pressure_1 of frame RT_DL1MK3_Pressure_1, 9437476 (0x900124).
    if920324  # This interface contains a data element for each signal of input frame RT_DL1MK3_Angle_3, 9569060 (0x920324). The frame has 1 signals
      data Angle_3: type=cif_0x920324_Angle_3_t  # Input signal Angle_3 of frame RT_DL1MK3_Angle_3, 9569060 (0x920324).
    if920224  # This interface contains a data element for each signal of input frame RT_DL1MK3_Angle_2, 9568804 (0x920224). The frame has 1 signals
      data Angle_2: type=cif_0x920224_Angle_2_t  # Input signal Angle_2 of frame RT_DL1MK3_Angle_2, 9568804 (0x920224).
    if920124  # This interface contains a data element for each signal of input frame RT_DL1MK3_Angle_1, 9568548 (0x920124). The frame has 1 signals
      data Angle_1: type=cif_0x920124_Angle_1_t  # Input signal Angle_1 of frame RT_DL1MK3_Angle_1, 9568548 (0x920124).
    if911924  # This interface contains a data element for each signal of input frame RT_DL1MK3_Temp_25, 9509156 (0x911924). The frame has 1 signals
      data Temperature_25: type=cif_0x911924_Temperature_25_t  # Input signal Temperature_25 of frame RT_DL1MK3_Temp_25, 9509156 (0x911924).
    if911824  # This interface contains a data element for each signal of input frame RT_DL1MK3_Temp_24, 9508900 (0x911824). The frame has 1 signals
      data Temperature_24: type=cif_0x911824_Temperature_24_t  # Input signal Temperature_24 of frame RT_DL1MK3_Temp_24, 9508900 (0x911824).
    if911724  # This interface contains a data element for each signal of input frame RT_DL1MK3_Temp_23, 9508644 (0x911724). The frame has 1 signals
      data Temperature_23: type=cif_0x911724_Temperature_23_t  # Input signal Temperature_23 of frame RT_DL1MK3_Temp_23, 9508644 (0x911724).
    if911624  # This interface contains a data element for each signal of input frame RT_DL1MK3_Temp_22, 9508388 (0x911624). The frame has 1 signals
      data Temperature_22: type=cif_0x911624_Temperature_22_t  # Input signal Temperature_22 of frame RT_DL1MK3_Temp_22, 9508388 (0x911624).
    if911524  # This interface contains a data element for each signal of input frame RT_DL1MK3_Temp_21, 9508132 (0x911524). The frame has 1 signals
      data Temperature_21: type=cif_0x911524_Temperature_21_t  # Input signal Temperature_21 of frame RT_DL1MK3_Temp_21, 9508132 (0x911524).
    if911424  # This interface contains a data element for each signal of input frame RT_DL1MK3_Temp_20, 9507876 (0x911424). The frame has 1 signals
      data Temperature_20: type=cif_0x911424_Temperature_20_t  # Input signal Temperature_20 of frame RT_DL1MK3_Temp_20, 9507876 (0x911424).
    if911324  # This interface contains a data element for each signal of input frame RT_DL1MK3_Temp_19, 9507620 (0x911324). The frame has 1 signals
      data Temperature_19: type=cif_0x911324_Temperature_19_t  # Input signal Temperature_19 of frame RT_DL1MK3_Temp_19, 9507620 (0x911324).
    if911224  # This interface contains a data element for each signal of input frame RT_DL1MK3_Temp_18, 9507364 (0x911224). The frame has 1 signals
      data Temperature_18: type=cif_0x911224_Temperature_18_t  # Input signal Temperature_18 of frame RT_DL1MK3_Temp_18, 9507364 (0x911224).
    if911124  # This interface contains a data element for each signal of input frame RT_DL1MK3_Temp_17, 9507108 (0x911124). The frame has 1 signals
      data Temperature_17: type=cif_0x911124_Temperature_17_t  # Input signal Temperature_17 of frame RT_DL1MK3_Temp_17, 9507108 (0x911124).
    if911024  # This interface contains a data element for each signal of input frame RT_DL1MK3_Temp_16, 9506852 (0x911024). The frame has 1 signals
      data Temperature_16: type=cif_0x911024_Temperature_16_t  # Input signal Temperature_16 of frame RT_DL1MK3_Temp_16, 9506852 (0x911024).
    if910f24  # This interface contains a data element for each signal of input frame RT_DL1MK3_Temp_15, 9506596 (0x910f24). The frame has 1 signals
      data Temperature_15: type=cif_0x910f24_Temperature_15_t  # Input signal Temperature_15 of frame RT_DL1MK3_Temp_15, 9506596 (0x910f24).
    if910e24  # This interface contains a data element for each signal of input frame RT_DL1MK3_Temp_14, 9506340 (0x910e24). The frame has 1 signals
      data Temperature_14: type=cif_0x910e24_Temperature_14_t  # Input signal Temperature_14 of frame RT_DL1MK3_Temp_14, 9506340 (0x910e24).
    if910d24  # This interface contains a data element for each signal of input frame RT_DL1MK3_Temp_13, 9506084 (0x910d24). The frame has 1 signals
      data Temperature_13: type=cif_0x910d24_Temperature_13_t  # Input signal Temperature_13 of frame RT_DL1MK3_Temp_13, 9506084 (0x910d24).
    if910c24  # This interface contains a data element for each signal of input frame RT_DL1MK3_Temp_12, 9505828 (0x910c24). The frame has 1 signals
      data Temperature_12: type=cif_0x910c24_Temperature_12_t  # Input signal Temperature_12 of frame RT_DL1MK3_Temp_12, 9505828 (0x910c24).
    if910b24  # This interface contains a data element for each signal of input frame RT_DL1MK3_Temp_11, 9505572 (0x910b24). The frame has 1 signals
      data Temperature_11: type=cif_0x910b24_Temperature_11_t  # Input signal Temperature_11 of frame RT_DL1MK3_Temp_11, 9505572 (0x910b24).
    if910a24  # This interface contains a data element for each signal of input frame RT_DL1MK3_Temp_10, 9505316 (0x910a24). The frame has 1 signals
      data Temperature_10: type=cif_0x910a24_Temperature_10_t  # Input signal Temperature_10 of frame RT_DL1MK3_Temp_10, 9505316 (0x910a24).
    if910924  # This interface contains a data element for each signal of input frame RT_DL1MK3_Temp_9, 9505060 (0x910924). The frame has 1 signals
      data Temperature_9: type=cif_0x910924_Temperature_9_t  # Input signal Temperature_9 of frame RT_DL1MK3_Temp_9, 9505060 (0x910924).
    if910824  # This interface contains a data element for each signal of input frame RT_DL1MK3_Temp_8, 9504804 (0x910824). The frame has 1 signals
      data Temperature_8: type=cif_0x910824_Temperature_8_t  # Input signal Temperature_8 of frame RT_DL1MK3_Temp_8, 9504804 (0x910824).
    if910724  # This interface contains a data element for each signal of input frame RT_DL1MK3_Temp_7, 9504548 (0x910724). The frame has 1 signals
      data Temperature_7: type=cif_0x910724_Temperature_7_t  # Input signal Temperature_7 of frame RT_DL1MK3_Temp_7, 9504548 (0x910724).
    if910624  # This interface contains a data element for each signal of input frame RT_DL1MK3_Temp_6, 9504292 (0x910624). The frame has 1 signals
      data Temperature_6: type=cif_0x910624_Temperature_6_t  # Input signal Temperature_6 of frame RT_DL1MK3_Temp_6, 9504292 (0x910624).
    if910524  # This interface contains a data element for each signal of input frame RT_DL1MK3_Temp_5, 9504036 (0x910524). The frame has 1 signals
      data Temperature_5: type=cif_0x910524_Temperature_5_t  # Input signal Temperature_5 of frame RT_DL1MK3_Temp_5, 9504036 (0x910524).
    if910424  # This interface contains a data element for each signal of input frame RT_DL1MK3_Temp_4, 9503780 (0x910424). The frame has 1 signals
      data Temperature_4: type=cif_0x910424_Temperature_4_t  # Input signal Temperature_4 of frame RT_DL1MK3_Temp_4, 9503780 (0x910424).
    if910324  # This interface contains a data element for each signal of input frame RT_DL1MK3_Temp_3, 9503524 (0x910324). The frame has 1 signals
      data Temperature_3: type=cif_0x910324_Temperature_3_t  # Input signal Temperature_3 of frame RT_DL1MK3_Temp_3, 9503524 (0x910324).
    if910224  # This interface contains a data element for each signal of input frame RT_DL1MK3_Temp_2, 9503268 (0x910224). The frame has 1 signals
      data Temperature_2: type=cif_0x910224_Temperature_2_t  # Input signal Temperature_2 of frame RT_DL1MK3_Temp_2, 9503268 (0x910224).
    if910124  # This interface contains a data element for each signal of input frame RT_DL1MK3_Temp_1, 9503012 (0x910124). The frame has 1 signals
      data Temperature_1: type=cif_0x910124_Temperature_1_t  # Input signal Temperature_1 of frame RT_DL1MK3_Temp_1, 9503012 (0x910124).
    if821f24  # This interface contains a data element for each signal of input frame RT_DL1MK3_Analog_32, 8527652 (0x821f24). The frame has 1 signals
      data Analog_32: type=cif_0x821f24_Analog_32_t  # Input signal Analog_32 of frame RT_DL1MK3_Analog_32, 8527652 (0x821f24).
    if821e24  # This interface contains a data element for each signal of input frame RT_DL1MK3_Analog_31, 8527396 (0x821e24). The frame has 1 signals
      data Analog_31: type=cif_0x821e24_Analog_31_t  # Input signal Analog_31 of frame RT_DL1MK3_Analog_31, 8527396 (0x821e24).
    if821d24  # This interface contains a data element for each signal of input frame RT_DL1MK3_Analog_30, 8527140 (0x821d24). The frame has 1 signals
      data Analog_30: type=cif_0x821d24_Analog_30_t  # Input signal Analog_30 of frame RT_DL1MK3_Analog_30, 8527140 (0x821d24).
    if821c24  # This interface contains a data element for each signal of input frame RT_DL1MK3_Analog_29, 8526884 (0x821c24). The frame has 1 signals
      data Analog_29: type=cif_0x821c24_Analog_29_t  # Input signal Analog_29 of frame RT_DL1MK3_Analog_29, 8526884 (0x821c24).
    if821b24  # This interface contains a data element for each signal of input frame RT_DL1MK3_Analog_28, 8526628 (0x821b24). The frame has 1 signals
      data Analog_28: type=cif_0x821b24_Analog_28_t  # Input signal Analog_28 of frame RT_DL1MK3_Analog_28, 8526628 (0x821b24).
    if821a24  # This interface contains a data element for each signal of input frame RT_DL1MK3_Analog_27, 8526372 (0x821a24). The frame has 1 signals
      data Analog_27: type=cif_0x821a24_Analog_27_t  # Input signal Analog_27 of frame RT_DL1MK3_Analog_27, 8526372 (0x821a24).
    if821924  # This interface contains a data element for each signal of input frame RT_DL1MK3_Analog_26, 8526116 (0x821924). The frame has 1 signals
      data Analog_26: type=cif_0x821924_Analog_26_t  # Input signal Analog_26 of frame RT_DL1MK3_Analog_26, 8526116 (0x821924).
    if821824  # This interface contains a data element for each signal of input frame RT_DL1MK3_Analog_25, 8525860 (0x821824). The frame has 1 signals
      data Analog_25: type=cif_0x821824_Analog_25_t  # Input signal Analog_25 of frame RT_DL1MK3_Analog_25, 8525860 (0x821824).
    if820e24  # This interface contains a data element for each signal of input frame RT_DL1MK3_Analog_15, 8523300 (0x820e24). The frame has 1 signals
      data Analog_15: type=cif_0x820e24_Analog_15_t  # Input signal Analog_15 of frame RT_DL1MK3_Analog_15, 8523300 (0x820e24).
    if820d24  # This interface contains a data element for each signal of input frame RT_DL1MK3_Analog_14, 8523044 (0x820d24). The frame has 1 signals
      data Analog_14: type=cif_0x820d24_Analog_14_t  # Input signal Analog_14 of frame RT_DL1MK3_Analog_14, 8523044 (0x820d24).
    if821024  # This interface contains a data element for each signal of input frame RT_DL1MK3_Analog_17, 8523812 (0x821024). The frame has 1 signals
      data Analog_17: type=cif_0x821024_Analog_17_t  # Input signal Analog_17 of frame RT_DL1MK3_Analog_17, 8523812 (0x821024).
    if821724  # This interface contains a data element for each signal of input frame RT_DL1MK3_Analog_24, 8525604 (0x821724). The frame has 1 signals
      data Analog_24: type=cif_0x821724_Analog_24_t  # Input signal Analog_24 of frame RT_DL1MK3_Analog_24, 8525604 (0x821724).
    if821624  # This interface contains a data element for each signal of input frame RT_DL1MK3_Analog_23, 8525348 (0x821624). The frame has 1 signals
      data Analog_23: type=cif_0x821624_Analog_23_t  # Input signal Analog_23 of frame RT_DL1MK3_Analog_23, 8525348 (0x821624).
    if821524  # This interface contains a data element for each signal of input frame RT_DL1MK3_Analog_22, 8525092 (0x821524). The frame has 1 signals
      data Analog_22: type=cif_0x821524_Analog_22_t  # Input signal Analog_22 of frame RT_DL1MK3_Analog_22, 8525092 (0x821524).
    if821424  # This interface contains a data element for each signal of input frame RT_DL1MK3_Analog_21, 8524836 (0x821424). The frame has 1 signals
      data Analog_21: type=cif_0x821424_Analog_21_t  # Input signal Analog_21 of frame RT_DL1MK3_Analog_21, 8524836 (0x821424).
    if821324  # This interface contains a data element for each signal of input frame RT_DL1MK3_Analog_20, 8524580 (0x821324). The frame has 1 signals
      data Analog_20: type=cif_0x821324_Analog_20_t  # Input signal Analog_20 of frame RT_DL1MK3_Analog_20, 8524580 (0x821324).
    if821224  # This interface contains a data element for each signal of input frame RT_DL1MK3_Analog_19, 8524324 (0x821224). The frame has 1 signals
      data Analog_19: type=cif_0x821224_Analog_19_t  # Input signal Analog_19 of frame RT_DL1MK3_Analog_19, 8524324 (0x821224).
    if820f24  # This interface contains a data element for each signal of input frame RT_DL1MK3_Analog_16, 8523556 (0x820f24). The frame has 1 signals
      data Analog_16: type=cif_0x820f24_Analog_16_t  # Input signal Analog_16 of frame RT_DL1MK3_Analog_16, 8523556 (0x820f24).
    if821124  # This interface contains a data element for each signal of input frame RT_DL1MK3_Analog_18, 8524068 (0x821124). The frame has 1 signals
      data Analog_18: type=cif_0x821124_Analog_18_t  # Input signal Analog_18 of frame RT_DL1MK3_Analog_18, 8524068 (0x821124).
    if820b24  # This interface contains a data element for each signal of input frame RT_DL1MK3_Analog_12, 8522532 (0x820b24). The frame has 1 signals
      data Analog_12: type=cif_0x820b24_Analog_12_t  # Input signal Analog_12 of frame RT_DL1MK3_Analog_12, 8522532 (0x820b24).
    if820a24  # This interface contains a data element for each signal of input frame RT_DL1MK3_Analog_11, 8522276 (0x820a24). The frame has 1 signals
      data Analog_11: type=cif_0x820a24_Analog_11_t  # Input signal Analog_11 of frame RT_DL1MK3_Analog_11, 8522276 (0x820a24).
    if820924  # This interface contains a data element for each signal of input frame RT_DL1MK3_Analog_10, 8522020 (0x820924). The frame has 1 signals
      data Analog_10: type=cif_0x820924_Analog_10_t  # Input signal Analog_10 of frame RT_DL1MK3_Analog_10, 8522020 (0x820924).
    if820824  # This interface contains a data element for each signal of input frame RT_DL1MK3_Analog_9, 8521764 (0x820824). The frame has 1 signals
      data Analog_9: type=cif_0x820824_Analog_9_t  # Input signal Analog_9 of frame RT_DL1MK3_Analog_9, 8521764 (0x820824).
    if820724  # This interface contains a data element for each signal of input frame RT_DL1MK3_Analog_8, 8521508 (0x820724). The frame has 1 signals
      data Analog_8: type=cif_0x820724_Analog_8_t  # Input signal Analog_8 of frame RT_DL1MK3_Analog_8, 8521508 (0x820724).
    if820624  # This interface contains a data element for each signal of input frame RT_DL1MK3_Analog_7, 8521252 (0x820624). The frame has 1 signals
      data Analog_7: type=cif_0x820624_Analog_7_t  # Input signal Analog_7 of frame RT_DL1MK3_Analog_7, 8521252 (0x820624).
    if820524  # This interface contains a data element for each signal of input frame RT_DL1MK3_Analog_6, 8520996 (0x820524). The frame has 1 signals
      data Analog_6: type=cif_0x820524_Analog_6_t  # Input signal Analog_6 of frame RT_DL1MK3_Analog_6, 8520996 (0x820524).
    if820424  # This interface contains a data element for each signal of input frame RT_DL1MK3_Analog_5, 8520740 (0x820424). The frame has 1 signals
      data Analog_5: type=cif_0x820424_Analog_5_t  # Input signal Analog_5 of frame RT_DL1MK3_Analog_5, 8520740 (0x820424).
    if820324  # This interface contains a data element for each signal of input frame RT_DL1MK3_Analog_4, 8520484 (0x820324). The frame has 1 signals
      data Analog_4: type=cif_0x820324_Analog_4_t  # Input signal Analog_4 of frame RT_DL1MK3_Analog_4, 8520484 (0x820324).
    if820224  # This interface contains a data element for each signal of input frame RT_DL1MK3_Analog_3, 8520228 (0x820224). The frame has 1 signals
      data Analog_3: type=cif_0x820224_Analog_3_t  # Input signal Analog_3 of frame RT_DL1MK3_Analog_3, 8520228 (0x820224).
    if820124  # This interface contains a data element for each signal of input frame RT_DL1MK3_Analog_2, 8519972 (0x820124). The frame has 1 signals
      data Analog_2: type=cif_0x820124_Analog_2_t  # Input signal Analog_2 of frame RT_DL1MK3_Analog_2, 8519972 (0x820124).
    if820024  # This interface contains a data element for each signal of input frame RT_DL1MK3_Analog_1, 8519716 (0x820024). The frame has 1 signals
      data Analog_1: type=cif_0x820024_Analog_1_t  # Input signal Analog_1 of frame RT_DL1MK3_Analog_1, 8519716 (0x820024).
    if800024  # This interface contains a data element for each signal of input frame RT_DL1MK3_Accel, 8388644 (0x800024). The frame has 8 signals
      8 x data:
        Validity_Accel_Longitudinal: type=cif_0x800024_Validity_Accel_Longitudinal_t  # Input signal Validity_Accel_Longitudinal of frame RT_DL1MK3_Accel, 8388644 (0x800024). Valid when bit is set, invalid when bit is clear.
        Validity_Accel_Lateral: type=cif_0x800024_Validity_Accel_Lateral_t  # Input signal Validity_Accel_Lateral of frame RT_DL1MK3_Accel, 8388644 (0x800024). Valid when bit is set, invalid when bit is clear.
        Validity_Accel_Vertical: type=cif_0x800024_Validity_Accel_Vertical_t  # Input signal Validity_Accel_Vertical of frame RT_DL1MK3_Accel, 8388644 (0x800024). Valid when bit is set, invalid when bit is clear.
        SQC: type=cif_0x800024_SQC_t  # Input signal SQC of frame RT_DL1MK3_Accel, 8388644 (0x800024). Sequence counter
        Accuracy_Accel: type=cif_0x800024_Accuracy_Accel_t  # Input signal Accuracy_Accel of frame RT_DL1MK3_Accel, 8388644 (0x800024). Dimensionless. Lower values imply but do not guarantee better accuracy than higher values.
        Accel_Longitudinal: type=cif_0x800024_Accel_Longitudinal_t  # Input signal Accel_Longitudinal of frame RT_DL1MK3_Accel, 8388644 (0x800024). Longitudinal acceleration. This is positive when the vehicle accelerates in a forwards direction.
        Accel_Lateral: type=cif_0x800024_Accel_Lateral_t  # Input signal Accel_Lateral of frame RT_DL1MK3_Accel, 8388644 (0x800024). Lateral acceleration. This is positive when the vehicle accelerates towards the right, e.g. when cornering around a right-hand bend.
        Accel_Vertical: type=cif_0x800024_Accel_Vertical_t  # Input signal Accel_Vertical of frame RT_DL1MK3_Accel, 8388644 (0x800024). Vertical acceleration. This is positive when the vehicle accelerates in an upwards direction, e.g. when travelling through a dip.
    if8f3222  # This interface contains a data element for each signal of input frame RT_SB_INS_Vpt_4_Vel_NED_2, 9384482 (0x8f3222). The frame has 3 signals
      data Virtual_4_Vel_NED_D: type=cif_0x8f3222_Virtual_4_Vel_NED_D_t  # Input signal Virtual_4_Vel_NED_D of frame RT_SB_INS_Vpt_4_Vel_NED_2, 9384482 (0x8f3222). VELNED D velocity. This is the velocity vector directly downwards towards the Earth centre at the current local Earth surface position.
      data Virtual_4_Heading: type=cif_0x8f3222_Virtual_4_Heading_t  # Input signal Virtual_4_Heading of frame RT_SB_INS_Vpt_4_Vel_NED_2, 9384482 (0x8f3222). This is GPS heading, the direction that the vehicle is travelling in the local horizontal plane.
      data Virtual_4_Slip: type=cif_0x8f3222_Virtual_4_Slip_t  # Input signal Virtual_4_Slip of frame RT_SB_INS_Vpt_4_Vel_NED_2, 9384482 (0x8f3222). Slip is defined as the difference between yaw and heading.
    if8f3122  # This interface contains a data element for each signal of input frame RT_SB_INS_Vpt_4_Vel_NED_1, 9384226 (0x8f3122). The frame has 2 signals
      data Virtual_4_Vel_NED_N: type=cif_0x8f3122_Virtual_4_Vel_NED_N_t  # Input signal Virtual_4_Vel_NED_N of frame RT_SB_INS_Vpt_4_Vel_NED_1, 9384226 (0x8f3122). VELNED N velocity. This is the velocity vector directly North at the current local Earth surface position.
      data Virtual_4_Vel_NED_E: type=cif_0x8f3122_Virtual_4_Vel_NED_E_t  # Input signal Virtual_4_Vel_NED_E of frame RT_SB_INS_Vpt_4_Vel_NED_1, 9384226 (0x8f3122). VELNED E velocity. This is the velocity vector directly East at the current local Earth surface position.
    if8f3022  # This interface contains a data element for each signal of input frame RT_SB_INS_Vpt_4_Offset, 9383970 (0x8f3022). The frame has 3 signals
      data Virtual_4_Offset_X: type=cif_0x8f3022_Virtual_4_Offset_X_t  # Input signal Virtual_4_Offset_X of frame RT_SB_INS_Vpt_4_Offset, 9383970 (0x8f3022). X offset of the virtual point in the vehicle body frame.
      data Virtual_4_Offset_Y: type=cif_0x8f3022_Virtual_4_Offset_Y_t  # Input signal Virtual_4_Offset_Y of frame RT_SB_INS_Vpt_4_Offset, 9383970 (0x8f3022). Y offset of the virtual point in the vehicle body frame.
      data Virtual_4_Offset_Z: type=cif_0x8f3022_Virtual_4_Offset_Z_t  # Input signal Virtual_4_Offset_Z of frame RT_SB_INS_Vpt_4_Offset, 9383970 (0x8f3022). Z offset (+ve downwards) of the virtual point in the vehicle body frame.
    if8f2222  # This interface contains a data element for each signal of input frame RT_SB_INS_Vpt_3_Vel_NED_2, 9380386 (0x8f2222). The frame has 3 signals
      data Virtual_3_Vel_NED_D: type=cif_0x8f2222_Virtual_3_Vel_NED_D_t  # Input signal Virtual_3_Vel_NED_D of frame RT_SB_INS_Vpt_3_Vel_NED_2, 9380386 (0x8f2222). VELNED D velocity. This is the velocity vector directly downwards towards the Earth centre at the current local Earth surface position.
      data Virtual_3_Heading: type=cif_0x8f2222_Virtual_3_Heading_t  # Input signal Virtual_3_Heading of frame RT_SB_INS_Vpt_3_Vel_NED_2, 9380386 (0x8f2222). This is GPS heading, the direction that the vehicle is travelling in the local horizontal plane.
      data Virtual_3_Slip: type=cif_0x8f2222_Virtual_3_Slip_t  # Input signal Virtual_3_Slip of frame RT_SB_INS_Vpt_3_Vel_NED_2, 9380386 (0x8f2222). Slip is defined as the difference between yaw and heading.
    if8f2122  # This interface contains a data element for each signal of input frame RT_SB_INS_Vpt_3_Vel_NED_1, 9380130 (0x8f2122). The frame has 2 signals
      data Virtual_3_Vel_NED_N: type=cif_0x8f2122_Virtual_3_Vel_NED_N_t  # Input signal Virtual_3_Vel_NED_N of frame RT_SB_INS_Vpt_3_Vel_NED_1, 9380130 (0x8f2122). VELNED N velocity. This is the velocity vector directly North at the current local Earth surface position.
      data Virtual_3_Vel_NED_E: type=cif_0x8f2122_Virtual_3_Vel_NED_E_t  # Input signal Virtual_3_Vel_NED_E of frame RT_SB_INS_Vpt_3_Vel_NED_1, 9380130 (0x8f2122). VELNED E velocity. This is the velocity vector directly East at the current local Earth surface position.
    if8f2022  # This interface contains a data element for each signal of input frame RT_SB_INS_Vpt_3_Offset, 9379874 (0x8f2022). The frame has 3 signals
      data Virtual_3_Offset_X: type=cif_0x8f2022_Virtual_3_Offset_X_t  # Input signal Virtual_3_Offset_X of frame RT_SB_INS_Vpt_3_Offset, 9379874 (0x8f2022). X offset of the virtual point in the vehicle body frame.
      data Virtual_3_Offset_Y: type=cif_0x8f2022_Virtual_3_Offset_Y_t  # Input signal Virtual_3_Offset_Y of frame RT_SB_INS_Vpt_3_Offset, 9379874 (0x8f2022). Y offset of the virtual point in the vehicle body frame.
      data Virtual_3_Offset_Z: type=cif_0x8f2022_Virtual_3_Offset_Z_t  # Input signal Virtual_3_Offset_Z of frame RT_SB_INS_Vpt_3_Offset, 9379874 (0x8f2022). Z offset (+ve downwards) of the virtual point in the vehicle body frame.
    if8f1222  # This interface contains a data element for each signal of input frame RT_SB_INS_Vpt_2_Vel_NED_2, 9376290 (0x8f1222). The frame has 3 signals
      data Virtual_2_Vel_NED_D: type=cif_0x8f1222_Virtual_2_Vel_NED_D_t  # Input signal Virtual_2_Vel_NED_D of frame RT_SB_INS_Vpt_2_Vel_NED_2, 9376290 (0x8f1222). VELNED D velocity. This is the velocity vector directly downwards towards the Earth centre at the current local Earth surface position.
      data Virtual_2_Heading: type=cif_0x8f1222_Virtual_2_Heading_t  # Input signal Virtual_2_Heading of frame RT_SB_INS_Vpt_2_Vel_NED_2, 9376290 (0x8f1222). This is GPS heading, the direction that the vehicle is travelling in the local horizontal plane.
      data Virtual_2_Slip: type=cif_0x8f1222_Virtual_2_Slip_t  # Input signal Virtual_2_Slip of frame RT_SB_INS_Vpt_2_Vel_NED_2, 9376290 (0x8f1222). Slip is defined as the difference between yaw and heading.
    if8f1122  # This interface contains a data element for each signal of input frame RT_SB_INS_Vpt_2_Vel_NED_1, 9376034 (0x8f1122). The frame has 2 signals
      data Virtual_2_Vel_NED_N: type=cif_0x8f1122_Virtual_2_Vel_NED_N_t  # Input signal Virtual_2_Vel_NED_N of frame RT_SB_INS_Vpt_2_Vel_NED_1, 9376034 (0x8f1122). VELNED N velocity. This is the velocity vector directly North at the current local Earth surface position.
      data Virtual_2_Vel_NED_E: type=cif_0x8f1122_Virtual_2_Vel_NED_E_t  # Input signal Virtual_2_Vel_NED_E of frame RT_SB_INS_Vpt_2_Vel_NED_1, 9376034 (0x8f1122). VELNED E velocity. This is the velocity vector directly East at the current local Earth surface position.
    if8f1022  # This interface contains a data element for each signal of input frame RT_SB_INS_Vpt_2_Offset, 9375778 (0x8f1022). The frame has 3 signals
      data Virtual_2_Offset_X: type=cif_0x8f1022_Virtual_2_Offset_X_t  # Input signal Virtual_2_Offset_X of frame RT_SB_INS_Vpt_2_Offset, 9375778 (0x8f1022). X offset of the virtual point in the vehicle body frame.
      data Virtual_2_Offset_Y: type=cif_0x8f1022_Virtual_2_Offset_Y_t  # Input signal Virtual_2_Offset_Y of frame RT_SB_INS_Vpt_2_Offset, 9375778 (0x8f1022). Y offset of the virtual point in the vehicle body frame.
      data Virtual_2_Offset_Z: type=cif_0x8f1022_Virtual_2_Offset_Z_t  # Input signal Virtual_2_Offset_Z of frame RT_SB_INS_Vpt_2_Offset, 9375778 (0x8f1022). Z offset (+ve downwards) of the virtual point in the vehicle body frame.
    if8f0222  # This interface contains a data element for each signal of input frame RT_SB_INS_Vpt_1_Vel_NED_2, 9372194 (0x8f0222). The frame has 3 signals
      data Virtual_1_Vel_NED_D: type=cif_0x8f0222_Virtual_1_Vel_NED_D_t  # Input signal Virtual_1_Vel_NED_D of frame RT_SB_INS_Vpt_1_Vel_NED_2, 9372194 (0x8f0222). VELNED D velocity. This is the velocity vector directly downwards towards the Earth centre at the current local Earth surface position.
      data Virtual_1_Heading: type=cif_0x8f0222_Virtual_1_Heading_t  # Input signal Virtual_1_Heading of frame RT_SB_INS_Vpt_1_Vel_NED_2, 9372194 (0x8f0222). This is GPS heading, the direction that the vehicle is travelling in the local horizontal plane.
      data Virtual_1_Slip: type=cif_0x8f0222_Virtual_1_Slip_t  # Input signal Virtual_1_Slip of frame RT_SB_INS_Vpt_1_Vel_NED_2, 9372194 (0x8f0222). Slip is defined as the difference between yaw and heading.
    if8f0122  # This interface contains a data element for each signal of input frame RT_SB_INS_Vpt_1_Vel_NED_1, 9371938 (0x8f0122). The frame has 2 signals
      data Virtual_1_Vel_NED_N: type=cif_0x8f0122_Virtual_1_Vel_NED_N_t  # Input signal Virtual_1_Vel_NED_N of frame RT_SB_INS_Vpt_1_Vel_NED_1, 9371938 (0x8f0122). VELNED N velocity. This is the velocity vector directly North at the current local Earth surface position.
      data Virtual_1_Vel_NED_E: type=cif_0x8f0122_Virtual_1_Vel_NED_E_t  # Input signal Virtual_1_Vel_NED_E of frame RT_SB_INS_Vpt_1_Vel_NED_1, 9371938 (0x8f0122). VELNED E velocity. This is the velocity vector directly East at the current local Earth surface position.
    if8f0022  # This interface contains a data element for each signal of input frame RT_SB_INS_Vpt_1_Offset, 9371682 (0x8f0022). The frame has 3 signals
      data Virtual_1_Offset_X: type=cif_0x8f0022_Virtual_1_Offset_X_t  # Input signal Virtual_1_Offset_X of frame RT_SB_INS_Vpt_1_Offset, 9371682 (0x8f0022). X offset of the virtual point in the vehicle body frame.
      data Virtual_1_Offset_Y: type=cif_0x8f0022_Virtual_1_Offset_Y_t  # Input signal Virtual_1_Offset_Y of frame RT_SB_INS_Vpt_1_Offset, 9371682 (0x8f0022). Y offset of the virtual point in the vehicle body frame.
      data Virtual_1_Offset_Z: type=cif_0x8f0022_Virtual_1_Offset_Z_t  # Input signal Virtual_1_Offset_Z of frame RT_SB_INS_Vpt_1_Offset, 9371682 (0x8f0022). Z offset (+ve downwards) of the virtual point in the vehicle body frame.
    if8e1622  # This interface contains a data element for each signal of input frame RT_SB_INS_Slip, 9311778 (0x8e1622). The frame has 6 signals
      6 x data:
        Validity_INS_Slip: type=cif_0x8e1622_Validity_INS_Slip_t  # Input signal Validity_INS_Slip of frame RT_SB_INS_Slip, 9311778 (0x8e1622).
        Validity_INS_Squat: type=cif_0x8e1622_Validity_INS_Squat_t  # Input signal Validity_INS_Squat of frame RT_SB_INS_Slip, 9311778 (0x8e1622).
        Accuracy_INS_Slip: type=cif_0x8e1622_Accuracy_INS_Slip_t  # Input signal Accuracy_INS_Slip of frame RT_SB_INS_Slip, 9311778 (0x8e1622). Dimensionless. Lower values imply but do not guarantee better accuracy than higher values.
        INS_Slip: type=cif_0x8e1622_INS_Slip_t  # Input signal INS_Slip of frame RT_SB_INS_Slip, 9311778 (0x8e1622). Slip is defined as the difference between yaw and heading
        Accuracy_INS_Squat: type=cif_0x8e1622_Accuracy_INS_Squat_t  # Input signal Accuracy_INS_Squat of frame RT_SB_INS_Slip, 9311778 (0x8e1622). Dimensionless. Lower values imply but do not guarantee better accuracy than higher values.
        INS_Squat: type=cif_0x8e1622_INS_Squat_t  # Input signal INS_Squat of frame RT_SB_INS_Slip, 9311778 (0x8e1622). Squat is defined as the difference between pitch and gradient
    if8e1322  # This interface contains a data element for each signal of input frame RT_SB_INS_Vel_ECEF_2, 9311010 (0x8e1322). The frame has 4 signals
      4 x data:
        Validity_INS_Vel_ECEF_Y: type=cif_0x8e1322_Validity_INS_Vel_ECEF_Y_t  # Input signal Validity_INS_Vel_ECEF_Y of frame RT_SB_INS_Vel_ECEF_2, 9311010 (0x8e1322). Valid when bit is set, invalid when bit is clear.
        Validity_INS_Vel_ECEF_Z: type=cif_0x8e1322_Validity_INS_Vel_ECEF_Z_t  # Input signal Validity_INS_Vel_ECEF_Z of frame RT_SB_INS_Vel_ECEF_2, 9311010 (0x8e1322). Valid when bit is set, invalid when bit is clear.
        INS_Vel_ECEF_Y: type=cif_0x8e1322_INS_Vel_ECEF_Y_t  # Input signal INS_Vel_ECEF_Y of frame RT_SB_INS_Vel_ECEF_2, 9311010 (0x8e1322). ECEF Y velocity. The ECEF Y axis originates from the Earth centre, and the positive Y axis intersects the Earth surface at zero degrees latittude and 90 degrees longitude.
        INS_Vel_ECEF_Z: type=cif_0x8e1322_INS_Vel_ECEF_Z_t  # Input signal INS_Vel_ECEF_Z of frame RT_SB_INS_Vel_ECEF_2, 9311010 (0x8e1322). ECEF Z velocity. The ECEF Z axis originates from the Earth centre, and the positive Z axis intersects the Earth surface at the North Pole.
    if8e1222  # This interface contains a data element for each signal of input frame RT_SB_INS_Vel_ECEF_1, 9310754 (0x8e1222). The frame has 5 signals
      5 x data:
        Validity_INS_Vel_ECEF_X: type=cif_0x8e1222_Validity_INS_Vel_ECEF_X_t  # Input signal Validity_INS_Vel_ECEF_X of frame RT_SB_INS_Vel_ECEF_1, 9310754 (0x8e1222). Valid when bit is set, invalid when bit is clear.
        Accuracy_INS_Vel_ECEF_X: type=cif_0x8e1222_Accuracy_INS_Vel_ECEF_X_t  # Input signal Accuracy_INS_Vel_ECEF_X of frame RT_SB_INS_Vel_ECEF_1, 9310754 (0x8e1222).
        Accuracy_INS_Vel_ECEF_Y: type=cif_0x8e1222_Accuracy_INS_Vel_ECEF_Y_t  # Input signal Accuracy_INS_Vel_ECEF_Y of frame RT_SB_INS_Vel_ECEF_1, 9310754 (0x8e1222).
        Accuracy_INS_Vel_ECEF_Z: type=cif_0x8e1222_Accuracy_INS_Vel_ECEF_Z_t  # Input signal Accuracy_INS_Vel_ECEF_Z of frame RT_SB_INS_Vel_ECEF_1, 9310754 (0x8e1222).
        INS_Vel_ECEF_X: type=cif_0x8e1222_INS_Vel_ECEF_X_t  # Input signal INS_Vel_ECEF_X of frame RT_SB_INS_Vel_ECEF_1, 9310754 (0x8e1222). ECEF X velocity. The ECEF X axis originates from the Earth centre, and the positive X axis intersects the Earth surface at zero degrees latittude and zero degrees longitude (the intersection of the equator and the prime meridian).
    if8e1122  # This interface contains a data element for each signal of input frame RT_SB_INS_Vel_NED_2, 9310498 (0x8e1122). The frame has 3 signals
      data Validity_INS_Vel_NED_D: type=cif_0x8e1122_Validity_INS_Vel_NED_D_t  # Input signal Validity_INS_Vel_NED_D of frame RT_SB_INS_Vel_NED_2, 9310498 (0x8e1122). Valid when bit is set, invalid when bit is clear.
      data Accuracy_INS_Vel_D: type=cif_0x8e1122_Accuracy_INS_Vel_D_t  # Input signal Accuracy_INS_Vel_D of frame RT_SB_INS_Vel_NED_2, 9310498 (0x8e1122).
      data INS_Vel_NED_D: type=cif_0x8e1122_INS_Vel_NED_D_t  # Input signal INS_Vel_NED_D of frame RT_SB_INS_Vel_NED_2, 9310498 (0x8e1122). VELNED D velocity. This is the velocity vector directly downwards towards the Earth centre at the current local Earth surface position.
    if8e1022  # This interface contains a data element for each signal of input frame RT_SB_INS_Vel_NED_1, 9310242 (0x8e1022). The frame has 5 signals
      5 x data:
        Validity_INS_Vel_NED_N: type=cif_0x8e1022_Validity_INS_Vel_NED_N_t  # Input signal Validity_INS_Vel_NED_N of frame RT_SB_INS_Vel_NED_1, 9310242 (0x8e1022). Valid when bit is set, invalid when bit is clear.
        Validity_INS_Vel_NED_E: type=cif_0x8e1022_Validity_INS_Vel_NED_E_t  # Input signal Validity_INS_Vel_NED_E of frame RT_SB_INS_Vel_NED_1, 9310242 (0x8e1022). Valid when bit is set, invalid when bit is clear.
        Accuracy_INS_Vel_NE: type=cif_0x8e1022_Accuracy_INS_Vel_NE_t  # Input signal Accuracy_INS_Vel_NE of frame RT_SB_INS_Vel_NED_1, 9310242 (0x8e1022).
        INS_Vel_NED_N: type=cif_0x8e1022_INS_Vel_NED_N_t  # Input signal INS_Vel_NED_N of frame RT_SB_INS_Vel_NED_1, 9310242 (0x8e1022). VELNED N velocity. This is the velocity vector directly North at the current local Earth surface position.
        INS_Vel_NED_E: type=cif_0x8e1022_INS_Vel_NED_E_t  # Input signal INS_Vel_NED_E of frame RT_SB_INS_Vel_NED_1, 9310242 (0x8e1022). VELNED E velocity. This is the velocity vector directly East at the current local Earth surface position.
    if8e0522  # This interface contains a data element for each signal of input frame RT_SB_INS_Pos_ECEF_2, 9307426 (0x8e0522). The frame has 2 signals
      data INS_Pos_ECEF_Y: type=cif_0x8e0522_INS_Pos_ECEF_Y_t  # Input signal INS_Pos_ECEF_Y of frame RT_SB_INS_Pos_ECEF_2, 9307426 (0x8e0522). ECEF Y position. The ECEF Y axis originates from the Earth centre, and the positive Y axis intersects the Earth surface at zero degrees latittude and 90 degrees longitude.
      data INS_Pos_ECEF_Z: type=cif_0x8e0522_INS_Pos_ECEF_Z_t  # Input signal INS_Pos_ECEF_Z of frame RT_SB_INS_Pos_ECEF_2, 9307426 (0x8e0522). ECEF Z position. The ECEF Z axis originates from the Earth centre, and the positive Z axis intersects the Earth surface at the North Pole.
    if8e0422  # This interface contains a data element for each signal of input frame RT_SB_INS_Pos_ECEF_1, 9307170 (0x8e0422). The frame has 7 signals
      7 x data:
        Validity_INS_Pos_ECEF_X: type=cif_0x8e0422_Validity_INS_Pos_ECEF_X_t  # Input signal Validity_INS_Pos_ECEF_X of frame RT_SB_INS_Pos_ECEF_1, 9307170 (0x8e0422). Valid when bit is set, invalid when bit is clear.
        Validity_INS_Pos_ECEF_Y: type=cif_0x8e0422_Validity_INS_Pos_ECEF_Y_t  # Input signal Validity_INS_Pos_ECEF_Y of frame RT_SB_INS_Pos_ECEF_1, 9307170 (0x8e0422). Valid when bit is set, invalid when bit is clear.
        Validity_INS_Pos_ECEF_Z: type=cif_0x8e0422_Validity_INS_Pos_ECEF_Z_t  # Input signal Validity_INS_Pos_ECEF_Z of frame RT_SB_INS_Pos_ECEF_1, 9307170 (0x8e0422). Valid when bit is set, invalid when bit is clear.
        Accuracy_INS_Pos_ECEF_X: type=cif_0x8e0422_Accuracy_INS_Pos_ECEF_X_t  # Input signal Accuracy_INS_Pos_ECEF_X of frame RT_SB_INS_Pos_ECEF_1, 9307170 (0x8e0422). Dimensionless. Lower values imply but do not guarantee better accuracy than higher values.
        Accuracy_INS_Pos_ECEF_Y: type=cif_0x8e0422_Accuracy_INS_Pos_ECEF_Y_t  # Input signal Accuracy_INS_Pos_ECEF_Y of frame RT_SB_INS_Pos_ECEF_1, 9307170 (0x8e0422). Dimensionless. Lower values imply but do not guarantee better accuracy than higher values.
        Accuracy_INS_Pos_ECEF_Z: type=cif_0x8e0422_Accuracy_INS_Pos_ECEF_Z_t  # Input signal Accuracy_INS_Pos_ECEF_Z of frame RT_SB_INS_Pos_ECEF_1, 9307170 (0x8e0422). Dimensionless. Lower values imply but do not guarantee better accuracy than higher values.
        INS_Pos_ECEF_X: type=cif_0x8e0422_INS_Pos_ECEF_X_t  # Input signal INS_Pos_ECEF_X of frame RT_SB_INS_Pos_ECEF_1, 9307170 (0x8e0422). ECEF X position. The ECEF X axis originates from the Earth centre, and the positive X axis intersects the Earth surface at zero degrees latittude and zero degrees longitude (the intersection of the equator and the prime meridian).
    if8e0322  # This interface contains a data element for each signal of input frame RT_SB_INS_Pos_LLH_2, 9306914 (0x8e0322). The frame has 2 signals
      data INS_Pos_LLH_Longitude: type=cif_0x8e0322_INS_Pos_LLH_Longitude_t  # Input signal INS_Pos_LLH_Longitude of frame RT_SB_INS_Pos_LLH_2, 9306914 (0x8e0322).
      data INS_Pos_LLH_Altitude: type=cif_0x8e0322_INS_Pos_LLH_Altitude_t  # Input signal INS_Pos_LLH_Altitude of frame RT_SB_INS_Pos_LLH_2, 9306914 (0x8e0322).
    if8e0222  # This interface contains a data element for each signal of input frame RT_SB_INS_Pos_LLH_1, 9306658 (0x8e0222). The frame has 7 signals
      7 x data:
        Validity_INS_Pos_LLH_Latitude: type=cif_0x8e0222_Validity_INS_Pos_LLH_Latitude_t  # Input signal Validity_INS_Pos_LLH_Latitude of frame RT_SB_INS_Pos_LLH_1, 9306658 (0x8e0222). Valid when bit is set, invalid when bit is clear.
        Validity_INS_Pos_LLH_Longitude: type=cif_0x8e0222_Validity_INS_Pos_LLH_Longitude_t  # Input signal Validity_INS_Pos_LLH_Longitude of frame RT_SB_INS_Pos_LLH_1, 9306658 (0x8e0222). Valid when bit is set, invalid when bit is clear.
        Validity_INS_Pos_LLH_Altitude: type=cif_0x8e0222_Validity_INS_Pos_LLH_Altitude_t  # Input signal Validity_INS_Pos_LLH_Altitude of frame RT_SB_INS_Pos_LLH_1, 9306658 (0x8e0222). Valid when bit is set, invalid when bit is clear.
        Accuracy_INS_Pos_LLH_Latitude: type=cif_0x8e0222_Accuracy_INS_Pos_LLH_Latitude_t  # Input signal Accuracy_INS_Pos_LLH_Latitude of frame RT_SB_INS_Pos_LLH_1, 9306658 (0x8e0222). This accuracy value applies to both 2D and 3D GPS speed.
        Accuracy_INS_Pos_LLH_Longitude: type=cif_0x8e0222_Accuracy_INS_Pos_LLH_Longitude_t  # Input signal Accuracy_INS_Pos_LLH_Longitude of frame RT_SB_INS_Pos_LLH_1, 9306658 (0x8e0222). This accuracy value applies to both 2D and 3D GPS speed.
        Accuracy_INS_Pos_LLH_Altitude: type=cif_0x8e0222_Accuracy_INS_Pos_LLH_Altitude_t  # Input signal Accuracy_INS_Pos_LLH_Altitude of frame RT_SB_INS_Pos_LLH_1, 9306658 (0x8e0222). This accuracy value applies to both 2D and 3D GPS speed.
        INS_Pos_LLH_Latitude: type=cif_0x8e0222_INS_Pos_LLH_Latitude_t  # Input signal INS_Pos_LLH_Latitude of frame RT_SB_INS_Pos_LLH_1, 9306658 (0x8e0222).
    if8e1522  # This interface contains a data element for each signal of input frame RT_SB_INS_Heading_Gradient_2, 9311522 (0x8e1522). The frame has 6 signals
      6 x data:
        Validity_INS_Heading: type=cif_0x8e1522_Validity_INS_Heading_t  # Input signal Validity_INS_Heading of frame RT_SB_INS_Heading_Gradient_2, 9311522 (0x8e1522). Valid when bit is set, invalid when bit is clear.
        Validity_INS_Gradient: type=cif_0x8e1522_Validity_INS_Gradient_t  # Input signal Validity_INS_Gradient of frame RT_SB_INS_Heading_Gradient_2, 9311522 (0x8e1522). Valid when bit is set, invalid when bit is clear.
        Accuracy_INS_Heading: type=cif_0x8e1522_Accuracy_INS_Heading_t  # Input signal Accuracy_INS_Heading of frame RT_SB_INS_Heading_Gradient_2, 9311522 (0x8e1522). Dimensionless. Lower values imply but do not guarantee better accuracy than higher values.
        INS_Heading_2: type=cif_0x8e1522_INS_Heading_2_t  # Input signal INS_Heading_2 of frame RT_SB_INS_Heading_Gradient_2, 9311522 (0x8e1522). This is GPS heading in the range 0 - 360., the direction that the vehicle is travelling in the local horizontal plane.
        Accuracy_INS_Gradient: type=cif_0x8e1522_Accuracy_INS_Gradient_t  # Input signal Accuracy_INS_Gradient of frame RT_SB_INS_Heading_Gradient_2, 9311522 (0x8e1522). Dimensionless. Lower values imply but do not guarantee better accuracy than higher values.
        INS_Gradient: type=cif_0x8e1522_INS_Gradient_t  # Input signal INS_Gradient of frame RT_SB_INS_Heading_Gradient_2, 9311522 (0x8e1522). This is GPS gradient, i.e. the vertical direction that the vehicle is travelling, NOT pointing (pitch).
    if8e1422  # This interface contains a data element for each signal of input frame RT_SB_INS_Heading_Gradient, 9311266 (0x8e1422). The frame has 6 signals
      6 x data:
        Validity_INS_Heading: type=cif_0x8e1422_Validity_INS_Heading_t  # Input signal Validity_INS_Heading of frame RT_SB_INS_Heading_Gradient, 9311266 (0x8e1422). Valid when bit is set, invalid when bit is clear.
        Validity_INS_Gradient: type=cif_0x8e1422_Validity_INS_Gradient_t  # Input signal Validity_INS_Gradient of frame RT_SB_INS_Heading_Gradient, 9311266 (0x8e1422). Valid when bit is set, invalid when bit is clear.
        Accuracy_INS_Heading: type=cif_0x8e1422_Accuracy_INS_Heading_t  # Input signal Accuracy_INS_Heading of frame RT_SB_INS_Heading_Gradient, 9311266 (0x8e1422). Dimensionless. Lower values imply but do not guarantee better accuracy than higher values.
        INS_Heading: type=cif_0x8e1422_INS_Heading_t  # Input signal INS_Heading of frame RT_SB_INS_Heading_Gradient, 9311266 (0x8e1422). This is GPS heading, the direction that the vehicle is travelling in the local horizontal plane.
        Accuracy_INS_Gradient: type=cif_0x8e1422_Accuracy_INS_Gradient_t  # Input signal Accuracy_INS_Gradient of frame RT_SB_INS_Heading_Gradient, 9311266 (0x8e1422). Dimensionless. Lower values imply but do not guarantee better accuracy than higher values.
        INS_Gradient: type=cif_0x8e1422_INS_Gradient_t  # Input signal INS_Gradient of frame RT_SB_INS_Heading_Gradient, 9311266 (0x8e1422). This is GPS gradient, i.e. the vertical direction that the vehicle is travelling, NOT pointing (pitch).
    if8e0022  # This interface contains a data element for each signal of input frame RT_SB_INS_Status, 9306146 (0x8e0022). The frame has 1 signals
      data INS_Status: type=cif_0x8e0022_INS_Status_t  # Input signal INS_Status of frame RT_SB_INS_Status, 9306146 (0x8e0022).
    if8e0122  # This interface contains a data element for each signal of input frame RT_SB_INS_Attitude, 9306402 (0x8e0122). The frame has 7 signals
      7 x data:
        Validity_Yaw: type=cif_0x8e0122_Validity_Yaw_t  # Input signal Validity_Yaw of frame RT_SB_INS_Attitude, 9306402 (0x8e0122).
        Validity_Pitch: type=cif_0x8e0122_Validity_Pitch_t  # Input signal Validity_Pitch of frame RT_SB_INS_Attitude, 9306402 (0x8e0122).
        Validity_Roll: type=cif_0x8e0122_Validity_Roll_t  # Input signal Validity_Roll of frame RT_SB_INS_Attitude, 9306402 (0x8e0122).
        Accuracy_Attitude: type=cif_0x8e0122_Accuracy_Attitude_t  # Input signal Accuracy_Attitude of frame RT_SB_INS_Attitude, 9306402 (0x8e0122).
        Attitude_Yaw: type=cif_0x8e0122_Attitude_Yaw_t  # Input signal Attitude_Yaw of frame RT_SB_INS_Attitude, 9306402 (0x8e0122).
        Attitude_Pitch: type=cif_0x8e0122_Attitude_Pitch_t  # Input signal Attitude_Pitch of frame RT_SB_INS_Attitude, 9306402 (0x8e0122).
        Attitude_Roll: type=cif_0x8e0122_Attitude_Roll_t  # Input signal Attitude_Roll of frame RT_SB_INS_Attitude, 9306402 (0x8e0122).
    if8d0122  # This interface contains a data element for each signal of input frame RT_SB_Output_Status, 9240866 (0x8d0122). The frame has 10 signals
      10 x data:
        Validity_Status_Timestamp: type=cif_0x8d0122_Validity_Status_Timestamp_t  # Input signal Validity_Status_Timestamp of frame RT_SB_Output_Status, 9240866 (0x8d0122). Valid when bit is set, invalid when bit is clear.
        Status_Analogue_1: type=cif_0x8d0122_Status_Analogue_1_t  # Input signal Status_Analogue_1 of frame RT_SB_Output_Status, 9240866 (0x8d0122). Analogue output status for channel 1.
        Status_Analogue_2: type=cif_0x8d0122_Status_Analogue_2_t  # Input signal Status_Analogue_2 of frame RT_SB_Output_Status, 9240866 (0x8d0122). Analogue output status for channel 1.
        Status_Analogue_3: type=cif_0x8d0122_Status_Analogue_3_t  # Input signal Status_Analogue_3 of frame RT_SB_Output_Status, 9240866 (0x8d0122). Analogue output status for channel 3.
        Status_Analogue_4: type=cif_0x8d0122_Status_Analogue_4_t  # Input signal Status_Analogue_4 of frame RT_SB_Output_Status, 9240866 (0x8d0122). Analogue output status for channel 4.
        Status_Pulse_Output: type=cif_0x8d0122_Status_Pulse_Output_t  # Input signal Status_Pulse_Output of frame RT_SB_Output_Status, 9240866 (0x8d0122). Pulse output activity status
        Status_Serial_Output_1: type=cif_0x8d0122_Status_Serial_Output_1_t  # Input signal Status_Serial_Output_1 of frame RT_SB_Output_Status, 9240866 (0x8d0122). Status output of serial port 1
        Status_Serial_Output_2: type=cif_0x8d0122_Status_Serial_Output_2_t  # Input signal Status_Serial_Output_2 of frame RT_SB_Output_Status, 9240866 (0x8d0122). Status output of serial port 1
        Status_Trigger: type=cif_0x8d0122_Status_Trigger_t  # Input signal Status_Trigger of frame RT_SB_Output_Status, 9240866 (0x8d0122). Status of the trigger input
        GPS_Time: type=cif_0x8d0122_GPS_Time_t  # Input signal GPS_Time of frame RT_SB_Output_Status, 9240866 (0x8d0122). GPS time is the time in seconds since midnight GMT on Saturday night.
    if8c1622  # This interface contains a data element for each signal of input frame RT_SB_GPS_Heading_Gradient_2, 9180706 (0x8c1622). The frame has 6 signals
      6 x data:
        Validity_GPS_Heading: type=cif_0x8c1622_Validity_GPS_Heading_t  # Input signal Validity_GPS_Heading of frame RT_SB_GPS_Heading_Gradient_2, 9180706 (0x8c1622). Valid when bit is set, invalid when bit is clear.
        Validity_GPS_Gradient: type=cif_0x8c1622_Validity_GPS_Gradient_t  # Input signal Validity_GPS_Gradient of frame RT_SB_GPS_Heading_Gradient_2, 9180706 (0x8c1622). Valid when bit is set, invalid when bit is clear.
        Accuracy_GPS_Heading: type=cif_0x8c1622_Accuracy_GPS_Heading_t  # Input signal Accuracy_GPS_Heading of frame RT_SB_GPS_Heading_Gradient_2, 9180706 (0x8c1622). Dimensionless. Lower values imply but do not guarantee better accuracy than higher values.
        GPS_Heading_2: type=cif_0x8c1622_GPS_Heading_2_t  # Input signal GPS_Heading_2 of frame RT_SB_GPS_Heading_Gradient_2, 9180706 (0x8c1622). This is GPS heading in the range 0 - 360., the direction that the vehicle is travelling in the local horizontal plane.
        Accuracy_GPS_Gradient: type=cif_0x8c1622_Accuracy_GPS_Gradient_t  # Input signal Accuracy_GPS_Gradient of frame RT_SB_GPS_Heading_Gradient_2, 9180706 (0x8c1622). Dimensionless. Lower values imply but do not guarantee better accuracy than higher values.
        GPS_Gradient: type=cif_0x8c1622_GPS_Gradient_t  # Input signal GPS_Gradient of frame RT_SB_GPS_Heading_Gradient_2, 9180706 (0x8c1622). This is GPS gradient, i.e. the vertical direction that the vehicle is travelling, NOT pointing (pitch).
    if802122  # This interface contains a data element for each signal of input frame RT_SB_Cumulative_Distance_2, 8397090 (0x802122). This cumulative distance calculation is updated when the trigger is active. The frame has 4 signals
      4 x data:
        Validity_Cumulative_Time: type=cif_0x802122_Validity_Cumulative_Time_t  # Input signal Validity_Cumulative_Time of frame RT_SB_Cumulative_Distance_2, 8397090 (0x802122). Valid when bit is set, invalid when bit is clear.
        Validity_Cumulative_Distance: type=cif_0x802122_Validity_Cumulative_Distance_t  # Input signal Validity_Cumulative_Distance of frame RT_SB_Cumulative_Distance_2, 8397090 (0x802122). Valid when bit is set, invalid when bit is clear.
        Cumulative_Time: type=cif_0x802122_Cumulative_Time_t  # Input signal Cumulative_Time of frame RT_SB_Cumulative_Distance_2, 8397090 (0x802122).
        Cumulative_Distance: type=cif_0x802122_Cumulative_Distance_t  # Input signal Cumulative_Distance of frame RT_SB_Cumulative_Distance_2, 8397090 (0x802122).
    if802022  # This interface contains a data element for each signal of input frame RT_SB_Cumulative_Distance_1, 8396834 (0x802022). This cumulative distance calculation is updated continuously once the first good GPS lock is obtained. The frame has 4 signals
      4 x data:
        Validity_Cumulative_Time: type=cif_0x802022_Validity_Cumulative_Time_t  # Input signal Validity_Cumulative_Time of frame RT_SB_Cumulative_Distance_1, 8396834 (0x802022). Valid when bit is set, invalid when bit is clear.
        Validity_Cumulative_Distance: type=cif_0x802022_Validity_Cumulative_Distance_t  # Input signal Validity_Cumulative_Distance of frame RT_SB_Cumulative_Distance_1, 8396834 (0x802022). Valid when bit is set, invalid when bit is clear.
        Cumulative_Time: type=cif_0x802022_Cumulative_Time_t  # Input signal Cumulative_Time of frame RT_SB_Cumulative_Distance_1, 8396834 (0x802022).
        Cumulative_Distance: type=cif_0x802022_Cumulative_Distance_t  # Input signal Cumulative_Distance of frame RT_SB_Cumulative_Distance_1, 8396834 (0x802022).
    if8d0022  # This interface contains a data element for each signal of input frame RT_SB_Trigger_Timestamp, 9240610 (0x8d0022). The frame has 5 signals
      5 x data:
        Validity_Trigger_Timestamp: type=cif_0x8d0022_Validity_Trigger_Timestamp_t  # Input signal Validity_Trigger_Timestamp of frame RT_SB_Trigger_Timestamp, 9240610 (0x8d0022). Valid when bit is set, invalid when bit is clear.
        Accuracy_Trigger_Timestamp: type=cif_0x8d0022_Accuracy_Trigger_Timestamp_t  # Input signal Accuracy_Trigger_Timestamp of frame RT_SB_Trigger_Timestamp, 9240610 (0x8d0022). Dimensionless. Lower values imply but do not guarantee better accuracy than higher values.
        Trigger_Number: type=cif_0x8d0022_Trigger_Number_t  # Input signal Trigger_Number of frame RT_SB_Trigger_Timestamp, 9240610 (0x8d0022). This is the ID of the trigger that generated the event, as marked on the case of the logger
        Trigger_Timestamp_Type: type=cif_0x8d0022_Trigger_Timestamp_Type_t  # Input signal Trigger_Timestamp_Type of frame RT_SB_Trigger_Timestamp, 9240610 (0x8d0022).
        GPS_High_Resolution_Time: type=cif_0x8d0022_GPS_High_Resolution_Time_t  # Input signal GPS_High_Resolution_Time of frame RT_SB_Trigger_Timestamp, 9240610 (0x8d0022). GPS time of week to micro-second resolution.
    if800121  # This interface contains a data element for each signal of input frame RT_IMU06_Gyro_Rates, 8388897 (0x800121). The frame has 7 signals
      7 x data:
        Validity_Gyro_Rate_Yaw: type=cif_0x800121_Validity_Gyro_Rate_Yaw_t  # Input signal Validity_Gyro_Rate_Yaw of frame RT_IMU06_Gyro_Rates, 8388897 (0x800121). Valid when bit is set, invalid when bit is clear.
        Validity_Gyro_Rate_Pitch: type=cif_0x800121_Validity_Gyro_Rate_Pitch_t  # Input signal Validity_Gyro_Rate_Pitch of frame RT_IMU06_Gyro_Rates, 8388897 (0x800121). Valid when bit is set, invalid when bit is clear.
        Validity_Gyro_Rate_Roll: type=cif_0x800121_Validity_Gyro_Rate_Roll_t  # Input signal Validity_Gyro_Rate_Roll of frame RT_IMU06_Gyro_Rates, 8388897 (0x800121). Valid when bit is set, invalid when bit is clear.
        Accuracy_Gyro_Rates: type=cif_0x800121_Accuracy_Gyro_Rates_t  # Input signal Accuracy_Gyro_Rates of frame RT_IMU06_Gyro_Rates, 8388897 (0x800121). Dimensionless. Lower values imply but do not guarantee better accuracy than higher values.
        Gyro_Rate_Yaw: type=cif_0x800121_Gyro_Rate_Yaw_t  # Input signal Gyro_Rate_Yaw of frame RT_IMU06_Gyro_Rates, 8388897 (0x800121). Yaw rate is positive for clockwise rotation when looking down on the vehicle from above.
        Gyro_Rate_Pitch: type=cif_0x800121_Gyro_Rate_Pitch_t  # Input signal Gyro_Rate_Pitch of frame RT_IMU06_Gyro_Rates, 8388897 (0x800121). Pitch rate is positive for clockwise rotation when looking at the left hand side of the vehicle from the left of the vehicle.
        Gyro_Rate_Roll: type=cif_0x800121_Gyro_Rate_Roll_t  # Input signal Gyro_Rate_Roll of frame RT_IMU06_Gyro_Rates, 8388897 (0x800121). Roll rate is positive for clockwise rotation when looking at the rear of the vehicle from behind the vehicle.
    if800021  # This interface contains a data element for each signal of input frame RT_IMU06_Accel, 8388641 (0x800021). The frame has 7 signals
      7 x data:
        Validity_Accel_Longitudinal: type=cif_0x800021_Validity_Accel_Longitudinal_t  # Input signal Validity_Accel_Longitudinal of frame RT_IMU06_Accel, 8388641 (0x800021). Valid when bit is set, invalid when bit is clear.
        Validity_Accel_Lateral: type=cif_0x800021_Validity_Accel_Lateral_t  # Input signal Validity_Accel_Lateral of frame RT_IMU06_Accel, 8388641 (0x800021). Valid when bit is set, invalid when bit is clear.
        Validity_Accel_Vertical: type=cif_0x800021_Validity_Accel_Vertical_t  # Input signal Validity_Accel_Vertical of frame RT_IMU06_Accel, 8388641 (0x800021). Valid when bit is set, invalid when bit is clear.
        Accuracy_Accel: type=cif_0x800021_Accuracy_Accel_t  # Input signal Accuracy_Accel of frame RT_IMU06_Accel, 8388641 (0x800021). Dimensionless. Lower values imply but do not guarantee better accuracy than higher values.
        Accel_Longitudinal: type=cif_0x800021_Accel_Longitudinal_t  # Input signal Accel_Longitudinal of frame RT_IMU06_Accel, 8388641 (0x800021). Longitudinal acceleration. This is positive when the vehicle accelerates in a forwards direction.
        Accel_Lateral: type=cif_0x800021_Accel_Lateral_t  # Input signal Accel_Lateral of frame RT_IMU06_Accel, 8388641 (0x800021). Lateral acceleration. This is positive when the vehicle accelerates towards the right, e.g. when cornering around a right-hand bend.
        Accel_Vertical: type=cif_0x800021_Accel_Vertical_t  # Input signal Accel_Vertical of frame RT_IMU06_Accel, 8388641 (0x800021). Vertical acceleration. This is positive when the vehicle accelerates in an upwards direction, e.g. when travelling through a dip.
    if801022  # This interface contains a data element for each signal of input frame RT_SB_Speed, 8392738 (0x801022). The frame has 3 signals
      data Validity_Speed: type=cif_0x801022_Validity_Speed_t  # Input signal Validity_Speed of frame RT_SB_Speed, 8392738 (0x801022). Valid when bit is set, invalid when bit is clear.
      data Accuracy_Speed: type=cif_0x801022_Accuracy_Speed_t  # Input signal Accuracy_Speed of frame RT_SB_Speed, 8392738 (0x801022). Dimensionless. Lower values imply but do not guarantee better accuracy than higher values.
      data Speed: type=cif_0x801022_Speed_t  # Input signal Speed of frame RT_SB_Speed, 8392738 (0x801022).
    if8c2122  # This interface contains a data element for each signal of input frame RT_SB_RTK_Slip, 9183522 (0x8c2122). The frame has 7 signals
      7 x data:
        Validity_RTK_Slip: type=cif_0x8c2122_Validity_RTK_Slip_t  # Input signal Validity_RTK_Slip of frame RT_SB_RTK_Slip, 9183522 (0x8c2122). Valid when bit is set, invalid when bit is clear.
        Validity_RTK_Squat: type=cif_0x8c2122_Validity_RTK_Squat_t  # Input signal Validity_RTK_Squat of frame RT_SB_RTK_Slip, 9183522 (0x8c2122). Valid when bit is set, invalid when bit is clear.
        Validity_RTK_Baseline: type=cif_0x8c2122_Validity_RTK_Baseline_t  # Input signal Validity_RTK_Baseline of frame RT_SB_RTK_Slip, 9183522 (0x8c2122). Valid when bit is set, invalid when bit is clear.
        Accuracy_RTK_Baseline: type=cif_0x8c2122_Accuracy_RTK_Baseline_t  # Input signal Accuracy_RTK_Baseline of frame RT_SB_RTK_Slip, 9183522 (0x8c2122).
        RTK_Slip: type=cif_0x8c2122_RTK_Slip_t  # Input signal RTK_Slip of frame RT_SB_RTK_Slip, 9183522 (0x8c2122). Slip is defined as the difference between yaw and heading.
        RTK_Squat: type=cif_0x8c2122_RTK_Squat_t  # Input signal RTK_Squat of frame RT_SB_RTK_Slip, 9183522 (0x8c2122). Squat is defined as the difference between pitch and gradient.
        RTK_Baseline: type=cif_0x8c2122_RTK_Baseline_t  # Input signal RTK_Baseline of frame RT_SB_RTK_Slip, 9183522 (0x8c2122). This is the estimated baseline length calculated by the RTK solution.
    if8c2022  # This interface contains a data element for each signal of input frame RT_SB_RTK_Attitude, 9183266 (0x8c2022). The frame has 7 signals
      7 x data:
        Validity_RTK_Yaw: type=cif_0x8c2022_Validity_RTK_Yaw_t  # Input signal Validity_RTK_Yaw of frame RT_SB_RTK_Attitude, 9183266 (0x8c2022). Valid when bit is set, invalid when bit is clear.
        Validity_RTK_Pitch: type=cif_0x8c2022_Validity_RTK_Pitch_t  # Input signal Validity_RTK_Pitch of frame RT_SB_RTK_Attitude, 9183266 (0x8c2022). Valid when bit is set, invalid when bit is clear.
        Validity_RTK_Roll: type=cif_0x8c2022_Validity_RTK_Roll_t  # Input signal Validity_RTK_Roll of frame RT_SB_RTK_Attitude, 9183266 (0x8c2022). Valid when bit is set, invalid when bit is clear.
        Accuracy_RTK_Attitude: type=cif_0x8c2022_Accuracy_RTK_Attitude_t  # Input signal Accuracy_RTK_Attitude of frame RT_SB_RTK_Attitude, 9183266 (0x8c2022). Note that RTK yaw is typically up to about 4 times more accurate than RTK pitch or roll.
        RTK_Attitude_Yaw: type=cif_0x8c2022_RTK_Attitude_Yaw_t  # Input signal RTK_Attitude_Yaw of frame RT_SB_RTK_Attitude, 9183266 (0x8c2022). RTK attitude is determined from the MB-RTK solution only. Yaw is positive for a clockwise rotational displacement from due North, looking down on the vehicle from above.
        RTK_Attitude_Pitch: type=cif_0x8c2022_RTK_Attitude_Pitch_t  # Input signal RTK_Attitude_Pitch of frame RT_SB_RTK_Attitude, 9183266 (0x8c2022). RTK attitude is determined from the MB-RTK solution only. Pitch is positive for a clockwise rotational displacement from the local horizontal plane when looking at the vehicle from the left hand side of it.
        RTK_Attitude_Roll: type=cif_0x8c2022_RTK_Attitude_Roll_t  # Input signal RTK_Attitude_Roll of frame RT_SB_RTK_Attitude, 9183266 (0x8c2022). RTK attitude is determined from the MB-RTK solution only. Roll is positive for a clockwise rotational displacement relative to the local horizontal plane when looking at the vehicle from the rear of it.
    if8c3022  # This interface contains a data element for each signal of input frame RT_SB_GPS_Mcycle_Lean, 9187362 (0x8c3022). The frame has 5 signals
      5 x data:
        Validity_GPS_Lateral_Accel: type=cif_0x8c3022_Validity_GPS_Lateral_Accel_t  # Input signal Validity_GPS_Lateral_Accel of frame RT_SB_GPS_Mcycle_Lean, 9187362 (0x8c3022). Valid when bit is set, invalid when bit is clear.
        Validity_GPS_Mcycle_Lean: type=cif_0x8c3022_Validity_GPS_Mcycle_Lean_t  # Input signal Validity_GPS_Mcycle_Lean of frame RT_SB_GPS_Mcycle_Lean, 9187362 (0x8c3022). Valid when bit is set, invalid when bit is clear.
        Accuracy_GPS_Lateral_Accel: type=cif_0x8c3022_Accuracy_GPS_Lateral_Accel_t  # Input signal Accuracy_GPS_Lateral_Accel of frame RT_SB_GPS_Mcycle_Lean, 9187362 (0x8c3022). This accuracy value applies to both GPS-derived lateral acceleration and motorcycle lean angle, since both are derived from the rate of change of GPS heading.
        GPS_Lateral_Accel: type=cif_0x8c3022_GPS_Lateral_Accel_t  # Input signal GPS_Lateral_Accel of frame RT_SB_GPS_Mcycle_Lean, 9187362 (0x8c3022). GPS-derived lateral acceleration. This is derived by differentiating GPS heading - it is much more noisy than lateral accel from the accelerometers, but useful for m/cycle applications.
        GPS_Mcycle_Lean_Angle: type=cif_0x8c3022_GPS_Mcycle_Lean_Angle_t  # Input signal GPS_Mcycle_Lean_Angle of frame RT_SB_GPS_Mcycle_Lean, 9187362 (0x8c3022). Motorcycle lean angle, derived from rate of change of heading from GPS. This is the lean angle of the centre of mass of the combined bike + rider.
    if8c0022  # This interface contains a data element for each signal of input frame RT_SB_GPS_Status, 9175074 (0x8c0022). The frame has 8 signals
      8 x data:
        GPS_Status: type=cif_0x8c0022_GPS_Status_t  # Input signal GPS_Status of frame RT_SB_GPS_Status, 9175074 (0x8c0022).
        Firmware_Version_Major: type=cif_0x8c0022_Firmware_Version_Major_t  # Input signal Firmware_Version_Major of frame RT_SB_GPS_Status, 9175074 (0x8c0022).
        Firmware_Version_Intermediate: type=cif_0x8c0022_Firmware_Version_Intermediate_t  # Input signal Firmware_Version_Intermediate of frame RT_SB_GPS_Status, 9175074 (0x8c0022).
        Firmware_Version_Minor: type=cif_0x8c0022_Firmware_Version_Minor_t  # Input signal Firmware_Version_Minor of frame RT_SB_GPS_Status, 9175074 (0x8c0022).
        GPS_nSv: type=cif_0x8c0022_GPS_nSv_t  # Input signal GPS_nSv of frame RT_SB_GPS_Status, 9175074 (0x8c0022). Number of satellites used in GPS solution
        GPS_nSv_2: type=cif_0x8c0022_GPS_nSv_2_t  # Input signal GPS_nSv_2 of frame RT_SB_GPS_Status, 9175074 (0x8c0022). Number of satellites used in GPS solution by module 2 on RTK units...
        GPS_nSv_RTK: type=cif_0x8c0022_GPS_nSv_RTK_t  # Input signal GPS_nSv_RTK of frame RT_SB_GPS_Status, 9175074 (0x8c0022). Number of common satellites available to RTK solution
        RTK_Status: type=cif_0x8c0022_RTK_Status_t  # Input signal RTK_Status of frame RT_SB_GPS_Status, 9175074 (0x8c0022).
    if8c0522  # This interface contains a data element for each signal of input frame RT_SB_GPS_Pos_ECEF_2, 9176354 (0x8c0522). The frame has 2 signals
      data GPS_Pos_ECEF_Y: type=cif_0x8c0522_GPS_Pos_ECEF_Y_t  # Input signal GPS_Pos_ECEF_Y of frame RT_SB_GPS_Pos_ECEF_2, 9176354 (0x8c0522). ECEF Y position. The ECEF Y axis originates from the Earth centre, and the positive Y axis intersects the Earth surface at zero degrees latittude and 90 degrees longitude.
      data GPS_Pos_ECEF_Z: type=cif_0x8c0522_GPS_Pos_ECEF_Z_t  # Input signal GPS_Pos_ECEF_Z of frame RT_SB_GPS_Pos_ECEF_2, 9176354 (0x8c0522). ECEF Z position. The ECEF Z axis originates from the Earth centre, and the positive Z axis intersects the Earth surface at the North Pole.
    if8c0422  # This interface contains a data element for each signal of input frame RT_SB_GPS_Pos_ECEF_1, 9176098 (0x8c0422). The frame has 7 signals
      7 x data:
        Validity_GPS_Pos_ECEF_X: type=cif_0x8c0422_Validity_GPS_Pos_ECEF_X_t  # Input signal Validity_GPS_Pos_ECEF_X of frame RT_SB_GPS_Pos_ECEF_1, 9176098 (0x8c0422). Valid when bit is set, invalid when bit is clear.
        Validity_GPS_Pos_ECEF_Y: type=cif_0x8c0422_Validity_GPS_Pos_ECEF_Y_t  # Input signal Validity_GPS_Pos_ECEF_Y of frame RT_SB_GPS_Pos_ECEF_1, 9176098 (0x8c0422). Valid when bit is set, invalid when bit is clear.
        Validity_GPS_Pos_ECEF_Z: type=cif_0x8c0422_Validity_GPS_Pos_ECEF_Z_t  # Input signal Validity_GPS_Pos_ECEF_Z of frame RT_SB_GPS_Pos_ECEF_1, 9176098 (0x8c0422). Valid when bit is set, invalid when bit is clear.
        Accuracy_GPS_Pos_ECEF_X: type=cif_0x8c0422_Accuracy_GPS_Pos_ECEF_X_t  # Input signal Accuracy_GPS_Pos_ECEF_X of frame RT_SB_GPS_Pos_ECEF_1, 9176098 (0x8c0422). Dimensionless. Lower values imply but do not guarantee better accuracy than higher values.
        Accuracy_GPS_Pos_ECEF_Y: type=cif_0x8c0422_Accuracy_GPS_Pos_ECEF_Y_t  # Input signal Accuracy_GPS_Pos_ECEF_Y of frame RT_SB_GPS_Pos_ECEF_1, 9176098 (0x8c0422). Dimensionless. Lower values imply but do not guarantee better accuracy than higher values.
        Accuracy_GPS_Pos_ECEF_Z: type=cif_0x8c0422_Accuracy_GPS_Pos_ECEF_Z_t  # Input signal Accuracy_GPS_Pos_ECEF_Z of frame RT_SB_GPS_Pos_ECEF_1, 9176098 (0x8c0422). Dimensionless. Lower values imply but do not guarantee better accuracy than higher values.
        GPS_Pos_ECEF_X: type=cif_0x8c0422_GPS_Pos_ECEF_X_t  # Input signal GPS_Pos_ECEF_X of frame RT_SB_GPS_Pos_ECEF_1, 9176098 (0x8c0422). ECEF X position. The ECEF X axis originates from the Earth centre, and the positive X axis intersects the Earth surface at zero degrees latittude and zero degrees longitude (the intersection of the equator and the prime meridian).
    if8c0322  # This interface contains a data element for each signal of input frame RT_SB_GPS_Pos_LLH_2, 9175842 (0x8c0322). The frame has 2 signals
      data GPS_Pos_LLH_Longitude: type=cif_0x8c0322_GPS_Pos_LLH_Longitude_t  # Input signal GPS_Pos_LLH_Longitude of frame RT_SB_GPS_Pos_LLH_2, 9175842 (0x8c0322).
      data GPS_Pos_LLH_Altitude: type=cif_0x8c0322_GPS_Pos_LLH_Altitude_t  # Input signal GPS_Pos_LLH_Altitude of frame RT_SB_GPS_Pos_LLH_2, 9175842 (0x8c0322).
    if8c0222  # This interface contains a data element for each signal of input frame RT_SB_GPS_Pos_LLH_1, 9175586 (0x8c0222). The frame has 7 signals
      7 x data:
        Validity_GPS_Pos_LLH_Latitude: type=cif_0x8c0222_Validity_GPS_Pos_LLH_Latitude_t  # Input signal Validity_GPS_Pos_LLH_Latitude of frame RT_SB_GPS_Pos_LLH_1, 9175586 (0x8c0222). Valid when bit is set, invalid when bit is clear.
        Validity_GPS_Pos_LLH_Longitude: type=cif_0x8c0222_Validity_GPS_Pos_LLH_Longitude_t  # Input signal Validity_GPS_Pos_LLH_Longitude of frame RT_SB_GPS_Pos_LLH_1, 9175586 (0x8c0222). Valid when bit is set, invalid when bit is clear.
        Validity_GPS_Pos_LLH_Altitude: type=cif_0x8c0222_Validity_GPS_Pos_LLH_Altitude_t  # Input signal Validity_GPS_Pos_LLH_Altitude of frame RT_SB_GPS_Pos_LLH_1, 9175586 (0x8c0222). Valid when bit is set, invalid when bit is clear.
        Accuracy_GPS_Pos_LLH_Latitude: type=cif_0x8c0222_Accuracy_GPS_Pos_LLH_Latitude_t  # Input signal Accuracy_GPS_Pos_LLH_Latitude of frame RT_SB_GPS_Pos_LLH_1, 9175586 (0x8c0222). This accuracy value applies to both 2D and 3D GPS speed.
        Accuracy_GPS_Pos_LLH_Longitude: type=cif_0x8c0222_Accuracy_GPS_Pos_LLH_Longitude_t  # Input signal Accuracy_GPS_Pos_LLH_Longitude of frame RT_SB_GPS_Pos_LLH_1, 9175586 (0x8c0222). This accuracy value applies to both 2D and 3D GPS speed.
        Accuracy_GPS_Pos_LLH_Altitude: type=cif_0x8c0222_Accuracy_GPS_Pos_LLH_Altitude_t  # Input signal Accuracy_GPS_Pos_LLH_Altitude of frame RT_SB_GPS_Pos_LLH_1, 9175586 (0x8c0222). This accuracy value applies to both 2D and 3D GPS speed.
        GPS_Pos_LLH_Latitude: type=cif_0x8c0222_GPS_Pos_LLH_Latitude_t  # Input signal GPS_Pos_LLH_Latitude of frame RT_SB_GPS_Pos_LLH_1, 9175586 (0x8c0222).
    if8c1522  # This interface contains a data element for each signal of input frame RT_SB_GPS_Heading_Gradient, 9180450 (0x8c1522). The frame has 6 signals
      6 x data:
        Validity_GPS_Heading: type=cif_0x8c1522_Validity_GPS_Heading_t  # Input signal Validity_GPS_Heading of frame RT_SB_GPS_Heading_Gradient, 9180450 (0x8c1522). Valid when bit is set, invalid when bit is clear.
        Validity_GPS_Gradient: type=cif_0x8c1522_Validity_GPS_Gradient_t  # Input signal Validity_GPS_Gradient of frame RT_SB_GPS_Heading_Gradient, 9180450 (0x8c1522). Valid when bit is set, invalid when bit is clear.
        Accuracy_GPS_Heading: type=cif_0x8c1522_Accuracy_GPS_Heading_t  # Input signal Accuracy_GPS_Heading of frame RT_SB_GPS_Heading_Gradient, 9180450 (0x8c1522). Dimensionless. Lower values imply but do not guarantee better accuracy than higher values.
        GPS_Heading: type=cif_0x8c1522_GPS_Heading_t  # Input signal GPS_Heading of frame RT_SB_GPS_Heading_Gradient, 9180450 (0x8c1522). This is GPS heading, the direction that the vehicle is travelling in the local horizontal plane.
        Accuracy_GPS_Gradient: type=cif_0x8c1522_Accuracy_GPS_Gradient_t  # Input signal Accuracy_GPS_Gradient of frame RT_SB_GPS_Heading_Gradient, 9180450 (0x8c1522). Dimensionless. Lower values imply but do not guarantee better accuracy than higher values.
        GPS_Gradient: type=cif_0x8c1522_GPS_Gradient_t  # Input signal GPS_Gradient of frame RT_SB_GPS_Heading_Gradient, 9180450 (0x8c1522). This is GPS gradient, i.e. the vertical direction that the vehicle is travelling, NOT pointing (pitch).
    if8c1422  # This interface contains a data element for each signal of input frame RT_SB_GPS_Vel_ECEF_2, 9180194 (0x8c1422). The frame has 4 signals
      4 x data:
        Validity_GPS_Vel_ECEF_Y: type=cif_0x8c1422_Validity_GPS_Vel_ECEF_Y_t  # Input signal Validity_GPS_Vel_ECEF_Y of frame RT_SB_GPS_Vel_ECEF_2, 9180194 (0x8c1422). Valid when bit is set, invalid when bit is clear.
        Validity_GPS_Vel_ECEF_Z: type=cif_0x8c1422_Validity_GPS_Vel_ECEF_Z_t  # Input signal Validity_GPS_Vel_ECEF_Z of frame RT_SB_GPS_Vel_ECEF_2, 9180194 (0x8c1422). Valid when bit is set, invalid when bit is clear.
        GPS_Vel_ECEF_Y: type=cif_0x8c1422_GPS_Vel_ECEF_Y_t  # Input signal GPS_Vel_ECEF_Y of frame RT_SB_GPS_Vel_ECEF_2, 9180194 (0x8c1422). ECEF Y velocity. The ECEF Y axis originates from the Earth centre, and the positive Y axis intersects the Earth surface at zero degrees latittude and 90 degrees longitude.
        GPS_Vel_ECEF_Z: type=cif_0x8c1422_GPS_Vel_ECEF_Z_t  # Input signal GPS_Vel_ECEF_Z of frame RT_SB_GPS_Vel_ECEF_2, 9180194 (0x8c1422). ECEF Z velocity. The ECEF Z axis originates from the Earth centre, and the positive Z axis intersects the Earth surface at the North Pole.
    if8c1322  # This interface contains a data element for each signal of input frame RT_SB_GPS_Vel_ECEF_1, 9179938 (0x8c1322). The frame has 5 signals
      5 x data:
        Validity_GPS_Vel_ECEF_X: type=cif_0x8c1322_Validity_GPS_Vel_ECEF_X_t  # Input signal Validity_GPS_Vel_ECEF_X of frame RT_SB_GPS_Vel_ECEF_1, 9179938 (0x8c1322). Valid when bit is set, invalid when bit is clear.
        Accuracy_GPS_Vel_ECEF_X: type=cif_0x8c1322_Accuracy_GPS_Vel_ECEF_X_t  # Input signal Accuracy_GPS_Vel_ECEF_X of frame RT_SB_GPS_Vel_ECEF_1, 9179938 (0x8c1322).
        Accuracy_GPS_Vel_ECEF_Y: type=cif_0x8c1322_Accuracy_GPS_Vel_ECEF_Y_t  # Input signal Accuracy_GPS_Vel_ECEF_Y of frame RT_SB_GPS_Vel_ECEF_1, 9179938 (0x8c1322).
        Accuracy_GPS_Vel_ECEF_Z: type=cif_0x8c1322_Accuracy_GPS_Vel_ECEF_Z_t  # Input signal Accuracy_GPS_Vel_ECEF_Z of frame RT_SB_GPS_Vel_ECEF_1, 9179938 (0x8c1322).
        GPS_Vel_ECEF_X: type=cif_0x8c1322_GPS_Vel_ECEF_X_t  # Input signal GPS_Vel_ECEF_X of frame RT_SB_GPS_Vel_ECEF_1, 9179938 (0x8c1322). ECEF X velocity. The ECEF X axis originates from the Earth centre, and the positive X axis intersects the Earth surface at zero degrees latittude and zero degrees longitude (the intersection of the equator and the prime meridian).
    if000  # This interface contains a data element for each signal of input frame RT_SB_GPS_Vel_NED_2, 0 (0x000). The frame has 3 signals
      data Validity_GPS_Vel_NED_D: type=cif_0x000_Validity_GPS_Vel_NED_D_t  # Input signal Validity_GPS_Vel_NED_D of frame RT_SB_GPS_Vel_NED_2, 0 (0x000). Valid when bit is set, invalid when bit is clear.
      data Accuracy_GPS_Vel_D: type=cif_0x000_Accuracy_GPS_Vel_D_t  # Input signal Accuracy_GPS_Vel_D of frame RT_SB_GPS_Vel_NED_2, 0 (0x000).
      data GPS_Vel_NED_D: type=cif_0x000_GPS_Vel_NED_D_t  # Input signal GPS_Vel_NED_D of frame RT_SB_GPS_Vel_NED_2, 0 (0x000). VELNED D velocity. This is the velocity vector directly downwards towards the Earth centre at the current local Earth surface position.
    if1fffffff  # This interface contains a data element for each signal of input frame RT_SB_GPS_Vel_NED_1, 536870911 (0x1fffffff). The frame has 5 signals
      5 x data:
        Validity_GPS_Vel_NED_N: type=cif_0x1fffffff_Validity_GPS_Vel_NED_N_t  # Input signal Validity_GPS_Vel_NED_N of frame RT_SB_GPS_Vel_NED_1, 536870911 (0x1fffffff). Valid when bit is set, invalid when bit is clear.
        Validity_GPS_Vel_NED_E: type=cif_0x1fffffff_Validity_GPS_Vel_NED_E_t  # Input signal Validity_GPS_Vel_NED_E of frame RT_SB_GPS_Vel_NED_1, 536870911 (0x1fffffff). Valid when bit is set, invalid when bit is clear.
        Accuracy_GPS_Vel_NE: type=cif_0x1fffffff_Accuracy_GPS_Vel_NE_t  # Input signal Accuracy_GPS_Vel_NE of frame RT_SB_GPS_Vel_NED_1, 536870911 (0x1fffffff).
        GPS_Vel_NED_N: type=cif_0x1fffffff_GPS_Vel_NED_N_t  # Input signal GPS_Vel_NED_N of frame RT_SB_GPS_Vel_NED_1, 536870911 (0x1fffffff). VELNED N velocity. This is the velocity vector directly North at the current local Earth surface position.
        GPS_Vel_NED_E: type=cif_0x1fffffff_GPS_Vel_NED_E_t  # Input signal GPS_Vel_NED_E of frame RT_SB_GPS_Vel_NED_1, 536870911 (0x1fffffff). VELNED E velocity. This is the velocity vector directly East at the current local Earth surface position.
    if71a  # This interface contains a data element for each signal of input frame RT_SB_GPS_Speed, 1818 (0x71a). The frame has 5 signals
      5 x data:
        Validity_GPS_Speed_2D: type=cif_0x71a_Validity_GPS_Speed_2D_t  # Input signal Validity_GPS_Speed_2D of frame RT_SB_GPS_Speed, 1818 (0x71a). Valid when bit is set, invalid when bit is clear.
        Validity_GPS_Speed_3D: type=cif_0x71a_Validity_GPS_Speed_3D_t  # Input signal Validity_GPS_Speed_3D of frame RT_SB_GPS_Speed, 1818 (0x71a). Valid when bit is set, invalid when bit is clear.
        Accuracy_GPS_Speed: type=cif_0x71a_Accuracy_GPS_Speed_t  # Input signal Accuracy_GPS_Speed of frame RT_SB_GPS_Speed, 1818 (0x71a). This accuracy value applies to both 2D and 3D GPS speed.
        GPS_Speed_2D: type=cif_0x71a_GPS_Speed_2D_t  # Input signal GPS_Speed_2D of frame RT_SB_GPS_Speed, 1818 (0x71a). This is GPS scalar 2D speed - scalar speed with no local Z axis component included.
        GPS_Speed_3D: type=cif_0x71a_GPS_Speed_3D_t  # Input signal GPS_Speed_3D of frame RT_SB_GPS_Speed, 1818 (0x71a). This is GPS scalar 3D speed - scalar speed with the local Z axis component included.
    if7ff  # This interface contains a data element for each signal of input frame RT_SB_GPS_Time, 2047 (0x7ff). The frame has 5 signals
      5 x data:
        Validity_GPS_Time: type=cif_0x7ff_Validity_GPS_Time_t  # Input signal Validity_GPS_Time of frame RT_SB_GPS_Time, 2047 (0x7ff). Valid when bit is set, invalid when bit is clear.
        Validity_GPS_Week: type=cif_0x7ff_Validity_GPS_Week_t  # Input signal Validity_GPS_Week of frame RT_SB_GPS_Time, 2047 (0x7ff). Valid when bit is set, invalid when bit is clear.
        Accuracy_GPS_Time: type=cif_0x7ff_Accuracy_GPS_Time_t  # Input signal Accuracy_GPS_Time of frame RT_SB_GPS_Time, 2047 (0x7ff).
        GPS_Time: type=cif_0x7ff_GPS_Time_t  # Input signal GPS_Time of frame RT_SB_GPS_Time, 2047 (0x7ff). GPS time is the time in seconds since midnight GMT on Saturday night.
        GPS_Week: type=cif_0x7ff_GPS_Week_t  # Input signal GPS_Week of frame RT_SB_GPS_Time, 2047 (0x7ff).
    if122  # This interface contains a data element for each signal of input frame RT_SB_Accel, 290 (0x122). The frame has 7 signals
      7 x data:
        Validity_Accel_Longitudinal: type=cif_0x122_Validity_Accel_Longitudinal_t  # Input signal Validity_Accel_Longitudinal of frame RT_SB_Accel, 290 (0x122). Valid when bit is set, invalid when bit is clear.
        Validity_Accel_Lateral: type=cif_0x122_Validity_Accel_Lateral_t  # Input signal Validity_Accel_Lateral of frame RT_SB_Accel, 290 (0x122). Valid when bit is set, invalid when bit is clear.
        Validity_Accel_Vertical: type=cif_0x122_Validity_Accel_Vertical_t  # Input signal Validity_Accel_Vertical of frame RT_SB_Accel, 290 (0x122). Valid when bit is set, invalid when bit is clear.
        Accuracy_Accel: type=cif_0x122_Accuracy_Accel_t  # Input signal Accuracy_Accel of frame RT_SB_Accel, 290 (0x122). Dimensionless. Lower values imply but do not guarantee better accuracy than higher values.
        Accel_Longitudinal: type=cif_0x122_Accel_Longitudinal_t  # Input signal Accel_Longitudinal of frame RT_SB_Accel, 290 (0x122). Longitudinal acceleration. This is positive when the vehicle accelerates in a forwards direction.
        Accel_Lateral: type=cif_0x122_Accel_Lateral_t  # Input signal Accel_Lateral of frame RT_SB_Accel, 290 (0x122). Lateral acceleration. This is positive when the vehicle accelerates towards the right, e.g. when cornering around a right-hand bend.
        Accel_Vertical: type=cif_0x122_Accel_Vertical_t  # Input signal Accel_Vertical of frame RT_SB_Accel, 290 (0x122). Vertical acceleration. This is positive when the vehicle accelerates in an upwards direction, e.g. when travelling through a dip.
    if800122  # This interface contains a data element for each signal of input frame RT_SB_Gyro_Rates, 8388898 (0x800122). The frame has 7 signals
      7 x data:
        Validity_Gyro_Rate_Yaw: type=cif_0x800122_Validity_Gyro_Rate_Yaw_t  # Input signal Validity_Gyro_Rate_Yaw of frame RT_SB_Gyro_Rates, 8388898 (0x800122). Valid when bit is set, invalid when bit is clear.
        Validity_Gyro_Rate_Pitch: type=cif_0x800122_Validity_Gyro_Rate_Pitch_t  # Input signal Validity_Gyro_Rate_Pitch of frame RT_SB_Gyro_Rates, 8388898 (0x800122). Valid when bit is set, invalid when bit is clear.
        Validity_Gyro_Rate_Roll: type=cif_0x800122_Validity_Gyro_Rate_Roll_t  # Input signal Validity_Gyro_Rate_Roll of frame RT_SB_Gyro_Rates, 8388898 (0x800122). Valid when bit is set, invalid when bit is clear.
        Accuracy_Gyro_Rates: type=cif_0x800122_Accuracy_Gyro_Rates_t  # Input signal Accuracy_Gyro_Rates of frame RT_SB_Gyro_Rates, 8388898 (0x800122). Dimensionless. Lower values imply but do not guarantee better accuracy than higher values.
        Gyro_Rate_Yaw: type=cif_0x800122_Gyro_Rate_Yaw_t  # Input signal Gyro_Rate_Yaw of frame RT_SB_Gyro_Rates, 8388898 (0x800122). Yaw rate is positive for clockwise rotation when looking down on the vehicle from above.
        Gyro_Rate_Pitch: type=cif_0x800122_Gyro_Rate_Pitch_t  # Input signal Gyro_Rate_Pitch of frame RT_SB_Gyro_Rates, 8388898 (0x800122). Pitch rate is positive for clockwise rotation when looking at the left hand side of the vehicle from the left of the vehicle.
        Gyro_Rate_Roll: type=cif_0x800122_Gyro_Rate_Roll_t  # Input signal Gyro_Rate_Roll of frame RT_SB_Gyro_Rates, 8388898 (0x800122). Roll rate is positive for clockwise rotation when looking at the rear of the vehicle from behind the vehicle.
package /AUTOSAR_AISpecification/PhysicalDimensions
  12 x physical dimension:
    Current1: current-exp=1  # The electric current
    Len1: length-exp=1  # Length 1
    Len1M1TiNeg2: length-exp=1, mass-exp=1, time-exp=-2  # Length 1 Mass 1 Time -2
    Len2M1TiNeg2: length-exp=2, mass-exp=1, time-exp=-2  # Length 2 Mass 1 Time -2
    Len2M1TiNeg3INeg1: length-exp=2, mass-exp=1, time-exp=-3, current-exp=-1  # Length 2 Mass 1 Time -3 Electric current -1
    LenNeg1M1TiNeg2: length-exp=-1, mass-exp=1, time-exp=-2  # Length -1 Mass 1 Time -2
    M3TiNeg1: length-exp=3, mass-exp=0, time-exp=-1  # Mass 1 Time -1 | Volume flow
    NoDimension  # No Dimension
    T1: temperature-exp=1  # Temperature 1
    Ti1: time-exp=1  # Time 1
    TiNeg1: time-exp=-1  # Time -1
    TiNeg2: time-exp=-2  # Time -2
package /AUTOSAR_AISpecification/Units
  14 x unit:
    Ampere: factor-si-to-unit=1, offset-si-to-unit=0, physical-dimension=Current1  # Base unit of the eletric current
    Bar: display-name=bar, factor-si-to-unit=1E-05, offset-si-to-unit=0, physical-dimension=LenNeg1M1TiNeg2  # pressure, no SI unit; 1 bar = 100,000 Pascal (Pa)
    CentiMtr3PerSec: factor-si-to-unit=1E-06, offset-si-to-unit=0, physical-dimension=M3TiNeg1  # Volume flow
    DegAngle: factor-si-to-unit=1, offset-si-to-unit=0, physical-dimension=NoDimension  # Degree as used for angles. 3600 degrees is the full circle or 2*pi respectively
    DegCgrd: display-name=degC, factor-si-to-unit=1, offset-si-to-unit=-273.15, physical-dimension=T1  # Degree Centigrade | temperature, no SI unit, (degC = Kelvin - 273.15)
    MilliMtr: display-name=m, factor-si-to-unit=0.001, offset-si-to-unit=0, physical-dimension=Len1  # Meter | SI base unit of length
    NoUnit: display-name=-, factor-si-to-unit=1, offset-si-to-unit=0, physical-dimension=NoDimension  # No Unit | Unit for dimensionless continuous value data types like numbers, factors and coefficients
    Nwt: display-name=N, factor-si-to-unit=1, offset-si-to-unit=0, physical-dimension=Len1M1TiNeg2  # Newton | SI derived unit of force
    NwtMtr: display-name=Nm, factor-si-to-unit=1, offset-si-to-unit=0, physical-dimension=Len2M1TiNeg2  # Newton Meter | SI derived unit of moment of force (torque = kg m^2/s^2)
    Perc: display-name=%, factor-si-to-unit=100, offset-si-to-unit=0, physical-dimension=NoDimension  # Percent | a percentage is a way of expressing a number as a fraction of 100 (no SI unit).
    Rpm: display-name=rpm, factor-si-to-unit=0.01666667, offset-si-to-unit=0, physical-dimension=TiNeg1  # revolutions per minute - no SI unit
    RpmPerSec: display-name=rpm/s, factor-si-to-unit=0.01666667, offset-si-to-unit=0, physical-dimension=TiNeg2  # Revolutions per minute per Second | time-derivative of revolutions per minute - no SI unit
    Sec: display-name=s, factor-si-to-unit=1, offset-si-to-unit=0, physical-dimension=Ti1  # Second | SI base unit of time
    Volt: display-name=V, factor-si-to-unit=1, offset-si-to-unit=0, physical-dimension=Len2M1TiNeg3INeg1  # SI derived unit of electric potential difference
package /AUTOSAR_PlatformTypes/Documentations
  documentation SWS_PlatformTypes  # Traces in SWS PlatformTypes
    documentation-content:
      trace PLATFORM027: category=SPECIFICATION_ITEM, p=l-1=The standard AUTOSAR type boolean shall be implemented as an unsigned integer with a bit length that is the shortest one natively supported by the platform (in general 8 bits).  # Implementation of Boolean
      trace PLATFORM034:  # Values of Boolean
        category=SPECIFICATION_ITEM
        p=l-1=The standard AUTOSAR type boolean shall only be used in conjunction with the standard symbols TRUE and FALSE. For value assignments of variables of type boolean no arithmetic or logical operators (+, ++, -, --, *, /, \, <<, >>, !, ~) must be used. The only allowed form of assignment is:
        verbatim=l-5=boolean var; ... var = TRUE; var = FALSE;
        p=l-1=The only allowed forms of comparison are:
        verbatim=l-5=boolean var; ... if (var == TRUE) if (var == FALSE) if (var != TRUE) if (var != FALSE)
package /AUTOSAR_PlatformTypes/ImplementationDataTypes  # AUTOSAR Platform types
package /AUTOSAR_PlatformTypes/SwBaseTypes  # AUTOSAR Base Types for AUTOSAR Platform types for a specific controller and compiler
