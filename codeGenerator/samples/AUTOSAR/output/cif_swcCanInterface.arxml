[part 2 of 4: package /cif_swcCanInterface/CANBus_CAN_RT/applicationDataTypes]
AUTOSAR XML (schema 4-1-3)
package /cif_swcCanInterface/CANBus_CAN_RT/applicationDataTypes  (continued)
  app type cif_0x0d7_Validity_INS_Vel_Sideways_t:  # The type of CAN input signal Validity_INS_Vel_Sideways, frame RT_SB_INS_Vel_Body_Axes, 215 (0x0d7). Implementation type is boolean
    category=VALUE
    compu {phys=raw} "The scaling of CAN input signal Validity_INS_Vel_Sideways, frame RT_SB_INS_Vel_Body_Axes, 215 (0x0d7). Scaling: WorldValue = BinaryValue []. Unit: The unit "" from the network database is mapped to the AUTOSAR unit NoUnit"
    range phys 0..1 "The range of CAN input signal Validity_INS_Vel_Sideways, frame RT_SB_INS_Vel_Body_Axes, 215 (0x0d7). Range (world values): 0.0 ... 1.0 []"
  app type cif_0x0d7_Bit4_t: category=VALUE, compu {phys=raw} "The scaling of CAN input signal Bit4, frame RT_SB_INS_Vel_Body_Axes, 215 (0x0d7). Scaling: WorldValue = BinaryValue []. Unit: The unit "" from the network database is mapped to the AUTOSAR unit NoUnit", range phys 0..1 "The range of CAN input signal Bit4, frame RT_SB_INS_Vel_Body_Axes, 215 (0x0d7). Range (world values): 0.0 ... 1.0 []"  # The type of CAN input signal Bit4, frame RT_SB_INS_Vel_Body_Axes, 215 (0x0d7). Implementation type is boolean
  app type cif_0x0d7_Bit7_t: category=VALUE, compu {phys=raw} "The scaling of CAN input signal Bit7, frame RT_SB_INS_Vel_Body_Axes, 215 (0x0d7). Scaling: WorldValue = BinaryValue []. Unit: The unit "" from the network database is mapped to the AUTOSAR unit NoUnit", range phys 0..1 "The range of CAN input signal Bit7, frame RT_SB_INS_Vel_Body_Axes, 215 (0x0d7). Range (world values): 0.0 ... 1.0 []"  # The type of CAN input signal Bit7, frame RT_SB_INS_Vel_Body_Axes, 215 (0x0d7). Implementation type is boolean
  app type cif_0x0d7_Byte2_Bit0_t: category=VALUE, compu {phys=raw} "The scaling of CAN input signal Byte2_Bit0, frame RT_SB_INS_Vel_Body_Axes, 215 (0x0d7). Scaling: WorldValue = BinaryValue []. Unit: The unit "" from the network database is mapped to the AUTOSAR unit NoUnit", range phys 0..1 "The range of CAN input signal Byte2_Bit0, frame RT_SB_INS_Vel_Body_Axes, 215 (0x0d7). Range (world values): 0.0 ... 1.0 []"  # The type of CAN input signal Byte2_Bit0, frame RT_SB_INS_Vel_Body_Axes, 215 (0x0d7). Implementation type is boolean
  app type cif_0x0d7_INS_Vel_Sideways_2D_t:  # The type of CAN input signal INS_Vel_Sideways_2D, frame RT_SB_INS_Vel_Body_Axes, 215 (0x0d7). Implementation type is int32
    category=VALUE
    compu {phys=raw*0.0001} "The scaling of CAN input signal INS_Vel_Sideways_2D, frame RT_SB_INS_Vel_Body_Axes, 215 (0x0d7). Scaling: WorldValue = 1.0E-4*BinaryValue + 0.0 [m/s]. Unit: The unit m/s from the network database is mapped to the AUTOSAR unit NoUnit"
    range phys -838..838 "The range of CAN input signal INS_Vel_Sideways_2D, frame RT_SB_INS_Vel_Body_Axes, 215 (0x0d7). Range (world values): -838.0 ... 838.0 [m/s]"
  app type cif_0x0d7_Byte4_Bits67_t:  # The type of CAN input signal Byte4_Bits67, frame RT_SB_INS_Vel_Body_Axes, 215 (0x0d7). Implementation type is uint8
    category=VALUE
    compu {phys=raw} "The scaling of CAN input signal Byte4_Bits67, frame RT_SB_INS_Vel_Body_Axes, 215 (0x0d7). Scaling: WorldValue = BinaryValue [Mpx selection]. Unit: The unit Mpx selection from the network database is mapped to the AUTOSAR unit NoUnit"
    range phys 1..3 "The range of CAN input signal Byte4_Bits67, frame RT_SB_INS_Vel_Body_Axes, 215 (0x0d7). Range (world values): 1.0 ... 3.0 [Mpx selection]"
  app type cif_0x0d7_Accuracy_INS_Vel_Body_org_t:  # The type of CAN input signal Accuracy_INS_Vel_Body_org, frame RT_SB_INS_Vel_Body_Axes, 215 (0x0d7). Implementation type is uint8
    category=VALUE
    compu {phys=raw} "The scaling of CAN input signal Accuracy_INS_Vel_Body_org, frame RT_SB_INS_Vel_Body_Axes, 215 (0x0d7). Scaling: WorldValue = BinaryValue []. Unit: The unit "" from the network database is mapped to the AUTOSAR unit NoUnit"
    range phys 0..255 "The range of CAN input signal Accuracy_INS_Vel_Body_org, frame RT_SB_INS_Vel_Body_Axes, 215 (0x0d7). Range (world values): 0.0 ... 255.0 []"
  app type cif_0x0d7_INS_Vel_Forwards_2D_org_t:  # The type of CAN input signal INS_Vel_Forwards_2D_org, frame RT_SB_INS_Vel_Body_Axes, 215 (0x0d7). Implementation type is int32
    category=VALUE
    compu {phys=raw*0.0001} "The scaling of CAN input signal INS_Vel_Forwards_2D_org, frame RT_SB_INS_Vel_Body_Axes, 215 (0x0d7). Scaling: WorldValue = 1.0E-4*BinaryValue + 0.0 [m/s]. Unit: The unit m/s from the network database is mapped to the AUTOSAR unit NoUnit"
    range phys -838..838 "The range of CAN input signal INS_Vel_Forwards_2D_org, frame RT_SB_INS_Vel_Body_Axes, 215 (0x0d7). Range (world values): -838.0 ... 838.0 [m/s]"
  app type cif_0x0d7_Accuracy_INS_Vel_Body_no2_t:  # The type of CAN input signal Accuracy_INS_Vel_Body_no2, frame RT_SB_INS_Vel_Body_Axes, 215 (0x0d7). Implementation type is uint8
    category=VALUE
    compu {phys=raw} "The scaling of CAN input signal Accuracy_INS_Vel_Body_no2, frame RT_SB_INS_Vel_Body_Axes, 215 (0x0d7). Scaling: WorldValue = BinaryValue []. Unit: The unit "" from the network database is mapped to the AUTOSAR unit NoUnit"
    range phys 0..255 "The range of CAN input signal Accuracy_INS_Vel_Body_no2, frame RT_SB_INS_Vel_Body_Axes, 215 (0x0d7). Range (world values): 0.0 ... 255.0 []"
  app type cif_0x0d7_INS_Vel_Forwards_2D_no2_t:  # The type of CAN input signal INS_Vel_Forwards_2D_no2, frame RT_SB_INS_Vel_Body_Axes, 215 (0x0d7). Implementation type is int32
    category=VALUE
    compu {phys=raw*0.0001} "The scaling of CAN input signal INS_Vel_Forwards_2D_no2, frame RT_SB_INS_Vel_Body_Axes, 215 (0x0d7). Scaling: WorldValue = 1.0E-4*BinaryValue + 0.0 [m/s]. Unit: The unit m/s from the network database is mapped to the AUTOSAR unit NoUnit"
    range phys -104..104 "The range of CAN input signal INS_Vel_Forwards_2D_no2, frame RT_SB_INS_Vel_Body_Axes, 215 (0x0d7). Range (world values): -104.0 ... 104.0 [m/s]"
  app type cif_0x0d7_Accuracy_INS_Vel_Body_no3_t:  # The type of CAN input signal Accuracy_INS_Vel_Body_no3, frame RT_SB_INS_Vel_Body_Axes, 215 (0x0d7). Implementation type is uint16
    category=VALUE
    compu {phys=raw*0.001} "The scaling of CAN input signal Accuracy_INS_Vel_Body_no3, frame RT_SB_INS_Vel_Body_Axes, 215 (0x0d7). Scaling: WorldValue = 0.001*BinaryValue + 0.0 []. Unit: The unit "" from the network database is mapped to the AUTOSAR unit NoUnit"
    range phys 0..32.768 "The range of CAN input signal Accuracy_INS_Vel_Body_no3, frame RT_SB_INS_Vel_Body_Axes, 215 (0x0d7). Range (world values): 0.0 ... 32.768 []"
  app type cif_0x0d7_INS_Vel_Forwards_2D_no3_t:  # The type of CAN input signal INS_Vel_Forwards_2D_no3, frame RT_SB_INS_Vel_Body_Axes, 215 (0x0d7). Implementation type is int16
    category=VALUE
    compu {phys=raw*0.01} "The scaling of CAN input signal INS_Vel_Forwards_2D_no3, frame RT_SB_INS_Vel_Body_Axes, 215 (0x0d7). Scaling: WorldValue = 0.01*BinaryValue + 0.0 [m/s]. Unit: The unit m/s from the network database is mapped to the AUTOSAR unit NoUnit"
    range phys -81.92..81.91 "The range of CAN input signal INS_Vel_Forwards_2D_no3, frame RT_SB_INS_Vel_Body_Axes, 215 (0x0d7). Range (world values): -81.92 ... 81.91 [m/s]"
  app type cif_0x801024_Validity_Speed_t: category=VALUE, compu {phys=raw} "The scaling of CAN input signal Validity_Speed, frame RT_DL1MK3_Speed, 8392740 (0x801024). Scaling: WorldValue = BinaryValue []. Unit: The unit "" from the network database is mapped to the AUTOSAR unit NoUnit", range phys 0..1 "The range of CAN input signal Validity_Speed, frame RT_DL1MK3_Speed, 8392740 (0x801024). Range (world values): 0.0 ... 1.0 []"  # The type of CAN input signal Validity_Speed, frame RT_DL1MK3_Speed, 8392740 (0x801024). Valid when bit is set, invalid when bit is clear. Implementation type is boolean
  app type cif_0x801024_Accuracy_Speed_t: category=VALUE, compu {phys=raw} "The scaling of CAN input signal Accuracy_Speed, frame RT_DL1MK3_Speed, 8392740 (0x801024). Scaling: WorldValue = BinaryValue []. Unit: The unit "" from the network database is mapped to the AUTOSAR unit NoUnit", range phys 0..255 "The range of CAN input signal Accuracy_Speed, frame RT_DL1MK3_Speed, 8392740 (0x801024). Range (world values): 0.0 ... 255.0 []"  # The type of CAN input signal Accuracy_Speed, frame RT_DL1MK3_Speed, 8392740 (0x801024). Dimensionless. Lower values imply but do not guarantee better accuracy than higher values. Implementation type is uint8
  app type cif_0x801024_Direction_t: category=VALUE, compu {phys=raw*2-1} "The scaling of CAN input signal Direction, frame RT_DL1MK3_Speed, 8392740 (0x801024). Scaling: WorldValue = 2.0*BinaryValue + -1.0 []. Unit: The unit "" from the network database is mapped to the AUTOSAR unit NoUnit", range phys -1..1 "The range of CAN input signal Direction, frame RT_DL1MK3_Speed, 8392740 (0x801024). Range (world values): -1.0 ... 1.0 []"  # The type of CAN input signal Direction, frame RT_DL1MK3_Speed, 8392740 (0x801024). Dimensionless. Direction of speed. 1 means forward, -1 means reverse Implementation type is uint8
  app type cif_0x801024_Speed_t:  # The type of CAN input signal Speed, frame RT_DL1MK3_Speed, 8392740 (0x801024). Implementation type is int32
    category=VALUE
    compu {phys=raw*1e-05} "The scaling of CAN input signal Speed, frame RT_DL1MK3_Speed, 8392740 (0x801024). Scaling: WorldValue = 1.0E-5*BinaryValue + 0.0 [m/s]. Unit: The unit m/s from the network database is mapped to the AUTOSAR unit NoUnit"
    range phys -20000..20000 "The range of CAN input signal Speed, frame RT_DL1MK3_Speed, 8392740 (0x801024). Range (world values): -20000.0 ... 20000.0 [m/s]"
  app type cif_0x8c0124_Validity_GPS_Time_t: category=VALUE, compu {phys=raw} "The scaling of CAN input signal Validity_GPS_Time, frame RT_DL1MK3_GPS_Time, 9175332 (0x8c0124). Scaling: WorldValue = BinaryValue []. Unit: The unit "" from the network database is mapped to the AUTOSAR unit NoUnit", range phys 0..1 "The range of CAN input signal Validity_GPS_Time, frame RT_DL1MK3_GPS_Time, 9175332 (0x8c0124). Range (world values): 0.0 ... 1.0 []"  # The type of CAN input signal Validity_GPS_Time, frame RT_DL1MK3_GPS_Time, 9175332 (0x8c0124). Valid when bit is set, invalid when bit is clear. Implementation type is boolean
  app type cif_0x8c0124_Validity_GPS_Week_t: category=VALUE, compu {phys=raw} "The scaling of CAN input signal Validity_GPS_Week, frame RT_DL1MK3_GPS_Time, 9175332 (0x8c0124). Scaling: WorldValue = BinaryValue []. Unit: The unit "" from the network database is mapped to the AUTOSAR unit NoUnit", range phys 0..1 "The range of CAN input signal Validity_GPS_Week, frame RT_DL1MK3_GPS_Time, 9175332 (0x8c0124). Range (world values): 0.0 ... 1.0 []"  # The type of CAN input signal Validity_GPS_Week, frame RT_DL1MK3_GPS_Time, 9175332 (0x8c0124). Valid when bit is set, invalid when bit is clear. Implementation type is boolean
  app type cif_0x8c0124_Accuracy_GPS_Time_t:  # The type of CAN input signal Accuracy_GPS_Time, frame RT_DL1MK3_GPS_Time, 9175332 (0x8c0124). Implementation type is uint8
    category=VALUE
    compu {phys=raw} "The scaling of CAN input signal Accuracy_GPS_Time, frame RT_DL1MK3_GPS_Time, 9175332 (0x8c0124). Scaling: WorldValue = BinaryValue []. Unit: The unit "" from the network database is mapped to the AUTOSAR unit NoUnit"
    range phys 0..255 "The range of CAN input signal Accuracy_GPS_Time, frame RT_DL1MK3_GPS_Time, 9175332 (0x8c0124). Range (world values): 0.0 ... 255.0 []"
  app type cif_0x8c0124_GPS_Time_t:  # The type of CAN input signal GPS_Time, frame RT_DL1MK3_GPS_Time, 9175332 (0x8c0124). GPS time is the time in seconds since midnight GMT on Saturday night. Implementation type is uint32
    category=VALUE
    compu {phys=raw*0.001; unit s} "The scaling of CAN input signal GPS_Time, frame RT_DL1MK3_GPS_Time, 9175332 (0x8c0124). Scaling: WorldValue = 0.001*BinaryValue + 0.0 [s]. Unit: The unit s from the network database is mapped to the AUTOSAR unit Sec"
    range phys 0..604800 "The range of CAN input signal GPS_Time, frame RT_DL1MK3_GPS_Time, 9175332 (0x8c0124). Range (world values): 0.0 ... 604800.0 [s]"
  app type cif_0x8c0124_GPS_Week_t: category=VALUE, compu {phys=raw} "The scaling of CAN input signal GPS_Week, frame RT_DL1MK3_GPS_Time, 9175332 (0x8c0124). Scaling: WorldValue = BinaryValue []. Unit: The unit "" from the network database is mapped to the AUTOSAR unit NoUnit", range phys 0..65535 "The range of CAN input signal GPS_Week, frame RT_DL1MK3_GPS_Time, 9175332 (0x8c0124). Range (world values): 0.0 ... 65535.0 []"  # The type of CAN input signal GPS_Week, frame RT_DL1MK3_GPS_Time, 9175332 (0x8c0124). Implementation type is uint16
  app type cif_0x8c0324_GPS_Pos_LLH_Longitude_t:  # The type of CAN input signal GPS_Pos_LLH_Longitude, frame RT_DL1MK3_GPS_Pos_LLH_2, 9175844 (0x8c0324). Implementation type is int32
    category=VALUE
    compu {phys=raw*1e-07} "The scaling of CAN input signal GPS_Pos_LLH_Longitude, frame RT_DL1MK3_GPS_Pos_LLH_2, 9175844 (0x8c0324). Scaling: WorldValue = 1.0E-7*BinaryValue + 0.0 [degrees]. Unit: The unit degrees from the network database is mapped to the AUTOSAR unit NoUnit"
    range phys -180..180 "The range of CAN input signal GPS_Pos_LLH_Longitude, frame RT_DL1MK3_GPS_Pos_LLH_2, 9175844 (0x8c0324). Range (world values): -180.0 ... 180.0 [degrees]"
  app type cif_0x8c0324_GPS_Pos_LLH_Altitude_t:  # The type of CAN input signal GPS_Pos_LLH_Altitude, frame RT_DL1MK3_GPS_Pos_LLH_2, 9175844 (0x8c0324). Implementation type is int32
    category=VALUE
    compu {phys=raw*0.001} "The scaling of CAN input signal GPS_Pos_LLH_Altitude, frame RT_DL1MK3_GPS_Pos_LLH_2, 9175844 (0x8c0324). Scaling: WorldValue = 0.001*BinaryValue + 0.0 [m]. Unit: The unit m from the network database is mapped to the AUTOSAR unit NoUnit"
    range phys -1000..100000 "The range of CAN input signal GPS_Pos_LLH_Altitude, frame RT_DL1MK3_GPS_Pos_LLH_2, 9175844 (0x8c0324). Range (world values): -1000.0 ... 100000.0 [m]"
  app type cif_0x8c0224_Validity_GPS_Pos_LLH_Latitude_t:  # The type of CAN input signal Validity_GPS_Pos_LLH_Latitude, frame RT_DL1MK3_GPS_Pos_LLH_1, 9175588 (0x8c0224). Valid when bit is set, invalid when bit is clear. Implementation type is boolean
    category=VALUE
    compu {phys=raw} "The scaling of CAN input signal Validity_GPS_Pos_LLH_Latitude, frame RT_DL1MK3_GPS_Pos_LLH_1, 9175588 (0x8c0224). Scaling: WorldValue = BinaryValue []. Unit: The unit "" from the network database is mapped to the AUTOSAR unit NoUnit"
    range phys 0..1 "The range of CAN input signal Validity_GPS_Pos_LLH_Latitude, frame RT_DL1MK3_GPS_Pos_LLH_1, 9175588 (0x8c0224). Range (world values): 0.0 ... 1.0 []"
  app type cif_0x8c0224_Validity_GPS_Pos_LLH_Longitude_t:  # The type of CAN input signal Validity_GPS_Pos_LLH_Longitude, frame RT_DL1MK3_GPS_Pos_LLH_1, 9175588 (0x8c0224). Valid when bit is set, invalid when bit is clear. Implementation type is boolean
    category=VALUE
    compu {phys=raw} "The scaling of CAN input signal Validity_GPS_Pos_LLH_Longitude, frame RT_DL1MK3_GPS_Pos_LLH_1, 9175588 (0x8c0224). Scaling: WorldValue = BinaryValue []. Unit: The unit "" from the network database is mapped to the AUTOSAR unit NoUnit"
    range phys 0..1 "The range of CAN input signal Validity_GPS_Pos_LLH_Longitude, frame RT_DL1MK3_GPS_Pos_LLH_1, 9175588 (0x8c0224). Range (world values): 0.0 ... 1.0 []"
  app type cif_0x8c0224_Validity_GPS_Pos_LLH_Altitude_t:  # The type of CAN input signal Validity_GPS_Pos_LLH_Altitude, frame RT_DL1MK3_GPS_Pos_LLH_1, 9175588 (0x8c0224). Valid when bit is set, invalid when bit is clear. Implementation type is boolean
    category=VALUE
    compu {phys=raw} "The scaling of CAN input signal Validity_GPS_Pos_LLH_Altitude, frame RT_DL1MK3_GPS_Pos_LLH_1, 9175588 (0x8c0224). Scaling: WorldValue = BinaryValue []. Unit: The unit "" from the network database is mapped to the AUTOSAR unit NoUnit"
    range phys 0..1 "The range of CAN input signal Validity_GPS_Pos_LLH_Altitude, frame RT_DL1MK3_GPS_Pos_LLH_1, 9175588 (0x8c0224). Range (world values): 0.0 ... 1.0 []"
  app type cif_0x8c0224_Accuracy_GPS_Pos_LLH_Latitude_t:  # The type of CAN input signal Accuracy_GPS_Pos_LLH_Latitude, frame RT_DL1MK3_GPS_Pos_LLH_1, 9175588 (0x8c0224). This accuracy value applies to both 2D and 3D GPS speed. Implementation type is uint8
    category=VALUE
    compu {phys=raw} "The scaling of CAN input signal Accuracy_GPS_Pos_LLH_Latitude, frame RT_DL1MK3_GPS_Pos_LLH_1, 9175588 (0x8c0224). Scaling: WorldValue = BinaryValue []. Unit: The unit "" from the network database is mapped to the AUTOSAR unit NoUnit"
    range phys 0..255 "The range of CAN input signal Accuracy_GPS_Pos_LLH_Latitude, frame RT_DL1MK3_GPS_Pos_LLH_1, 9175588 (0x8c0224). Range (world values): 0.0 ... 255.0 []"
  app type cif_0x8c0224_Accuracy_GPS_Pos_LLH_Longitude_t:  # The type of CAN input signal Accuracy_GPS_Pos_LLH_Longitude, frame RT_DL1MK3_GPS_Pos_LLH_1, 9175588 (0x8c0224). This accuracy value applies to both 2D and 3D GPS speed. Implementation type is uint8
    category=VALUE
    compu {phys=raw} "The scaling of CAN input signal Accuracy_GPS_Pos_LLH_Longitude, frame RT_DL1MK3_GPS_Pos_LLH_1, 9175588 (0x8c0224). Scaling: WorldValue = BinaryValue []. Unit: The unit "" from the network database is mapped to the AUTOSAR unit NoUnit"
    range phys 0..255 "The range of CAN input signal Accuracy_GPS_Pos_LLH_Longitude, frame RT_DL1MK3_GPS_Pos_LLH_1, 9175588 (0x8c0224). Range (world values): 0.0 ... 255.0 []"
  app type cif_0x8c0224_Accuracy_GPS_Pos_LLH_Altitude_t:  # The type of CAN input signal Accuracy_GPS_Pos_LLH_Altitude, frame RT_DL1MK3_GPS_Pos_LLH_1, 9175588 (0x8c0224). This accuracy value applies to both 2D and 3D GPS speed. Implementation type is uint8
    category=VALUE
    compu {phys=raw} "The scaling of CAN input signal Accuracy_GPS_Pos_LLH_Altitude, frame RT_DL1MK3_GPS_Pos_LLH_1, 9175588 (0x8c0224). Scaling: WorldValue = BinaryValue []. Unit: The unit "" from the network database is mapped to the AUTOSAR unit NoUnit"
    range phys 0..255 "The range of CAN input signal Accuracy_GPS_Pos_LLH_Altitude, frame RT_DL1MK3_GPS_Pos_LLH_1, 9175588 (0x8c0224). Range (world values): 0.0 ... 255.0 []"
  app type cif_0x8c0224_GPS_Pos_LLH_Latitude_t:  # The type of CAN input signal GPS_Pos_LLH_Latitude, frame RT_DL1MK3_GPS_Pos_LLH_1, 9175588 (0x8c0224). Implementation type is int32
    category=VALUE
    compu {phys=raw*1e-07} "The scaling of CAN input signal GPS_Pos_LLH_Latitude, frame RT_DL1MK3_GPS_Pos_LLH_1, 9175588 (0x8c0224). Scaling: WorldValue = 1.0E-7*BinaryValue + 0.0 [degrees]. Unit: The unit degrees from the network database is mapped to the AUTOSAR unit NoUnit"
    range phys -90..90 "The range of CAN input signal GPS_Pos_LLH_Latitude, frame RT_DL1MK3_GPS_Pos_LLH_1, 9175588 (0x8c0224). Range (world values): -90.0 ... 90.0 [degrees]"
  app type cif_0x4d2_Validity_GPS_Speed_2D_t: category=VALUE, compu {phys=raw} "The scaling of CAN input signal Validity_GPS_Speed_2D, frame RT_DL1MK3_GPS_Speed, 1234 (0x4d2). Scaling: WorldValue = BinaryValue []. Unit: The unit "" from the network database is mapped to the AUTOSAR unit NoUnit", range phys 0..1 "The range of CAN input signal Validity_GPS_Speed_2D, frame RT_DL1MK3_GPS_Speed, 1234 (0x4d2). Range (world values): 0.0 ... 1.0 []"  # The type of CAN input signal Validity_GPS_Speed_2D, frame RT_DL1MK3_GPS_Speed, 1234 (0x4d2). Valid when bit is set, invalid when bit is clear. Implementation type is boolean
  app type cif_0x4d2_Validity_GPS_Speed_3D_t: category=VALUE, compu {phys=raw} "The scaling of CAN input signal Validity_GPS_Speed_3D, frame RT_DL1MK3_GPS_Speed, 1234 (0x4d2). Scaling: WorldValue = BinaryValue []. Unit: The unit "" from the network database is mapped to the AUTOSAR unit NoUnit", range phys 0..1 "The range of CAN input signal Validity_GPS_Speed_3D, frame RT_DL1MK3_GPS_Speed, 1234 (0x4d2). Range (world values): 0.0 ... 1.0 []"  # The type of CAN input signal Validity_GPS_Speed_3D, frame RT_DL1MK3_GPS_Speed, 1234 (0x4d2). Valid when bit is set, invalid when bit is clear. Implementation type is boolean
  app type cif_0x4d2_Accuracy_GPS_Speed_t: category=VALUE, compu {phys=raw} "The scaling of CAN input signal Accuracy_GPS_Speed, frame RT_DL1MK3_GPS_Speed, 1234 (0x4d2). Scaling: WorldValue = BinaryValue []. Unit: The unit "" from the network database is mapped to the AUTOSAR unit NoUnit", range phys 0..255 "The range of CAN input signal Accuracy_GPS_Speed, frame RT_DL1MK3_GPS_Speed, 1234 (0x4d2). Range (world values): 0.0 ... 255.0 []"  # The type of CAN input signal Accuracy_GPS_Speed, frame RT_DL1MK3_GPS_Speed, 1234 (0x4d2). This accuracy value applies to both 2D and 3D GPS speed. Implementation type is uint8
  app type cif_0x4d2_GPS_Speed_2D_t:  # The type of CAN input signal GPS_Speed_2D, frame RT_DL1MK3_GPS_Speed, 1234 (0x4d2). This is GPS scalar 2D speed - scalar speed with no local Z axis component included. Implementation type is uint32
    category=VALUE
    compu {phys=raw*0.0001} "The scaling of CAN input signal GPS_Speed_2D, frame RT_DL1MK3_GPS_Speed, 1234 (0x4d2). Scaling: WorldValue = 1.0E-4*BinaryValue + 0.0 [m/s]. Unit: The unit m/s from the network database is mapped to the AUTOSAR unit NoUnit"
    range phys 0..1675 "The range of CAN input signal GPS_Speed_2D, frame RT_DL1MK3_GPS_Speed, 1234 (0x4d2). Range (world values): 0.0 ... 1675.0 [m/s]"
  app type cif_0x4d2_GPS_Speed_3D_t:  # The type of CAN input signal GPS_Speed_3D, frame RT_DL1MK3_GPS_Speed, 1234 (0x4d2). This is GPS scalar 3D speed - scalar speed with the local Z axis component included. Implementation type is uint32
    category=VALUE
    compu {phys=raw*0.0001} "The scaling of CAN input signal GPS_Speed_3D, frame RT_DL1MK3_GPS_Speed, 1234 (0x4d2). Scaling: WorldValue = 1.0E-4*BinaryValue + 0.0 [m/s]. Unit: The unit m/s from the network database is mapped to the AUTOSAR unit NoUnit"
    range phys 0..1675 "The range of CAN input signal GPS_Speed_3D, frame RT_DL1MK3_GPS_Speed, 1234 (0x4d2). Range (world values): 0.0 ... 1675.0 [m/s]"
  app type cif_0x910725_IR_Temperature_7_t:  # The type of CAN output signal IR_Temperature_7, frame RT_IRTemp_Temp_7, 9504549 (0x910725). Implementation type is int16
    category=VALUE
    compu {phys=raw*0.1} "The scaling of CAN output signal IR_Temperature_7, frame RT_IRTemp_Temp_7, 9504549 (0x910725). Scaling: WorldValue = 0.1*BinaryValue + 0.0 []. Unit: The unit "" from the network database is mapped to the AUTOSAR unit NoUnit"
    range phys 0 "The range of CAN output signal IR_Temperature_7, frame RT_IRTemp_Temp_7, 9504549 (0x910725). Range (world values): 0.0 ... 0.0 []"
  app type cif_0x980825_IR_Temperature_29_t:  # The type of CAN input signal IR_Temperature_29, frame RT_IRTemp_Temp_RR_2, 9963557 (0x980825). Implementation type is int16
    category=VALUE
    compu {phys=raw*0.1} "The scaling of CAN input signal IR_Temperature_29, frame RT_IRTemp_Temp_RR_2, 9963557 (0x980825). Scaling: WorldValue = 0.1*BinaryValue + 0.0 []. Unit: The unit "" from the network database is mapped to the AUTOSAR unit NoUnit"
    range phys 0 "The range of CAN input signal IR_Temperature_29, frame RT_IRTemp_Temp_RR_2, 9963557 (0x980825). Range (world values): 0.0 ... 0.0 []"
  app type cif_0x980825_IR_Temperature_30_t:  # The type of CAN input signal IR_Temperature_30, frame RT_IRTemp_Temp_RR_2, 9963557 (0x980825). Implementation type is int16
    category=VALUE
    compu {phys=raw*0.1} "The scaling of CAN input signal IR_Temperature_30, frame RT_IRTemp_Temp_RR_2, 9963557 (0x980825). Scaling: WorldValue = 0.1*BinaryValue + 0.0 []. Unit: The unit "" from the network database is mapped to the AUTOSAR unit NoUnit"
    range phys 0 "The range of CAN input signal IR_Temperature_30, frame RT_IRTemp_Temp_RR_2, 9963557 (0x980825). Range (world values): 0.0 ... 0.0 []"
  app type cif_0x980825_IR_Temperature_31_t:  # The type of CAN input signal IR_Temperature_31, frame RT_IRTemp_Temp_RR_2, 9963557 (0x980825). Implementation type is int16
    category=VALUE
    compu {phys=raw*0.1} "The scaling of CAN input signal IR_Temperature_31, frame RT_IRTemp_Temp_RR_2, 9963557 (0x980825). Scaling: WorldValue = 0.1*BinaryValue + 0.0 []. Unit: The unit "" from the network database is mapped to the AUTOSAR unit NoUnit"
    range phys 0 "The range of CAN input signal IR_Temperature_31, frame RT_IRTemp_Temp_RR_2, 9963557 (0x980825). Range (world values): 0.0 ... 0.0 []"
  app type cif_0x980825_IR_Temperature_32_t:  # The type of CAN input signal IR_Temperature_32, frame RT_IRTemp_Temp_RR_2, 9963557 (0x980825). Implementation type is int16
    category=VALUE
    compu {phys=raw*0.1} "The scaling of CAN input signal IR_Temperature_32, frame RT_IRTemp_Temp_RR_2, 9963557 (0x980825). Scaling: WorldValue = 0.1*BinaryValue + 0.0 []. Unit: The unit "" from the network database is mapped to the AUTOSAR unit NoUnit"
    range phys 0 "The range of CAN input signal IR_Temperature_32, frame RT_IRTemp_Temp_RR_2, 9963557 (0x980825). Range (world values): 0.0 ... 0.0 []"
  app type cif_0x980625_IR_Temperature_21_t:  # The type of CAN output signal IR_Temperature_21, frame RT_IRTemp_Temp_RL_2, 9963045 (0x980625). Implementation type is int16
    category=VALUE
    compu {phys=raw*0.1} "The scaling of CAN output signal IR_Temperature_21, frame RT_IRTemp_Temp_RL_2, 9963045 (0x980625). Scaling: WorldValue = 0.1*BinaryValue + 0.0 []. Unit: The unit "" from the network database is mapped to the AUTOSAR unit NoUnit"
    range phys 0 "The range of CAN output signal IR_Temperature_21, frame RT_IRTemp_Temp_RL_2, 9963045 (0x980625). Range (world values): 0.0 ... 0.0 []"
  app type cif_0x980625_IR_Temperature_22_t:  # The type of CAN output signal IR_Temperature_22, frame RT_IRTemp_Temp_RL_2, 9963045 (0x980625). Implementation type is int16
    category=VALUE
    compu {phys=raw*0.1} "The scaling of CAN output signal IR_Temperature_22, frame RT_IRTemp_Temp_RL_2, 9963045 (0x980625). Scaling: WorldValue = 0.1*BinaryValue + 0.0 []. Unit: The unit "" from the network database is mapped to the AUTOSAR unit NoUnit"
    range phys 0 "The range of CAN output signal IR_Temperature_22, frame RT_IRTemp_Temp_RL_2, 9963045 (0x980625). Range (world values): 0.0 ... 0.0 []"
  app type cif_0x980625_IR_Temperature_23_t:  # The type of CAN output signal IR_Temperature_23, frame RT_IRTemp_Temp_RL_2, 9963045 (0x980625). Implementation type is int16
    category=VALUE
    compu {phys=raw*0.1} "The scaling of CAN output signal IR_Temperature_23, frame RT_IRTemp_Temp_RL_2, 9963045 (0x980625). Scaling: WorldValue = 0.1*BinaryValue + 0.0 []. Unit: The unit "" from the network database is mapped to the AUTOSAR unit NoUnit"
    range phys 0 "The range of CAN output signal IR_Temperature_23, frame RT_IRTemp_Temp_RL_2, 9963045 (0x980625). Range (world values): 0.0 ... 0.0 []"
  app type cif_0x980625_IR_Temperature_24_t:  # The type of CAN output signal IR_Temperature_24, frame RT_IRTemp_Temp_RL_2, 9963045 (0x980625). Implementation type is int16
    category=VALUE
    compu {phys=raw*0.1} "The scaling of CAN output signal IR_Temperature_24, frame RT_IRTemp_Temp_RL_2, 9963045 (0x980625). Scaling: WorldValue = 0.1*BinaryValue + 0.0 []. Unit: The unit "" from the network database is mapped to the AUTOSAR unit NoUnit"
    range phys 0 "The range of CAN output signal IR_Temperature_24, frame RT_IRTemp_Temp_RL_2, 9963045 (0x980625). Range (world values): 0.0 ... 0.0 []"
  app type cif_0x980425_IR_Temperature_13_t:  # The type of CAN output signal IR_Temperature_13, frame RT_IRTemp_Temp_FR_2, 9962533 (0x980425). Implementation type is int16
    category=VALUE
    compu {phys=raw*0.1} "The scaling of CAN output signal IR_Temperature_13, frame RT_IRTemp_Temp_FR_2, 9962533 (0x980425). Scaling: WorldValue = 0.1*BinaryValue + 0.0 []. Unit: The unit "" from the network database is mapped to the AUTOSAR unit NoUnit"
    range phys 0 "The range of CAN output signal IR_Temperature_13, frame RT_IRTemp_Temp_FR_2, 9962533 (0x980425). Range (world values): 0.0 ... 0.0 []"
  app type cif_0x980425_IR_Temperature_14_t:  # The type of CAN output signal IR_Temperature_14, frame RT_IRTemp_Temp_FR_2, 9962533 (0x980425). Implementation type is int16
    category=VALUE
    compu {phys=raw*0.1} "The scaling of CAN output signal IR_Temperature_14, frame RT_IRTemp_Temp_FR_2, 9962533 (0x980425). Scaling: WorldValue = 0.1*BinaryValue + 0.0 []. Unit: The unit "" from the network database is mapped to the AUTOSAR unit NoUnit"
    range phys 0 "The range of CAN output signal IR_Temperature_14, frame RT_IRTemp_Temp_FR_2, 9962533 (0x980425). Range (world values): 0.0 ... 0.0 []"
  app type cif_0x980425_IR_Temperature_15_t:  # The type of CAN output signal IR_Temperature_15, frame RT_IRTemp_Temp_FR_2, 9962533 (0x980425). Implementation type is int16
    category=VALUE
    compu {phys=raw*0.1} "The scaling of CAN output signal IR_Temperature_15, frame RT_IRTemp_Temp_FR_2, 9962533 (0x980425). Scaling: WorldValue = 0.1*BinaryValue + 0.0 []. Unit: The unit "" from the network database is mapped to the AUTOSAR unit NoUnit"
    range phys 0 "The range of CAN output signal IR_Temperature_15, frame RT_IRTemp_Temp_FR_2, 9962533 (0x980425). Range (world values): 0.0 ... 0.0 []"
  app type cif_0x980425_IR_Temperature_16_t:  # The type of CAN output signal IR_Temperature_16, frame RT_IRTemp_Temp_FR_2, 9962533 (0x980425). Implementation type is int16
    category=VALUE
    compu {phys=raw*0.1} "The scaling of CAN output signal IR_Temperature_16, frame RT_IRTemp_Temp_FR_2, 9962533 (0x980425). Scaling: WorldValue = 0.1*BinaryValue + 0.0 []. Unit: The unit "" from the network database is mapped to the AUTOSAR unit NoUnit"
    range phys 0 "The range of CAN output signal IR_Temperature_16, frame RT_IRTemp_Temp_FR_2, 9962533 (0x980425). Range (world values): 0.0 ... 0.0 []"
  app type cif_0x980225_IR_Temperature_5_t:  # The type of CAN input signal IR_Temperature_5, frame RT_IRTemp_Temp_FL_2, 9962021 (0x980225). Implementation type is int16
    category=VALUE
    compu {phys=raw*0.1} "The scaling of CAN input signal IR_Temperature_5, frame RT_IRTemp_Temp_FL_2, 9962021 (0x980225). Scaling: WorldValue = 0.1*BinaryValue + 0.0 []. Unit: The unit "" from the network database is mapped to the AUTOSAR unit NoUnit"
    range phys 0 "The range of CAN input signal IR_Temperature_5, frame RT_IRTemp_Temp_FL_2, 9962021 (0x980225). Range (world values): 0.0 ... 0.0 []"
  app type cif_0x980225_IR_Temperature_6_t:  # The type of CAN input signal IR_Temperature_6, frame RT_IRTemp_Temp_FL_2, 9962021 (0x980225). Implementation type is int16
    category=VALUE
    compu {phys=raw*0.1} "The scaling of CAN input signal IR_Temperature_6, frame RT_IRTemp_Temp_FL_2, 9962021 (0x980225). Scaling: WorldValue = 0.1*BinaryValue + 0.0 []. Unit: The unit "" from the network database is mapped to the AUTOSAR unit NoUnit"
    range phys 0 "The range of CAN input signal IR_Temperature_6, frame RT_IRTemp_Temp_FL_2, 9962021 (0x980225). Range (world values): 0.0 ... 0.0 []"
  app type cif_0x980225_IR_Temperature_7_t:  # The type of CAN input signal IR_Temperature_7, frame RT_IRTemp_Temp_FL_2, 9962021 (0x980225). Implementation type is int16
    category=VALUE
    compu {phys=raw*0.1} "The scaling of CAN input signal IR_Temperature_7, frame RT_IRTemp_Temp_FL_2, 9962021 (0x980225). Scaling: WorldValue = 0.1*BinaryValue + 0.0 []. Unit: The unit "" from the network database is mapped to the AUTOSAR unit NoUnit"
    range phys 0 "The range of CAN input signal IR_Temperature_7, frame RT_IRTemp_Temp_FL_2, 9962021 (0x980225). Range (world values): 0.0 ... 0.0 []"
  app type cif_0x980225_IR_Temperature_8_t:  # The type of CAN input signal IR_Temperature_8, frame RT_IRTemp_Temp_FL_2, 9962021 (0x980225). Implementation type is int16
    category=VALUE
    compu {phys=raw*0.1} "The scaling of CAN input signal IR_Temperature_8, frame RT_IRTemp_Temp_FL_2, 9962021 (0x980225). Scaling: WorldValue = 0.1*BinaryValue + 0.0 []. Unit: The unit "" from the network database is mapped to the AUTOSAR unit NoUnit"
    range phys 0 "The range of CAN input signal IR_Temperature_8, frame RT_IRTemp_Temp_FL_2, 9962021 (0x980225). Range (world values): 0.0 ... 0.0 []"
  app type cif_0x980725_IR_Temperature_25_t:  # The type of CAN input signal IR_Temperature_25, frame RT_IRTemp_Temp_RR_1, 9963301 (0x980725). Implementation type is int16
    category=VALUE
    compu {phys=raw*0.1} "The scaling of CAN input signal IR_Temperature_25, frame RT_IRTemp_Temp_RR_1, 9963301 (0x980725). Scaling: WorldValue = 0.1*BinaryValue + 0.0 []. Unit: The unit "" from the network database is mapped to the AUTOSAR unit NoUnit"
    range phys 0 "The range of CAN input signal IR_Temperature_25, frame RT_IRTemp_Temp_RR_1, 9963301 (0x980725). Range (world values): 0.0 ... 0.0 []"
  app type cif_0x980725_IR_Temperature_26_t:  # The type of CAN input signal IR_Temperature_26, frame RT_IRTemp_Temp_RR_1, 9963301 (0x980725). Implementation type is int16
    category=VALUE
    compu {phys=raw*0.1} "The scaling of CAN input signal IR_Temperature_26, frame RT_IRTemp_Temp_RR_1, 9963301 (0x980725). Scaling: WorldValue = 0.1*BinaryValue + 0.0 []. Unit: The unit "" from the network database is mapped to the AUTOSAR unit NoUnit"
    range phys 0 "The range of CAN input signal IR_Temperature_26, frame RT_IRTemp_Temp_RR_1, 9963301 (0x980725). Range (world values): 0.0 ... 0.0 []"
  app type cif_0x980725_IR_Temperature_27_t:  # The type of CAN input signal IR_Temperature_27, frame RT_IRTemp_Temp_RR_1, 9963301 (0x980725). Implementation type is int16
    category=VALUE
    compu {phys=raw*0.1} "The scaling of CAN input signal IR_Temperature_27, frame RT_IRTemp_Temp_RR_1, 9963301 (0x980725). Scaling: WorldValue = 0.1*BinaryValue + 0.0 []. Unit: The unit "" from the network database is mapped to the AUTOSAR unit NoUnit"
    range phys 0 "The range of CAN input signal IR_Temperature_27, frame RT_IRTemp_Temp_RR_1, 9963301 (0x980725). Range (world values): 0.0 ... 0.0 []"
  app type cif_0x980725_IR_Temperature_28_t:  # The type of CAN input signal IR_Temperature_28, frame RT_IRTemp_Temp_RR_1, 9963301 (0x980725). Implementation type is int16
    category=VALUE
    compu {phys=raw*0.1} "The scaling of CAN input signal IR_Temperature_28, frame RT_IRTemp_Temp_RR_1, 9963301 (0x980725). Scaling: WorldValue = 0.1*BinaryValue + 0.0 []. Unit: The unit "" from the network database is mapped to the AUTOSAR unit NoUnit"
    range phys 0 "The range of CAN input signal IR_Temperature_28, frame RT_IRTemp_Temp_RR_1, 9963301 (0x980725). Range (world values): 0.0 ... 0.0 []"
  app type cif_0x980525_IR_Temperature_17_t:  # The type of CAN input signal IR_Temperature_17, frame RT_IRTemp_Temp_RL_1, 9962789 (0x980525). Implementation type is int16
    category=VALUE
    compu {phys=raw*0.1} "The scaling of CAN input signal IR_Temperature_17, frame RT_IRTemp_Temp_RL_1, 9962789 (0x980525). Scaling: WorldValue = 0.1*BinaryValue + 0.0 []. Unit: The unit "" from the network database is mapped to the AUTOSAR unit NoUnit"
    range phys 0 "The range of CAN input signal IR_Temperature_17, frame RT_IRTemp_Temp_RL_1, 9962789 (0x980525). Range (world values): 0.0 ... 0.0 []"
  app type cif_0x980525_IR_Temperature_18_t:  # The type of CAN input signal IR_Temperature_18, frame RT_IRTemp_Temp_RL_1, 9962789 (0x980525). Implementation type is int16
    category=VALUE
    compu {phys=raw*0.1} "The scaling of CAN input signal IR_Temperature_18, frame RT_IRTemp_Temp_RL_1, 9962789 (0x980525). Scaling: WorldValue = 0.1*BinaryValue + 0.0 []. Unit: The unit "" from the network database is mapped to the AUTOSAR unit NoUnit"
    range phys 0 "The range of CAN input signal IR_Temperature_18, frame RT_IRTemp_Temp_RL_1, 9962789 (0x980525). Range (world values): 0.0 ... 0.0 []"
  app type cif_0x980525_IR_Temperature_19_t:  # The type of CAN input signal IR_Temperature_19, frame RT_IRTemp_Temp_RL_1, 9962789 (0x980525). Implementation type is int16
    category=VALUE
    compu {phys=raw*0.1} "The scaling of CAN input signal IR_Temperature_19, frame RT_IRTemp_Temp_RL_1, 9962789 (0x980525). Scaling: WorldValue = 0.1*BinaryValue + 0.0 []. Unit: The unit "" from the network database is mapped to the AUTOSAR unit NoUnit"
    range phys 0 "The range of CAN input signal IR_Temperature_19, frame RT_IRTemp_Temp_RL_1, 9962789 (0x980525). Range (world values): 0.0 ... 0.0 []"
  app type cif_0x980525_IR_Temperature_20_t:  # The type of CAN input signal IR_Temperature_20, frame RT_IRTemp_Temp_RL_1, 9962789 (0x980525). Implementation type is int16
    category=VALUE
    compu {phys=raw*0.1} "The scaling of CAN input signal IR_Temperature_20, frame RT_IRTemp_Temp_RL_1, 9962789 (0x980525). Scaling: WorldValue = 0.1*BinaryValue + 0.0 []. Unit: The unit "" from the network database is mapped to the AUTOSAR unit NoUnit"
    range phys 0 "The range of CAN input signal IR_Temperature_20, frame RT_IRTemp_Temp_RL_1, 9962789 (0x980525). Range (world values): 0.0 ... 0.0 []"
  app type cif_0x980325_IR_Temperature_9_t:  # The type of CAN input signal IR_Temperature_9, frame RT_IRTemp_Temp_FR_1, 9962277 (0x980325). Implementation type is int16
    category=VALUE
    compu {phys=raw*0.1} "The scaling of CAN input signal IR_Temperature_9, frame RT_IRTemp_Temp_FR_1, 9962277 (0x980325). Scaling: WorldValue = 0.1*BinaryValue + 0.0 []. Unit: The unit "" from the network database is mapped to the AUTOSAR unit NoUnit"
    range phys 0 "The range of CAN input signal IR_Temperature_9, frame RT_IRTemp_Temp_FR_1, 9962277 (0x980325). Range (world values): 0.0 ... 0.0 []"
  app type cif_0x980325_IR_Temperature_10_t:  # The type of CAN input signal IR_Temperature_10, frame RT_IRTemp_Temp_FR_1, 9962277 (0x980325). Implementation type is int16
    category=VALUE
    compu {phys=raw*0.1} "The scaling of CAN input signal IR_Temperature_10, frame RT_IRTemp_Temp_FR_1, 9962277 (0x980325). Scaling: WorldValue = 0.1*BinaryValue + 0.0 []. Unit: The unit "" from the network database is mapped to the AUTOSAR unit NoUnit"
    range phys 0 "The range of CAN input signal IR_Temperature_10, frame RT_IRTemp_Temp_FR_1, 9962277 (0x980325). Range (world values): 0.0 ... 0.0 []"
  app type cif_0x980325_IR_Temperature_11_t:  # The type of CAN input signal IR_Temperature_11, frame RT_IRTemp_Temp_FR_1, 9962277 (0x980325). Implementation type is int16
    category=VALUE
    compu {phys=raw*0.1} "The scaling of CAN input signal IR_Temperature_11, frame RT_IRTemp_Temp_FR_1, 9962277 (0x980325). Scaling: WorldValue = 0.1*BinaryValue + 0.0 []. Unit: The unit "" from the network database is mapped to the AUTOSAR unit NoUnit"
    range phys 0 "The range of CAN input signal IR_Temperature_11, frame RT_IRTemp_Temp_FR_1, 9962277 (0x980325). Range (world values): 0.0 ... 0.0 []"
  app type cif_0x980325_IR_Temperature_12_t:  # The type of CAN input signal IR_Temperature_12, frame RT_IRTemp_Temp_FR_1, 9962277 (0x980325). Implementation type is int16
    category=VALUE
    compu {phys=raw*0.1} "The scaling of CAN input signal IR_Temperature_12, frame RT_IRTemp_Temp_FR_1, 9962277 (0x980325). Scaling: WorldValue = 0.1*BinaryValue + 0.0 []. Unit: The unit "" from the network database is mapped to the AUTOSAR unit NoUnit"
    range phys 0 "The range of CAN input signal IR_Temperature_12, frame RT_IRTemp_Temp_FR_1, 9962277 (0x980325). Range (world values): 0.0 ... 0.0 []"
  app type cif_0x980125_IR_Temperature_1_t:  # The type of CAN input signal IR_Temperature_1, frame RT_IRTemp_Temp_FL_1, 9961765 (0x980125). Implementation type is int16
    category=VALUE
    compu {phys=raw*0.1} "The scaling of CAN input signal IR_Temperature_1, frame RT_IRTemp_Temp_FL_1, 9961765 (0x980125). Scaling: WorldValue = 0.1*BinaryValue + 0.0 []. Unit: The unit "" from the network database is mapped to the AUTOSAR unit NoUnit"
    range phys 0 "The range of CAN input signal IR_Temperature_1, frame RT_IRTemp_Temp_FL_1, 9961765 (0x980125). Range (world values): 0.0 ... 0.0 []"
  app type cif_0x980125_IR_Temperature_2_t:  # The type of CAN input signal IR_Temperature_2, frame RT_IRTemp_Temp_FL_1, 9961765 (0x980125). Implementation type is int16
    category=VALUE
    compu {phys=raw*0.1} "The scaling of CAN input signal IR_Temperature_2, frame RT_IRTemp_Temp_FL_1, 9961765 (0x980125). Scaling: WorldValue = 0.1*BinaryValue + 0.0 []. Unit: The unit "" from the network database is mapped to the AUTOSAR unit NoUnit"
    range phys 0 "The range of CAN input signal IR_Temperature_2, frame RT_IRTemp_Temp_FL_1, 9961765 (0x980125). Range (world values): 0.0 ... 0.0 []"
  app type cif_0x980125_IR_Temperature_3_t:  # The type of CAN input signal IR_Temperature_3, frame RT_IRTemp_Temp_FL_1, 9961765 (0x980125). Implementation type is int16
    category=VALUE
    compu {phys=raw*0.1} "The scaling of CAN input signal IR_Temperature_3, frame RT_IRTemp_Temp_FL_1, 9961765 (0x980125). Scaling: WorldValue = 0.1*BinaryValue + 0.0 []. Unit: The unit "" from the network database is mapped to the AUTOSAR unit NoUnit"
    range phys 0 "The range of CAN input signal IR_Temperature_3, frame RT_IRTemp_Temp_FL_1, 9961765 (0x980125). Range (world values): 0.0 ... 0.0 []"
  app type cif_0x980125_IR_Temperature_4_t:  # The type of CAN input signal IR_Temperature_4, frame RT_IRTemp_Temp_FL_1, 9961765 (0x980125). Implementation type is int16
    category=VALUE
    compu {phys=raw*0.1} "The scaling of CAN input signal IR_Temperature_4, frame RT_IRTemp_Temp_FL_1, 9961765 (0x980125). Scaling: WorldValue = 0.1*BinaryValue + 0.0 []. Unit: The unit "" from the network database is mapped to the AUTOSAR unit NoUnit"
    range phys 0 "The range of CAN input signal IR_Temperature_4, frame RT_IRTemp_Temp_FL_1, 9961765 (0x980125). Range (world values): 0.0 ... 0.0 []"
  app type cif_0x912025_IR_Temperature_32_t:  # The type of CAN input signal IR_Temperature_32, frame RT_IRTemp_Temp_32, 9510949 (0x912025). Implementation type is int16
    category=VALUE
    compu {phys=raw*0.1} "The scaling of CAN input signal IR_Temperature_32, frame RT_IRTemp_Temp_32, 9510949 (0x912025). Scaling: WorldValue = 0.1*BinaryValue + 0.0 []. Unit: The unit "" from the network database is mapped to the AUTOSAR unit NoUnit"
    range phys 0 "The range of CAN input signal IR_Temperature_32, frame RT_IRTemp_Temp_32, 9510949 (0x912025). Range (world values): 0.0 ... 0.0 []"
  app type cif_0x911f25_IR_Temperature_31_t:  # The type of CAN input signal IR_Temperature_31, frame RT_IRTemp_Temp_31, 9510693 (0x911f25). Implementation type is int16
    category=VALUE
    compu {phys=raw*0.1} "The scaling of CAN input signal IR_Temperature_31, frame RT_IRTemp_Temp_31, 9510693 (0x911f25). Scaling: WorldValue = 0.1*BinaryValue + 0.0 []. Unit: The unit "" from the network database is mapped to the AUTOSAR unit NoUnit"
    range phys 0 "The range of CAN input signal IR_Temperature_31, frame RT_IRTemp_Temp_31, 9510693 (0x911f25). Range (world values): 0.0 ... 0.0 []"
  app type cif_0x911e25_IR_Temperature_30_t:  # The type of CAN output signal IR_Temperature_30, frame RT_IRTemp_Temp_30, 9510437 (0x911e25). Implementation type is int16
    category=VALUE
    compu {phys=raw*0.1} "The scaling of CAN output signal IR_Temperature_30, frame RT_IRTemp_Temp_30, 9510437 (0x911e25). Scaling: WorldValue = 0.1*BinaryValue + 0.0 []. Unit: The unit "" from the network database is mapped to the AUTOSAR unit NoUnit"
    range phys 0 "The range of CAN output signal IR_Temperature_30, frame RT_IRTemp_Temp_30, 9510437 (0x911e25). Range (world values): 0.0 ... 0.0 []"
  app type cif_0x911d25_IR_Temperature_29_t:  # The type of CAN input signal IR_Temperature_29, frame RT_IRTemp_Temp_29, 9510181 (0x911d25). Implementation type is int16
    category=VALUE
    compu {phys=raw*0.1} "The scaling of CAN input signal IR_Temperature_29, frame RT_IRTemp_Temp_29, 9510181 (0x911d25). Scaling: WorldValue = 0.1*BinaryValue + 0.0 []. Unit: The unit "" from the network database is mapped to the AUTOSAR unit NoUnit"
    range phys 0 "The range of CAN input signal IR_Temperature_29, frame RT_IRTemp_Temp_29, 9510181 (0x911d25). Range (world values): 0.0 ... 0.0 []"
  app type cif_0x911c25_IR_Temperature_28_t:  # The type of CAN input signal IR_Temperature_28, frame RT_IRTemp_Temp_28, 9509925 (0x911c25). Implementation type is int16
    category=VALUE
    compu {phys=raw*0.1} "The scaling of CAN input signal IR_Temperature_28, frame RT_IRTemp_Temp_28, 9509925 (0x911c25). Scaling: WorldValue = 0.1*BinaryValue + 0.0 []. Unit: The unit "" from the network database is mapped to the AUTOSAR unit NoUnit"
    range phys 0 "The range of CAN input signal IR_Temperature_28, frame RT_IRTemp_Temp_28, 9509925 (0x911c25). Range (world values): 0.0 ... 0.0 []"
  app type cif_0x911b25_IR_Temperature_27_t:  # The type of CAN input signal IR_Temperature_27, frame RT_IRTemp_Temp_27, 9509669 (0x911b25). Implementation type is int16
    category=VALUE
    compu {phys=raw*0.1} "The scaling of CAN input signal IR_Temperature_27, frame RT_IRTemp_Temp_27, 9509669 (0x911b25). Scaling: WorldValue = 0.1*BinaryValue + 0.0 []. Unit: The unit "" from the network database is mapped to the AUTOSAR unit NoUnit"
    range phys 0 "The range of CAN input signal IR_Temperature_27, frame RT_IRTemp_Temp_27, 9509669 (0x911b25). Range (world values): 0.0 ... 0.0 []"
  app type cif_0x911a25_IR_Temperature_26_t:  # The type of CAN output signal IR_Temperature_26, frame RT_IRTemp_Temp_26, 9509413 (0x911a25). Implementation type is int16
    category=VALUE
    compu {phys=raw*0.1} "The scaling of CAN output signal IR_Temperature_26, frame RT_IRTemp_Temp_26, 9509413 (0x911a25). Scaling: WorldValue = 0.1*BinaryValue + 0.0 []. Unit: The unit "" from the network database is mapped to the AUTOSAR unit NoUnit"
    range phys 0 "The range of CAN output signal IR_Temperature_26, frame RT_IRTemp_Temp_26, 9509413 (0x911a25). Range (world values): 0.0 ... 0.0 []"
  app type cif_0x911925_IR_Temperature_25_t:  # The type of CAN input signal IR_Temperature_25, frame RT_IRTemp_Temp_25, 9509157 (0x911925). Implementation type is int16
    category=VALUE
    compu {phys=raw*0.1} "The scaling of CAN input signal IR_Temperature_25, frame RT_IRTemp_Temp_25, 9509157 (0x911925). Scaling: WorldValue = 0.1*BinaryValue + 0.0 []. Unit: The unit "" from the network database is mapped to the AUTOSAR unit NoUnit"
    range phys 0 "The range of CAN input signal IR_Temperature_25, frame RT_IRTemp_Temp_25, 9509157 (0x911925). Range (world values): 0.0 ... 0.0 []"
  app type cif_0x911825_IR_Temperature_24_t:  # The type of CAN input signal IR_Temperature_24, frame RT_IRTemp_Temp_24, 9508901 (0x911825). Implementation type is int16
    category=VALUE
    compu {phys=raw*0.1} "The scaling of CAN input signal IR_Temperature_24, frame RT_IRTemp_Temp_24, 9508901 (0x911825). Scaling: WorldValue = 0.1*BinaryValue + 0.0 []. Unit: The unit "" from the network database is mapped to the AUTOSAR unit NoUnit"
    range phys 0 "The range of CAN input signal IR_Temperature_24, frame RT_IRTemp_Temp_24, 9508901 (0x911825). Range (world values): 0.0 ... 0.0 []"
  app type cif_0x911625_IR_Temperature_22_t:  # The type of CAN input signal IR_Temperature_22, frame RT_IRTemp_Temp_22, 9508389 (0x911625). Implementation type is int16
    category=VALUE
    compu {phys=raw*0.1} "The scaling of CAN input signal IR_Temperature_22, frame RT_IRTemp_Temp_22, 9508389 (0x911625). Scaling: WorldValue = 0.1*BinaryValue + 0.0 []. Unit: The unit "" from the network database is mapped to the AUTOSAR unit NoUnit"
    range phys 0 "The range of CAN input signal IR_Temperature_22, frame RT_IRTemp_Temp_22, 9508389 (0x911625). Range (world values): 0.0 ... 0.0 []"
  app type cif_0x911725_IR_Temperature_23_t:  # The type of CAN input signal IR_Temperature_23, frame RT_IRTemp_Temp_23, 9508645 (0x911725). Implementation type is int16
    category=VALUE
    compu {phys=raw*0.1} "The scaling of CAN input signal IR_Temperature_23, frame RT_IRTemp_Temp_23, 9508645 (0x911725). Scaling: WorldValue = 0.1*BinaryValue + 0.0 []. Unit: The unit "" from the network database is mapped to the AUTOSAR unit NoUnit"
    range phys 0 "The range of CAN input signal IR_Temperature_23, frame RT_IRTemp_Temp_23, 9508645 (0x911725). Range (world values): 0.0 ... 0.0 []"
  app type cif_0x911525_IR_Temperature_21_t:  # The type of CAN input signal IR_Temperature_21, frame RT_IRTemp_Temp_21, 9508133 (0x911525). Implementation type is int16
    category=VALUE
    compu {phys=raw*0.1} "The scaling of CAN input signal IR_Temperature_21, frame RT_IRTemp_Temp_21, 9508133 (0x911525). Scaling: WorldValue = 0.1*BinaryValue + 0.0 []. Unit: The unit "" from the network database is mapped to the AUTOSAR unit NoUnit"
    range phys 0 "The range of CAN input signal IR_Temperature_21, frame RT_IRTemp_Temp_21, 9508133 (0x911525). Range (world values): 0.0 ... 0.0 []"
  app type cif_0x911425_IR_Temperature_20_t:  # The type of CAN input signal IR_Temperature_20, frame RT_IRTemp_Temp_20, 9507877 (0x911425). Implementation type is int16
    category=VALUE
    compu {phys=raw*0.1} "The scaling of CAN input signal IR_Temperature_20, frame RT_IRTemp_Temp_20, 9507877 (0x911425). Scaling: WorldValue = 0.1*BinaryValue + 0.0 []. Unit: The unit "" from the network database is mapped to the AUTOSAR unit NoUnit"
    range phys 0 "The range of CAN input signal IR_Temperature_20, frame RT_IRTemp_Temp_20, 9507877 (0x911425). Range (world values): 0.0 ... 0.0 []"
  app type cif_0x911325_IR_Temperature_19_t:  # The type of CAN input signal IR_Temperature_19, frame RT_IRTemp_Temp_19, 9507621 (0x911325). Implementation type is int16
    category=VALUE
    compu {phys=raw*0.1} "The scaling of CAN input signal IR_Temperature_19, frame RT_IRTemp_Temp_19, 9507621 (0x911325). Scaling: WorldValue = 0.1*BinaryValue + 0.0 []. Unit: The unit "" from the network database is mapped to the AUTOSAR unit NoUnit"
    range phys 0 "The range of CAN input signal IR_Temperature_19, frame RT_IRTemp_Temp_19, 9507621 (0x911325). Range (world values): 0.0 ... 0.0 []"
  app type cif_0x911225_IR_Temperature_18_t:  # The type of CAN input signal IR_Temperature_18, frame RT_IRTemp_Temp_18, 9507365 (0x911225). Implementation type is int16
    category=VALUE
    compu {phys=raw*0.1} "The scaling of CAN input signal IR_Temperature_18, frame RT_IRTemp_Temp_18, 9507365 (0x911225). Scaling: WorldValue = 0.1*BinaryValue + 0.0 []. Unit: The unit "" from the network database is mapped to the AUTOSAR unit NoUnit"
    range phys 0 "The range of CAN input signal IR_Temperature_18, frame RT_IRTemp_Temp_18, 9507365 (0x911225). Range (world values): 0.0 ... 0.0 []"
  app type cif_0x911025_IR_Temperature_16_t:  # The type of CAN input signal IR_Temperature_16, frame RT_IRTemp_Temp_16, 9506853 (0x911025). Implementation type is int16
    category=VALUE
    compu {phys=raw*0.1} "The scaling of CAN input signal IR_Temperature_16, frame RT_IRTemp_Temp_16, 9506853 (0x911025). Scaling: WorldValue = 0.1*BinaryValue + 0.0 []. Unit: The unit "" from the network database is mapped to the AUTOSAR unit NoUnit"
    range phys 0 "The range of CAN input signal IR_Temperature_16, frame RT_IRTemp_Temp_16, 9506853 (0x911025). Range (world values): 0.0 ... 0.0 []"
  app type cif_0x910f25_IR_Temperature_15_t:  # The type of CAN input signal IR_Temperature_15, frame RT_IRTemp_Temp_15, 9506597 (0x910f25). Implementation type is int16
    category=VALUE
    compu {phys=raw*0.1} "The scaling of CAN input signal IR_Temperature_15, frame RT_IRTemp_Temp_15, 9506597 (0x910f25). Scaling: WorldValue = 0.1*BinaryValue + 0.0 []. Unit: The unit "" from the network database is mapped to the AUTOSAR unit NoUnit"
    range phys 0 "The range of CAN input signal IR_Temperature_15, frame RT_IRTemp_Temp_15, 9506597 (0x910f25). Range (world values): 0.0 ... 0.0 []"
  app type cif_0x910e25_IR_Temperature_14_t:  # The type of CAN input signal IR_Temperature_14, frame RT_IRTemp_Temp_14, 9506341 (0x910e25). Implementation type is int16
    category=VALUE
    compu {phys=raw*0.1} "The scaling of CAN input signal IR_Temperature_14, frame RT_IRTemp_Temp_14, 9506341 (0x910e25). Scaling: WorldValue = 0.1*BinaryValue + 0.0 []. Unit: The unit "" from the network database is mapped to the AUTOSAR unit NoUnit"
    range phys 0 "The range of CAN input signal IR_Temperature_14, frame RT_IRTemp_Temp_14, 9506341 (0x910e25). Range (world values): 0.0 ... 0.0 []"
  app type cif_0x910d25_IR_Temperature_13_t:  # The type of CAN input signal IR_Temperature_13, frame RT_IRTemp_Temp_13, 9506085 (0x910d25). Implementation type is int16
    category=VALUE
    compu {phys=raw*0.1} "The scaling of CAN input signal IR_Temperature_13, frame RT_IRTemp_Temp_13, 9506085 (0x910d25). Scaling: WorldValue = 0.1*BinaryValue + 0.0 []. Unit: The unit "" from the network database is mapped to the AUTOSAR unit NoUnit"
    range phys 0 "The range of CAN input signal IR_Temperature_13, frame RT_IRTemp_Temp_13, 9506085 (0x910d25). Range (world values): 0.0 ... 0.0 []"
  app type cif_0x910c25_IR_Temperature_12_t:  # The type of CAN input signal IR_Temperature_12, frame RT_IRTemp_Temp_12, 9505829 (0x910c25). Implementation type is int16
    category=VALUE
    compu {phys=raw*0.1} "The scaling of CAN input signal IR_Temperature_12, frame RT_IRTemp_Temp_12, 9505829 (0x910c25). Scaling: WorldValue = 0.1*BinaryValue + 0.0 []. Unit: The unit "" from the network database is mapped to the AUTOSAR unit NoUnit"
    range phys 0 "The range of CAN input signal IR_Temperature_12, frame RT_IRTemp_Temp_12, 9505829 (0x910c25). Range (world values): 0.0 ... 0.0 []"
  app type cif_0x910b25_IR_Temperature_11_t:  # The type of CAN input signal IR_Temperature_11, frame RT_IRTemp_Temp_11, 9505573 (0x910b25). Implementation type is int16
    category=VALUE
    compu {phys=raw*0.1} "The scaling of CAN input signal IR_Temperature_11, frame RT_IRTemp_Temp_11, 9505573 (0x910b25). Scaling: WorldValue = 0.1*BinaryValue + 0.0 []. Unit: The unit "" from the network database is mapped to the AUTOSAR unit NoUnit"
    range phys 0 "The range of CAN input signal IR_Temperature_11, frame RT_IRTemp_Temp_11, 9505573 (0x910b25). Range (world values): 0.0 ... 0.0 []"
  app type cif_0x910a25_IR_Temperature_10_t:  # The type of CAN input signal IR_Temperature_10, frame RT_IRTemp_Temp_10, 9505317 (0x910a25). Implementation type is int16
    category=VALUE
    compu {phys=raw*0.1} "The scaling of CAN input signal IR_Temperature_10, frame RT_IRTemp_Temp_10, 9505317 (0x910a25). Scaling: WorldValue = 0.1*BinaryValue + 0.0 []. Unit: The unit "" from the network database is mapped to the AUTOSAR unit NoUnit"
    range phys 0 "The range of CAN input signal IR_Temperature_10, frame RT_IRTemp_Temp_10, 9505317 (0x910a25). Range (world values): 0.0 ... 0.0 []"
  app type cif_0x910825_IR_Temperature_8_t:  # The type of CAN input signal IR_Temperature_8, frame RT_IRTemp_Temp_8, 9504805 (0x910825). Implementation type is int16
    category=VALUE
    compu {phys=raw*0.1} "The scaling of CAN input signal IR_Temperature_8, frame RT_IRTemp_Temp_8, 9504805 (0x910825). Scaling: WorldValue = 0.1*BinaryValue + 0.0 []. Unit: The unit "" from the network database is mapped to the AUTOSAR unit NoUnit"
    range phys 0 "The range of CAN input signal IR_Temperature_8, frame RT_IRTemp_Temp_8, 9504805 (0x910825). Range (world values): 0.0 ... 0.0 []"
  app type cif_0x910925_IR_Temperature_9_t:  # The type of CAN input signal IR_Temperature_9, frame RT_IRTemp_Temp_9, 9505061 (0x910925). Implementation type is int16
    category=VALUE
    compu {phys=raw*0.1} "The scaling of CAN input signal IR_Temperature_9, frame RT_IRTemp_Temp_9, 9505061 (0x910925). Scaling: WorldValue = 0.1*BinaryValue + 0.0 []. Unit: The unit "" from the network database is mapped to the AUTOSAR unit NoUnit"
    range phys 0 "The range of CAN input signal IR_Temperature_9, frame RT_IRTemp_Temp_9, 9505061 (0x910925). Range (world values): 0.0 ... 0.0 []"
  app type cif_0x911125_IR_Temperature_17_t:  # The type of CAN input signal IR_Temperature_17, frame RT_IRTemp_Temp_17, 9507109 (0x911125). Implementation type is int16
    category=VALUE
    compu {phys=raw*0.1} "The scaling of CAN input signal IR_Temperature_17, frame RT_IRTemp_Temp_17, 9507109 (0x911125). Scaling: WorldValue = 0.1*BinaryValue + 0.0 []. Unit: The unit "" from the network database is mapped to the AUTOSAR unit NoUnit"
    range phys 0 "The range of CAN input signal IR_Temperature_17, frame RT_IRTemp_Temp_17, 9507109 (0x911125). Range (world values): 0.0 ... 0.0 []"
  app type cif_0x910625_IR_Temperature_6_t:  # The type of CAN input signal IR_Temperature_6, frame RT_IRTemp_Temp_6, 9504293 (0x910625). Implementation type is int16
    category=VALUE
    compu {phys=raw*0.1} "The scaling of CAN input signal IR_Temperature_6, frame RT_IRTemp_Temp_6, 9504293 (0x910625). Scaling: WorldValue = 0.1*BinaryValue + 0.0 []. Unit: The unit "" from the network database is mapped to the AUTOSAR unit NoUnit"
    range phys 0 "The range of CAN input signal IR_Temperature_6, frame RT_IRTemp_Temp_6, 9504293 (0x910625). Range (world values): 0.0 ... 0.0 []"
  app type cif_0x910525_IR_Temperature_5_t:  # The type of CAN input signal IR_Temperature_5, frame RT_IRTemp_Temp_5, 9504037 (0x910525). Implementation type is int16
    category=VALUE
    compu {phys=raw*0.1} "The scaling of CAN input signal IR_Temperature_5, frame RT_IRTemp_Temp_5, 9504037 (0x910525). Scaling: WorldValue = 0.1*BinaryValue + 0.0 []. Unit: The unit "" from the network database is mapped to the AUTOSAR unit NoUnit"
    range phys 0 "The range of CAN input signal IR_Temperature_5, frame RT_IRTemp_Temp_5, 9504037 (0x910525). Range (world values): 0.0 ... 0.0 []"
  app type cif_0x910425_IR_Temperature_4_t:  # The type of CAN input signal IR_Temperature_4, frame RT_IRTemp_Temp_4, 9503781 (0x910425). Implementation type is int16
    category=VALUE
    compu {phys=raw*0.1} "The scaling of CAN input signal IR_Temperature_4, frame RT_IRTemp_Temp_4, 9503781 (0x910425). Scaling: WorldValue = 0.1*BinaryValue + 0.0 []. Unit: The unit "" from the network database is mapped to the AUTOSAR unit NoUnit"
    range phys 0 "The range of CAN input signal IR_Temperature_4, frame RT_IRTemp_Temp_4, 9503781 (0x910425). Range (world values): 0.0 ... 0.0 []"
  app type cif_0x910325_IR_Temperature_3_t:  # The type of CAN input signal IR_Temperature_3, frame RT_IRTemp_Temp_3, 9503525 (0x910325). Implementation type is int16
    category=VALUE
    compu {phys=raw*0.1} "The scaling of CAN input signal IR_Temperature_3, frame RT_IRTemp_Temp_3, 9503525 (0x910325). Scaling: WorldValue = 0.1*BinaryValue + 0.0 []. Unit: The unit "" from the network database is mapped to the AUTOSAR unit NoUnit"
    range phys 0 "The range of CAN input signal IR_Temperature_3, frame RT_IRTemp_Temp_3, 9503525 (0x910325). Range (world values): 0.0 ... 0.0 []"
  app type cif_0x910225_IR_Temperature_2_t:  # The type of CAN input signal IR_Temperature_2, frame RT_IRTemp_Temp_2, 9503269 (0x910225). Implementation type is int16
    category=VALUE
    compu {phys=raw*0.1} "The scaling of CAN input signal IR_Temperature_2, frame RT_IRTemp_Temp_2, 9503269 (0x910225). Scaling: WorldValue = 0.1*BinaryValue + 0.0 []. Unit: The unit "" from the network database is mapped to the AUTOSAR unit NoUnit"
    range phys 0 "The range of CAN input signal IR_Temperature_2, frame RT_IRTemp_Temp_2, 9503269 (0x910225). Range (world values): 0.0 ... 0.0 []"
  app type cif_0x910125_IR_Temperature_1_t:  # The type of CAN input signal IR_Temperature_1, frame RT_IRTemp_Temp_1, 9503013 (0x910125). Implementation type is int16
    category=VALUE
    compu {phys=raw*0.1} "The scaling of CAN input signal IR_Temperature_1, frame RT_IRTemp_Temp_1, 9503013 (0x910125). Scaling: WorldValue = 0.1*BinaryValue + 0.0 []. Unit: The unit "" from the network database is mapped to the AUTOSAR unit NoUnit"
    range phys 0 "The range of CAN input signal IR_Temperature_1, frame RT_IRTemp_Temp_1, 9503013 (0x910125). Range (world values): 0.0 ... 0.0 []"
  app type cif_0x910125_CRC_t: category=VALUE, compu {phys=raw} "The scaling of CAN input signal CRC, frame RT_IRTemp_Temp_1, 9503013 (0x910125). Scaling: WorldValue = BinaryValue []. Unit: The unit "" from the network database is mapped to the AUTOSAR unit NoUnit", range phys 1..255 "The range of CAN input signal CRC, frame RT_IRTemp_Temp_1, 9503013 (0x910125). Range (world values): 1.0 ... 255.0 []"  # The type of CAN input signal CRC, frame RT_IRTemp_Temp_1, 9503013 (0x910125). Checksum Implementation type is uint8
  app type cif_0x8d0722_Validity_Final_Speed_t:  # The type of CAN input signal Validity_Final_Speed, frame RT_SB_Trig_Final_Condition, 9242402 (0x8d0722). Valid when bit is set, invalid when bit is clear. Implementation type is boolean
    category=VALUE
    compu {phys=raw} "The scaling of CAN input signal Validity_Final_Speed, frame RT_SB_Trig_Final_Condition, 9242402 (0x8d0722). Scaling: WorldValue = BinaryValue []. Unit: The unit "" from the network database is mapped to the AUTOSAR unit NoUnit"
    range phys 0..1 "The range of CAN input signal Validity_Final_Speed, frame RT_SB_Trig_Final_Condition, 9242402 (0x8d0722). Range (world values): 0.0 ... 1.0 []"
  app type cif_0x8d0722_Final_Speed_t:  # The type of CAN input signal Final_Speed, frame RT_SB_Trig_Final_Condition, 9242402 (0x8d0722). Speed at end of triggered test Implementation type is uint32
    category=VALUE
    compu {phys=raw*0.0001} "The scaling of CAN input signal Final_Speed, frame RT_SB_Trig_Final_Condition, 9242402 (0x8d0722). Scaling: WorldValue = 1.0E-4*BinaryValue + 0.0 [m/s]. Unit: The unit m/s from the network database is mapped to the AUTOSAR unit NoUnit"
    range phys 0..1675 "The range of CAN input signal Final_Speed, frame RT_SB_Trig_Final_Condition, 9242402 (0x8d0722). Range (world values): 0.0 ... 1675.0 [m/s]"
  app type cif_0x31a_Validity_Initial_Speed_t:  # The type of CAN input signal Validity_Initial_Speed, frame RT_SB_Trig_Initial_Condition, 794 (0x31a). Valid when bit is set, invalid when bit is clear. Valid when bit is set, invalid when bit is clear. Implementation type is boolean
    category=VALUE
    compu {phys=raw} "The scaling of CAN input signal Validity_Initial_Speed, frame RT_SB_Trig_Initial_Condition, 794 (0x31a). Scaling: WorldValue = BinaryValue []. Unit: The unit "" from the network database is mapped to the AUTOSAR unit NoUnit"
    range phys 0..1 "The range of CAN input signal Validity_Initial_Speed, frame RT_SB_Trig_Initial_Condition, 794 (0x31a). Range (world values): 0.0 ... 1.0 []"
  app type cif_0x31a_Validity_Initial_Heading_t:  # The type of CAN input signal Validity_Initial_Heading, frame RT_SB_Trig_Initial_Condition, 794 (0x31a). Valid when bit is set, invalid when bit is clear. Valid when bit is set, invalid when bit is clear. Implementation type is boolean
    category=VALUE
    compu {phys=raw} "The scaling of CAN input signal Validity_Initial_Heading, frame RT_SB_Trig_Initial_Condition, 794 (0x31a). Scaling: WorldValue = BinaryValue []. Unit: The unit "" from the network database is mapped to the AUTOSAR unit NoUnit"
    range phys 0..1 "The range of CAN input signal Validity_Initial_Heading, frame RT_SB_Trig_Initial_Condition, 794 (0x31a). Range (world values): 0.0 ... 1.0 []"
  app type cif_0x31a_Initial_Speed_t:  # The type of CAN input signal Initial_Speed, frame RT_SB_Trig_Initial_Condition, 794 (0x31a). Speed at start of triggered test Speed at start of triggered test Implementation type is uint32
    category=VALUE
    compu {phys=raw*0.0001} "The scaling of CAN input signal Initial_Speed, frame RT_SB_Trig_Initial_Condition, 794 (0x31a). Scaling: WorldValue = 1.0E-4*BinaryValue + 0.0 [m/s]. Unit: The unit m/s from the network database is mapped to the AUTOSAR unit NoUnit"
    range phys 0..1675 "The range of CAN input signal Initial_Speed, frame RT_SB_Trig_Initial_Condition, 794 (0x31a). Range (world values): 0.0 ... 1675.0 [m/s]"
  app type cif_0x31a_Initial_Heading_t:  # The type of CAN input signal Initial_Heading, frame RT_SB_Trig_Initial_Condition, 794 (0x31a). Heading (track) at start of triggered test Heading (track) at start of triggered test Implementation type is int16
    category=VALUE
    compu {phys=raw*0.01} "The scaling of CAN input signal Initial_Heading, frame RT_SB_Trig_Initial_Condition, 794 (0x31a). Scaling: WorldValue = 0.01*BinaryValue + 0.0 [degrees]. Unit: The unit degrees from the network database is mapped to the AUTOSAR unit NoUnit"
    range phys -180..180 "The range of CAN input signal Initial_Heading, frame RT_SB_Trig_Initial_Condition, 794 (0x31a). Range (world values): -180.0 ... 180.0 [degrees]"
  app type cif_0x31a_MFDD_Start_Threshold_t:  # The type of CAN input signal MFDD_Start_Threshold, frame RT_SB_Trig_Initial_Condition, 794 (0x31a). Implementation type is uint8
    category=VALUE
    compu {phys=raw; unit %} "The scaling of CAN input signal MFDD_Start_Threshold, frame RT_SB_Trig_Initial_Condition, 794 (0x31a). Scaling: WorldValue = BinaryValue [%]. Unit: The unit % from the network database is mapped to the AUTOSAR unit Perc"
    range phys 0..100 "The range of CAN input signal MFDD_Start_Threshold, frame RT_SB_Trig_Initial_Condition, 794 (0x31a). Range (world values): 0.0 ... 100.0 [%]"
  app type cif_0x31a_MFDD_End_Threshold_t:  # The type of CAN input signal MFDD_End_Threshold, frame RT_SB_Trig_Initial_Condition, 794 (0x31a). Implementation type is uint8
    category=VALUE
    compu {phys=raw; unit %} "The scaling of CAN input signal MFDD_End_Threshold, frame RT_SB_Trig_Initial_Condition, 794 (0x31a). Scaling: WorldValue = BinaryValue [%]. Unit: The unit % from the network database is mapped to the AUTOSAR unit Perc"
    range phys 0..100 "The range of CAN input signal MFDD_End_Threshold, frame RT_SB_Trig_Initial_Condition, 794 (0x31a). Range (world values): 0.0 ... 100.0 [%]"
  app type cif_0x8d0522_Direct_Distance_t:  # The type of CAN input signal Direct_Distance, frame RT_SB_Trig_Direct_Dist, 9241890 (0x8d0522). Direct distance from start of test to current position Implementation type is uint32
    category=VALUE
    compu {phys=raw*0.001} "The scaling of CAN input signal Direct_Distance, frame RT_SB_Trig_Direct_Dist, 9241890 (0x8d0522). Scaling: WorldValue = 0.001*BinaryValue + 0.0 [m]. Unit: The unit m from the network database is mapped to the AUTOSAR unit NoUnit"
    range phys 0..4294970 "The range of CAN input signal Direct_Distance, frame RT_SB_Trig_Direct_Dist, 9241890 (0x8d0522). Range (world values): 0.0 ... 4294970.0 [m]"
  app type cif_0x8d0522_Path_Distance_2D_t:  # The type of CAN input signal Path_Distance_2D, frame RT_SB_Trig_Direct_Dist, 9241890 (0x8d0522). 2D path distance (horizontal components only) Implementation type is uint32
    category=VALUE
    compu {phys=raw*0.001} "The scaling of CAN input signal Path_Distance_2D, frame RT_SB_Trig_Direct_Dist, 9241890 (0x8d0522). Scaling: WorldValue = 0.001*BinaryValue + 0.0 [m]. Unit: The unit m from the network database is mapped to the AUTOSAR unit NoUnit"
    range phys 0..4294970 "The range of CAN input signal Path_Distance_2D, frame RT_SB_Trig_Direct_Dist, 9241890 (0x8d0522). Range (world values): 0.0 ... 4294970.0 [m]"
  app type cif_0x8d0422_Forward_Distance_t:  # The type of CAN output signal Forward_Distance, frame RT_SB_Trig_Forward_Dist, 9241634 (0x8d0422). Current forward distance from start of test in direction of initial heading at start of test Implementation type is int32
    category=VALUE
    compu {phys=raw*0.001} "The scaling of CAN output signal Forward_Distance, frame RT_SB_Trig_Forward_Dist, 9241634 (0x8d0422). Scaling: WorldValue = 0.001*BinaryValue + 0.0 [m]. Unit: The unit m from the network database is mapped to the AUTOSAR unit NoUnit"
    range phys -2147480..2147480 "The range of CAN output signal Forward_Distance, frame RT_SB_Trig_Forward_Dist, 9241634 (0x8d0422). Range (world values): -2147480.0 ... 2147480.0 [m]"
  app type cif_0x8d0422_Deviation_Distance_t:  # The type of CAN output signal Deviation_Distance, frame RT_SB_Trig_Forward_Dist, 9241634 (0x8d0422). Current deviation distance from a line projected along the initial heading at start of test, +ve for deviation to the right. Implementation type is int32
    category=VALUE
    compu {phys=raw*0.001} "The scaling of CAN output signal Deviation_Distance, frame RT_SB_Trig_Forward_Dist, 9241634 (0x8d0422). Scaling: WorldValue = 0.001*BinaryValue + 0.0 [m]. Unit: The unit m from the network database is mapped to the AUTOSAR unit NoUnit"
    range phys -2147480..2147480 "The range of CAN output signal Deviation_Distance, frame RT_SB_Trig_Forward_Dist, 9241634 (0x8d0422). Range (world values): -2147480.0 ... 2147480.0 [m]"
  app type cif_0x8d0322_Path_Distance_3D_t:  # The type of CAN input signal Path_Distance_3D, frame RT_SB_Trig_Path_Dist, 9241378 (0x8d0322). 3D path distance Implementation type is uint32
    category=VALUE
    compu {phys=raw*0.001} "The scaling of CAN input signal Path_Distance_3D, frame RT_SB_Trig_Path_Dist, 9241378 (0x8d0322). Scaling: WorldValue = 0.001*BinaryValue + 0.0 [m]. Unit: The unit m from the network database is mapped to the AUTOSAR unit NoUnit"
    range phys 0..4294970 "The range of CAN input signal Path_Distance_3D, frame RT_SB_Trig_Path_Dist, 9241378 (0x8d0322). Range (world values): 0.0 ... 4294970.0 [m]"
  app type cif_0x8d0222_Validity_MFDD_t: category=VALUE, compu {phys=raw} "The scaling of CAN output signal Validity_MFDD, frame RT_SB_Trig_Accel, 9241122 (0x8d0222). Scaling: WorldValue = BinaryValue []. Unit: The unit "" from the network database is mapped to the AUTOSAR unit NoUnit", range phys 0..1 "The range of CAN output signal Validity_MFDD, frame RT_SB_Trig_Accel, 9241122 (0x8d0222). Range (world values): 0.0 ... 1.0 []"  # The type of CAN output signal Validity_MFDD, frame RT_SB_Trig_Accel, 9241122 (0x8d0222). Valid when bit is set, invalid when bit is clear. Implementation type is boolean
  app type cif_0x8d0222_Validity_Average_Accel_t:  # The type of CAN output signal Validity_Average_Accel, frame RT_SB_Trig_Accel, 9241122 (0x8d0222). Valid when bit is set, invalid when bit is clear. Implementation type is boolean
    category=VALUE
    compu {phys=raw} "The scaling of CAN output signal Validity_Average_Accel, frame RT_SB_Trig_Accel, 9241122 (0x8d0222). Scaling: WorldValue = BinaryValue []. Unit: The unit "" from the network database is mapped to the AUTOSAR unit NoUnit"
    range phys 0..1 "The range of CAN output signal Validity_Average_Accel, frame RT_SB_Trig_Accel, 9241122 (0x8d0222). Range (world values): 0.0 ... 1.0 []"
  app type cif_0x8d0222_Validity_Triggered_Time_t:  # The type of CAN output signal Validity_Triggered_Time, frame RT_SB_Trig_Accel, 9241122 (0x8d0222). Valid when bit is set, invalid when bit is clear. Implementation type is boolean
    category=VALUE
    compu {phys=raw} "The scaling of CAN output signal Validity_Triggered_Time, frame RT_SB_Trig_Accel, 9241122 (0x8d0222). Scaling: WorldValue = BinaryValue []. Unit: The unit "" from the network database is mapped to the AUTOSAR unit NoUnit"
    range phys 0..1 "The range of CAN output signal Validity_Triggered_Time, frame RT_SB_Trig_Accel, 9241122 (0x8d0222). Range (world values): 0.0 ... 1.0 []"
  app type cif_0x8d0222_MFDD_t: category=VALUE, compu {phys=raw*0.001} "The scaling of CAN output signal MFDD, frame RT_SB_Trig_Accel, 9241122 (0x8d0222). Scaling: WorldValue = 0.001*BinaryValue + 0.0 [g]. Unit: The unit g from the network database is mapped to the AUTOSAR unit NoUnit", range phys -65..65 "The range of CAN output signal MFDD, frame RT_SB_Trig_Accel, 9241122 (0x8d0222). Range (world values): -65.0 ... 65.0 [g]"  # The type of CAN output signal MFDD, frame RT_SB_Trig_Accel, 9241122 (0x8d0222). Mean fully-developed decelleration of triggered test. Thresholds used are as set in the logger configuration. Implementation type is int16
  app type cif_0x8d0222_Average_Accel_t:  # The type of CAN output signal Average_Accel, frame RT_SB_Trig_Accel, 9241122 (0x8d0222). Average acceleration from start of triggered test to current time. Implementation type is int16
    category=VALUE
    compu {phys=raw*0.001} "The scaling of CAN output signal Average_Accel, frame RT_SB_Trig_Accel, 9241122 (0x8d0222). Scaling: WorldValue = 0.001*BinaryValue + 0.0 [g]. Unit: The unit g from the network database is mapped to the AUTOSAR unit NoUnit"
    range phys -65..65 "The range of CAN output signal Average_Accel, frame RT_SB_Trig_Accel, 9241122 (0x8d0222). Range (world values): -65.0 ... 65.0 [g]"
  app type cif_0x8d0222_Triggered_Time_t:  # The type of CAN output signal Triggered_Time, frame RT_SB_Trig_Accel, 9241122 (0x8d0222). Cumulative time from start of triggered test to current time. Implementation type is uint32
    category=VALUE
    compu {phys=raw*0.01; unit s} "The scaling of CAN output signal Triggered_Time, frame RT_SB_Trig_Accel, 9241122 (0x8d0222). Scaling: WorldValue = 0.01*BinaryValue + 0.0 [s]. Unit: The unit s from the network database is mapped to the AUTOSAR unit Sec"
    range phys 0..167772 "The range of CAN output signal Triggered_Time, frame RT_SB_Trig_Accel, 9241122 (0x8d0222). Range (world values): 0.0 ... 167772.0 [s]"
  app type cif_0x960c24_Measured_Time_12_t:  # The type of CAN output signal Measured_Time_12, frame RT_DL1MK3_Measure_Time_12, 9833508 (0x960c24). Implementation type is uint32
    category=VALUE
    compu {phys=raw} "The scaling of CAN output signal Measured_Time_12, frame RT_DL1MK3_Measure_Time_12, 9833508 (0x960c24). Scaling: WorldValue = BinaryValue []. Unit: The unit "" from the network database is mapped to the AUTOSAR unit NoUnit"
    range phys 0 "The range of CAN output signal Measured_Time_12, frame RT_DL1MK3_Measure_Time_12, 9833508 (0x960c24). Range (world values): 0.0 ... 0.0 []"
  app type cif_0x960b24_Measured_Time_11_t:  # The type of CAN input signal Measured_Time_11, frame RT_DL1MK3_Measure_Time_11, 9833252 (0x960b24). Implementation type is uint32
    category=VALUE
    compu {phys=raw} "The scaling of CAN input signal Measured_Time_11, frame RT_DL1MK3_Measure_Time_11, 9833252 (0x960b24). Scaling: WorldValue = BinaryValue []. Unit: The unit "" from the network database is mapped to the AUTOSAR unit NoUnit"
    range phys 0 "The range of CAN input signal Measured_Time_11, frame RT_DL1MK3_Measure_Time_11, 9833252 (0x960b24). Range (world values): 0.0 ... 0.0 []"
  app type cif_0x960a24_Measured_Time_10_t:  # The type of CAN input signal Measured_Time_10, frame RT_DL1MK3_Measure_Time_10, 9832996 (0x960a24). Implementation type is uint32
    category=VALUE
    compu {phys=raw} "The scaling of CAN input signal Measured_Time_10, frame RT_DL1MK3_Measure_Time_10, 9832996 (0x960a24). Scaling: WorldValue = BinaryValue []. Unit: The unit "" from the network database is mapped to the AUTOSAR unit NoUnit"
    range phys 0 "The range of CAN input signal Measured_Time_10, frame RT_DL1MK3_Measure_Time_10, 9832996 (0x960a24). Range (world values): 0.0 ... 0.0 []"
  app type cif_0x960924_Measured_Time_9_t:  # The type of CAN input signal Measured_Time_9, frame RT_DL1MK3_Measure_Time_9, 9832740 (0x960924). Implementation type is uint32
    category=VALUE
    compu {phys=raw} "The scaling of CAN input signal Measured_Time_9, frame RT_DL1MK3_Measure_Time_9, 9832740 (0x960924). Scaling: WorldValue = BinaryValue []. Unit: The unit "" from the network database is mapped to the AUTOSAR unit NoUnit"
    range phys 0 "The range of CAN input signal Measured_Time_9, frame RT_DL1MK3_Measure_Time_9, 9832740 (0x960924). Range (world values): 0.0 ... 0.0 []"
  app type cif_0x960824_Measured_Time_8_t:  # The type of CAN input signal Measured_Time_8, frame RT_DL1MK3_Measure_Time_8, 9832484 (0x960824). Implementation type is uint32
    category=VALUE
    compu {phys=raw} "The scaling of CAN input signal Measured_Time_8, frame RT_DL1MK3_Measure_Time_8, 9832484 (0x960824). Scaling: WorldValue = BinaryValue []. Unit: The unit "" from the network database is mapped to the AUTOSAR unit NoUnit"
    range phys 0 "The range of CAN input signal Measured_Time_8, frame RT_DL1MK3_Measure_Time_8, 9832484 (0x960824). Range (world values): 0.0 ... 0.0 []"
  app type cif_0x960724_Measured_Time_7_t:  # The type of CAN input signal Measured_Time_7, frame RT_DL1MK3_Measure_Time_7, 9832228 (0x960724). Implementation type is uint32
    category=VALUE
    compu {phys=raw} "The scaling of CAN input signal Measured_Time_7, frame RT_DL1MK3_Measure_Time_7, 9832228 (0x960724). Scaling: WorldValue = BinaryValue []. Unit: The unit "" from the network database is mapped to the AUTOSAR unit NoUnit"
    range phys 0 "The range of CAN input signal Measured_Time_7, frame RT_DL1MK3_Measure_Time_7, 9832228 (0x960724). Range (world values): 0.0 ... 0.0 []"
  app type cif_0x960624_Measured_Time_6_t:  # The type of CAN input signal Measured_Time_6, frame RT_DL1MK3_Measure_Time_6, 9831972 (0x960624). Implementation type is uint32
    category=VALUE
    compu {phys=raw} "The scaling of CAN input signal Measured_Time_6, frame RT_DL1MK3_Measure_Time_6, 9831972 (0x960624). Scaling: WorldValue = BinaryValue []. Unit: The unit "" from the network database is mapped to the AUTOSAR unit NoUnit"
    range phys 0 "The range of CAN input signal Measured_Time_6, frame RT_DL1MK3_Measure_Time_6, 9831972 (0x960624). Range (world values): 0.0 ... 0.0 []"
  app type cif_0x960524_Measured_Time_5_t:  # The type of CAN input signal Measured_Time_5, frame RT_DL1MK3_Measure_Time_5, 9831716 (0x960524). Implementation type is uint32
    category=VALUE
    compu {phys=raw} "The scaling of CAN input signal Measured_Time_5, frame RT_DL1MK3_Measure_Time_5, 9831716 (0x960524). Scaling: WorldValue = BinaryValue []. Unit: The unit "" from the network database is mapped to the AUTOSAR unit NoUnit"
    range phys 0 "The range of CAN input signal Measured_Time_5, frame RT_DL1MK3_Measure_Time_5, 9831716 (0x960524). Range (world values): 0.0 ... 0.0 []"
  app type cif_0x960424_Measured_Time_4_t:  # The type of CAN input signal Measured_Time_4, frame RT_DL1MK3_Measure_Time_4, 9831460 (0x960424). Implementation type is uint32
    category=VALUE
    compu {phys=raw} "The scaling of CAN input signal Measured_Time_4, frame RT_DL1MK3_Measure_Time_4, 9831460 (0x960424). Scaling: WorldValue = BinaryValue []. Unit: The unit "" from the network database is mapped to the AUTOSAR unit NoUnit"
    range phys 0 "The range of CAN input signal Measured_Time_4, frame RT_DL1MK3_Measure_Time_4, 9831460 (0x960424). Range (world values): 0.0 ... 0.0 []"
  app type cif_0x960324_Measured_Time_3_t:  # The type of CAN input signal Measured_Time_3, frame RT_DL1MK3_Measure_Time_3, 9831204 (0x960324). Implementation type is uint32
    category=VALUE
    compu {phys=raw} "The scaling of CAN input signal Measured_Time_3, frame RT_DL1MK3_Measure_Time_3, 9831204 (0x960324). Scaling: WorldValue = BinaryValue []. Unit: The unit "" from the network database is mapped to the AUTOSAR unit NoUnit"
    range phys 0 "The range of CAN input signal Measured_Time_3, frame RT_DL1MK3_Measure_Time_3, 9831204 (0x960324). Range (world values): 0.0 ... 0.0 []"
  app type cif_0x960224_Measured_Time_2_t:  # The type of CAN input signal Measured_Time_2, frame RT_DL1MK3_Measure_Time_2, 9830948 (0x960224). Implementation type is uint32
    category=VALUE
    compu {phys=raw} "The scaling of CAN input signal Measured_Time_2, frame RT_DL1MK3_Measure_Time_2, 9830948 (0x960224). Scaling: WorldValue = BinaryValue []. Unit: The unit "" from the network database is mapped to the AUTOSAR unit NoUnit"
    range phys 0 "The range of CAN input signal Measured_Time_2, frame RT_DL1MK3_Measure_Time_2, 9830948 (0x960224). Range (world values): 0.0 ... 0.0 []"
  app type cif_0x960124_Measured_Time_1_t:  # The type of CAN input signal Measured_Time_1, frame RT_DL1MK3_Measure_Time_1, 9830692 (0x960124). Implementation type is uint32
    category=VALUE
    compu {phys=raw} "The scaling of CAN input signal Measured_Time_1, frame RT_DL1MK3_Measure_Time_1, 9830692 (0x960124). Scaling: WorldValue = BinaryValue []. Unit: The unit "" from the network database is mapped to the AUTOSAR unit NoUnit"
    range phys 0 "The range of CAN input signal Measured_Time_1, frame RT_DL1MK3_Measure_Time_1, 9830692 (0x960124). Range (world values): 0.0 ... 0.0 []"
  app type cif_0x950c24_RPM_t: category=VALUE, compu {phys=raw} "The scaling of CAN input signal RPM, frame RT_DL1MK3_RPM, 9767972 (0x950c24). Scaling: WorldValue = BinaryValue []. Unit: The unit "" from the network database is mapped to the AUTOSAR unit NoUnit", range phys 0 "The range of CAN input signal RPM, frame RT_DL1MK3_RPM, 9767972 (0x950c24). Range (world values): 0.0 ... 0.0 []"  # The type of CAN input signal RPM, frame RT_DL1MK3_RPM, 9767972 (0x950c24). Implementation type is uint16
  app type cif_0x950b24_Frequency_4_t: category=VALUE, compu {phys=raw*0.1} "The scaling of CAN input signal Frequency_4, frame RT_DL1MK3_Freq_4, 9767716 (0x950b24). Scaling: WorldValue = 0.1*BinaryValue + 0.0 []. Unit: The unit "" from the network database is mapped to the AUTOSAR unit NoUnit", range phys 0 "The range of CAN input signal Frequency_4, frame RT_DL1MK3_Freq_4, 9767716 (0x950b24). Range (world values): 0.0 ... 0.0 []"  # The type of CAN input signal Frequency_4, frame RT_DL1MK3_Freq_4, 9767716 (0x950b24). Implementation type is uint16
  app type cif_0x950a24_Frequency_3_t: category=VALUE, compu {phys=raw*0.1} "The scaling of CAN input signal Frequency_3, frame RT_DL1MK3_Freq_3, 9767460 (0x950a24). Scaling: WorldValue = 0.1*BinaryValue + 0.0 []. Unit: The unit "" from the network database is mapped to the AUTOSAR unit NoUnit", range phys 0 "The range of CAN input signal Frequency_3, frame RT_DL1MK3_Freq_3, 9767460 (0x950a24). Range (world values): 0.0 ... 0.0 []"  # The type of CAN input signal Frequency_3, frame RT_DL1MK3_Freq_3, 9767460 (0x950a24). Implementation type is uint16
  app type cif_0x950924_Frequency_2_t: category=VALUE, compu {phys=raw*0.1} "The scaling of CAN input signal Frequency_2, frame RT_DL1MK3_Freq_2, 9767204 (0x950924). Scaling: WorldValue = 0.1*BinaryValue + 0.0 []. Unit: The unit "" from the network database is mapped to the AUTOSAR unit NoUnit", range phys 0 "The range of CAN input signal Frequency_2, frame RT_DL1MK3_Freq_2, 9767204 (0x950924). Range (world values): 0.0 ... 0.0 []"  # The type of CAN input signal Frequency_2, frame RT_DL1MK3_Freq_2, 9767204 (0x950924). Implementation type is uint16
  app type cif_0x970324_Misc_3_t: category=VALUE, compu {phys=raw*0.001} "The scaling of CAN input signal Misc_3, frame RT_DL1MK3_Misc_3, 9896740 (0x970324). Scaling: WorldValue = 0.001*BinaryValue + 0.0 []. Unit: The unit "" from the network database is mapped to the AUTOSAR unit NoUnit", range phys 0 "The range of CAN input signal Misc_3, frame RT_DL1MK3_Misc_3, 9896740 (0x970324). Range (world values): 0.0 ... 0.0 []"  # The type of CAN input signal Misc_3, frame RT_DL1MK3_Misc_3, 9896740 (0x970324). Implementation type is uint16
  app type cif_0x970224_Misc_2_t: category=VALUE, compu {phys=raw*0.001} "The scaling of CAN input signal Misc_2, frame RT_DL1MK3_Misc_2, 9896484 (0x970224). Scaling: WorldValue = 0.001*BinaryValue + 0.0 []. Unit: The unit "" from the network database is mapped to the AUTOSAR unit NoUnit", range phys 0 "The range of CAN input signal Misc_2, frame RT_DL1MK3_Misc_2, 9896484 (0x970224). Range (world values): 0.0 ... 0.0 []"  # The type of CAN input signal Misc_2, frame RT_DL1MK3_Misc_2, 9896484 (0x970224). Implementation type is uint16
  app type cif_0x970124_Misc_1_t: category=VALUE, compu {phys=raw*0.001} "The scaling of CAN input signal Misc_1, frame RT_DL1MK3_Misc_1, 9896228 (0x970124). Scaling: WorldValue = 0.001*BinaryValue + 0.0 []. Unit: The unit "" from the network database is mapped to the AUTOSAR unit NoUnit", range phys 0 "The range of CAN input signal Misc_1, frame RT_DL1MK3_Misc_1, 9896228 (0x970124). Range (world values): 0.0 ... 0.0 []"  # The type of CAN input signal Misc_1, frame RT_DL1MK3_Misc_1, 9896228 (0x970124). Implementation type is uint16
  app type cif_0x941f24_AUX_31_t: category=VALUE, compu {phys=raw*0.1} "The scaling of CAN input signal AUX_31, frame RT_DL1MK3_Aux_31, 9707300 (0x941f24). Scaling: WorldValue = 0.1*BinaryValue + 0.0 []. Unit: The unit "" from the network database is mapped to the AUTOSAR unit NoUnit", range phys 0 "The range of CAN input signal AUX_31, frame RT_DL1MK3_Aux_31, 9707300 (0x941f24). Range (world values): 0.0 ... 0.0 []"  # The type of CAN input signal AUX_31, frame RT_DL1MK3_Aux_31, 9707300 (0x941f24). Implementation type is uint16
  app type cif_0x941e24_AUX_30_t: category=VALUE, compu {phys=raw*0.1} "The scaling of CAN input signal AUX_30, frame RT_DL1MK3_Aux_30, 9707044 (0x941e24). Scaling: WorldValue = 0.1*BinaryValue + 0.0 []. Unit: The unit "" from the network database is mapped to the AUTOSAR unit NoUnit", range phys 0 "The range of CAN input signal AUX_30, frame RT_DL1MK3_Aux_30, 9707044 (0x941e24). Range (world values): 0.0 ... 0.0 []"  # The type of CAN input signal AUX_30, frame RT_DL1MK3_Aux_30, 9707044 (0x941e24). Implementation type is uint16
  app type cif_0x941d24_AUX_29_t: category=VALUE, compu {phys=raw*0.1} "The scaling of CAN input signal AUX_29, frame RT_DL1MK3_Aux_29, 9706788 (0x941d24). Scaling: WorldValue = 0.1*BinaryValue + 0.0 []. Unit: The unit "" from the network database is mapped to the AUTOSAR unit NoUnit", range phys 0 "The range of CAN input signal AUX_29, frame RT_DL1MK3_Aux_29, 9706788 (0x941d24). Range (world values): 0.0 ... 0.0 []"  # The type of CAN input signal AUX_29, frame RT_DL1MK3_Aux_29, 9706788 (0x941d24). Implementation type is uint16
  app type cif_0x941c24_AUX_28_t: category=VALUE, compu {phys=raw*0.1} "The scaling of CAN input signal AUX_28, frame RT_DL1MK3_Aux_28, 9706532 (0x941c24). Scaling: WorldValue = 0.1*BinaryValue + 0.0 []. Unit: The unit "" from the network database is mapped to the AUTOSAR unit NoUnit", range phys 0 "The range of CAN input signal AUX_28, frame RT_DL1MK3_Aux_28, 9706532 (0x941c24). Range (world values): 0.0 ... 0.0 []"  # The type of CAN input signal AUX_28, frame RT_DL1MK3_Aux_28, 9706532 (0x941c24). Implementation type is uint16
  app type cif_0x941b24_AUX_27_t: category=VALUE, compu {phys=raw*0.1} "The scaling of CAN input signal AUX_27, frame RT_DL1MK3_Aux_27, 9706276 (0x941b24). Scaling: WorldValue = 0.1*BinaryValue + 0.0 []. Unit: The unit "" from the network database is mapped to the AUTOSAR unit NoUnit", range phys 0 "The range of CAN input signal AUX_27, frame RT_DL1MK3_Aux_27, 9706276 (0x941b24). Range (world values): 0.0 ... 0.0 []"  # The type of CAN input signal AUX_27, frame RT_DL1MK3_Aux_27, 9706276 (0x941b24). Implementation type is uint16
  app type cif_0x941a24_AUX_26_t: category=VALUE, compu {phys=raw*0.1} "The scaling of CAN input signal AUX_26, frame RT_DL1MK3_Aux_26, 9706020 (0x941a24). Scaling: WorldValue = 0.1*BinaryValue + 0.0 []. Unit: The unit "" from the network database is mapped to the AUTOSAR unit NoUnit", range phys 0 "The range of CAN input signal AUX_26, frame RT_DL1MK3_Aux_26, 9706020 (0x941a24). Range (world values): 0.0 ... 0.0 []"  # The type of CAN input signal AUX_26, frame RT_DL1MK3_Aux_26, 9706020 (0x941a24). Implementation type is uint16
  app type cif_0x941924_AUX_25_t: category=VALUE, compu {phys=raw*0.1} "The scaling of CAN input signal AUX_25, frame RT_DL1MK3_Aux_25, 9705764 (0x941924). Scaling: WorldValue = 0.1*BinaryValue + 0.0 []. Unit: The unit "" from the network database is mapped to the AUTOSAR unit NoUnit", range phys 0 "The range of CAN input signal AUX_25, frame RT_DL1MK3_Aux_25, 9705764 (0x941924). Range (world values): 0.0 ... 0.0 []"  # The type of CAN input signal AUX_25, frame RT_DL1MK3_Aux_25, 9705764 (0x941924). Implementation type is uint16
  app type cif_0x941824_AUX_24_t: category=VALUE, compu {phys=raw*0.1} "The scaling of CAN input signal AUX_24, frame RT_DL1MK3_Aux_24, 9705508 (0x941824). Scaling: WorldValue = 0.1*BinaryValue + 0.0 []. Unit: The unit "" from the network database is mapped to the AUTOSAR unit NoUnit", range phys 0 "The range of CAN input signal AUX_24, frame RT_DL1MK3_Aux_24, 9705508 (0x941824). Range (world values): 0.0 ... 0.0 []"  # The type of CAN input signal AUX_24, frame RT_DL1MK3_Aux_24, 9705508 (0x941824). Implementation type is uint16
  app type cif_0x941724_AUX_23_t: category=VALUE, compu {phys=raw*0.1} "The scaling of CAN input signal AUX_23, frame RT_DL1MK3_Aux_23, 9705252 (0x941724). Scaling: WorldValue = 0.1*BinaryValue + 0.0 []. Unit: The unit "" from the network database is mapped to the AUTOSAR unit NoUnit", range phys 0 "The range of CAN input signal AUX_23, frame RT_DL1MK3_Aux_23, 9705252 (0x941724). Range (world values): 0.0 ... 0.0 []"  # The type of CAN input signal AUX_23, frame RT_DL1MK3_Aux_23, 9705252 (0x941724). Implementation type is uint16
  app type cif_0x941624_AUX_22_t: category=VALUE, compu {phys=raw*10} "The scaling of CAN input signal AUX_22, frame RT_DL1MK3_Aux_22, 9704996 (0x941624). Scaling: WorldValue = 10.0*BinaryValue + 0.0 []. Unit: The unit "" from the network database is mapped to the AUTOSAR unit NoUnit", range phys 0 "The range of CAN input signal AUX_22, frame RT_DL1MK3_Aux_22, 9704996 (0x941624). Range (world values): 0.0 ... 0.0 []"  # The type of CAN input signal AUX_22, frame RT_DL1MK3_Aux_22, 9704996 (0x941624). Implementation type is uint16
  app type cif_0x941524_AUX_21_t: category=VALUE, compu {phys=raw*0.1} "The scaling of CAN input signal AUX_21, frame RT_DL1MK3_Aux_21, 9704740 (0x941524). Scaling: WorldValue = 0.1*BinaryValue + 0.0 []. Unit: The unit "" from the network database is mapped to the AUTOSAR unit NoUnit", range phys 0 "The range of CAN input signal AUX_21, frame RT_DL1MK3_Aux_21, 9704740 (0x941524). Range (world values): 0.0 ... 0.0 []"  # The type of CAN input signal AUX_21, frame RT_DL1MK3_Aux_21, 9704740 (0x941524). Implementation type is uint16
  app type cif_0x941424_AUX_20_t: category=VALUE, compu {phys=raw*0.1} "The scaling of CAN input signal AUX_20, frame RT_DL1MK3_Aux_20, 9704484 (0x941424). Scaling: WorldValue = 0.1*BinaryValue + 0.0 []. Unit: The unit "" from the network database is mapped to the AUTOSAR unit NoUnit", range phys 0 "The range of CAN input signal AUX_20, frame RT_DL1MK3_Aux_20, 9704484 (0x941424). Range (world values): 0.0 ... 0.0 []"  # The type of CAN input signal AUX_20, frame RT_DL1MK3_Aux_20, 9704484 (0x941424). Implementation type is uint16
  app type cif_0x941324_AUX_19_t: category=VALUE, compu {phys=raw*0.1} "The scaling of CAN input signal AUX_19, frame RT_DL1MK3_Aux_19, 9704228 (0x941324). Scaling: WorldValue = 0.1*BinaryValue + 0.0 []. Unit: The unit "" from the network database is mapped to the AUTOSAR unit NoUnit", range phys 0 "The range of CAN input signal AUX_19, frame RT_DL1MK3_Aux_19, 9704228 (0x941324). Range (world values): 0.0 ... 0.0 []"  # The type of CAN input signal AUX_19, frame RT_DL1MK3_Aux_19, 9704228 (0x941324). Implementation type is uint16
  app type cif_0x941224_AUX_18_t: category=VALUE, compu {phys=raw*0.1} "The scaling of CAN input signal AUX_18, frame RT_DL1MK3_Aux_18, 9703972 (0x941224). Scaling: WorldValue = 0.1*BinaryValue + 0.0 []. Unit: The unit "" from the network database is mapped to the AUTOSAR unit NoUnit", range phys 0 "The range of CAN input signal AUX_18, frame RT_DL1MK3_Aux_18, 9703972 (0x941224). Range (world values): 0.0 ... 0.0 []"  # The type of CAN input signal AUX_18, frame RT_DL1MK3_Aux_18, 9703972 (0x941224). Implementation type is uint16
  app type cif_0x941124_AUX_17_t: category=VALUE, compu {phys=raw*0.1} "The scaling of CAN input signal AUX_17, frame RT_DL1MK3_Aux_17, 9703716 (0x941124). Scaling: WorldValue = 0.1*BinaryValue + 0.0 []. Unit: The unit "" from the network database is mapped to the AUTOSAR unit NoUnit", range phys 0 "The range of CAN input signal AUX_17, frame RT_DL1MK3_Aux_17, 9703716 (0x941124). Range (world values): 0.0 ... 0.0 []"  # The type of CAN input signal AUX_17, frame RT_DL1MK3_Aux_17, 9703716 (0x941124). Implementation type is uint16
  app type cif_0x941024_AUX_16_t: category=VALUE, compu {phys=raw*0.1} "The scaling of CAN input signal AUX_16, frame RT_DL1MK3_Aux_16, 9703460 (0x941024). Scaling: WorldValue = 0.1*BinaryValue + 0.0 []. Unit: The unit "" from the network database is mapped to the AUTOSAR unit NoUnit", range phys 0 "The range of CAN input signal AUX_16, frame RT_DL1MK3_Aux_16, 9703460 (0x941024). Range (world values): 0.0 ... 0.0 []"  # The type of CAN input signal AUX_16, frame RT_DL1MK3_Aux_16, 9703460 (0x941024). Implementation type is uint16
  app type cif_0x940f24_AUX_15_t: category=VALUE, compu {phys=raw*0.1} "The scaling of CAN input signal AUX_15, frame RT_DL1MK3_Aux_15, 9703204 (0x940f24). Scaling: WorldValue = 0.1*BinaryValue + 0.0 []. Unit: The unit "" from the network database is mapped to the AUTOSAR unit NoUnit", range phys 0 "The range of CAN input signal AUX_15, frame RT_DL1MK3_Aux_15, 9703204 (0x940f24). Range (world values): 0.0 ... 0.0 []"  # The type of CAN input signal AUX_15, frame RT_DL1MK3_Aux_15, 9703204 (0x940f24). Implementation type is uint16
  app type cif_0x940e24_AUX_14_t: category=VALUE, compu {phys=raw*0.1} "The scaling of CAN input signal AUX_14, frame RT_DL1MK3_Aux_14, 9702948 (0x940e24). Scaling: WorldValue = 0.1*BinaryValue + 0.0 []. Unit: The unit "" from the network database is mapped to the AUTOSAR unit NoUnit", range phys 0 "The range of CAN input signal AUX_14, frame RT_DL1MK3_Aux_14, 9702948 (0x940e24). Range (world values): 0.0 ... 0.0 []"  # The type of CAN input signal AUX_14, frame RT_DL1MK3_Aux_14, 9702948 (0x940e24). Implementation type is uint16
  app type cif_0x940d24_AUX_13_t: category=VALUE, compu {phys=raw*0.1} "The scaling of CAN input signal AUX_13, frame RT_DL1MK3_Aux_13, 9702692 (0x940d24). Scaling: WorldValue = 0.1*BinaryValue + 0.0 []. Unit: The unit "" from the network database is mapped to the AUTOSAR unit NoUnit", range phys 0 "The range of CAN input signal AUX_13, frame RT_DL1MK3_Aux_13, 9702692 (0x940d24). Range (world values): 0.0 ... 0.0 []"  # The type of CAN input signal AUX_13, frame RT_DL1MK3_Aux_13, 9702692 (0x940d24). Implementation type is uint16
  app type cif_0x940c24_AUX_12_t: category=VALUE, compu {phys=raw*0.1} "The scaling of CAN input signal AUX_12, frame RT_DL1MK3_Aux_12, 9702436 (0x940c24). Scaling: WorldValue = 0.1*BinaryValue + 0.0 []. Unit: The unit "" from the network database is mapped to the AUTOSAR unit NoUnit", range phys 0 "The range of CAN input signal AUX_12, frame RT_DL1MK3_Aux_12, 9702436 (0x940c24). Range (world values): 0.0 ... 0.0 []"  # The type of CAN input signal AUX_12, frame RT_DL1MK3_Aux_12, 9702436 (0x940c24). Implementation type is uint16
  app type cif_0x940b24_AUX_11_t: category=VALUE, compu {phys=raw*0.1} "The scaling of CAN input signal AUX_11, frame RT_DL1MK3_Aux_11, 9702180 (0x940b24). Scaling: WorldValue = 0.1*BinaryValue + 0.0 []. Unit: The unit "" from the network database is mapped to the AUTOSAR unit NoUnit", range phys 0 "The range of CAN input signal AUX_11, frame RT_DL1MK3_Aux_11, 9702180 (0x940b24). Range (world values): 0.0 ... 0.0 []"  # The type of CAN input signal AUX_11, frame RT_DL1MK3_Aux_11, 9702180 (0x940b24). Implementation type is uint16
  app type cif_0x940924_AUX_9_t: category=VALUE, compu {phys=raw*0.1} "The scaling of CAN input signal AUX_9, frame RT_DL1MK3_Aux_9, 9701668 (0x940924). Scaling: WorldValue = 0.1*BinaryValue + 0.0 []. Unit: The unit "" from the network database is mapped to the AUTOSAR unit NoUnit", range phys 0 "The range of CAN input signal AUX_9, frame RT_DL1MK3_Aux_9, 9701668 (0x940924). Range (world values): 0.0 ... 0.0 []"  # The type of CAN input signal AUX_9, frame RT_DL1MK3_Aux_9, 9701668 (0x940924). Implementation type is uint16
  app type cif_0x940a24_AUX_10_t: category=VALUE, compu {phys=raw*0.1} "The scaling of CAN input signal AUX_10, frame RT_DL1MK3_Aux_10, 9701924 (0x940a24). Scaling: WorldValue = 0.1*BinaryValue + 0.0 []. Unit: The unit "" from the network database is mapped to the AUTOSAR unit NoUnit", range phys 0 "The range of CAN input signal AUX_10, frame RT_DL1MK3_Aux_10, 9701924 (0x940a24). Range (world values): 0.0 ... 0.0 []"  # The type of CAN input signal AUX_10, frame RT_DL1MK3_Aux_10, 9701924 (0x940a24). Implementation type is uint16
  app type cif_0x940824_AUX_8_t: category=VALUE, compu {phys=raw*0.1} "The scaling of CAN input signal AUX_8, frame RT_DL1MK3_Aux_8, 9701412 (0x940824). Scaling: WorldValue = 0.1*BinaryValue + 0.0 []. Unit: The unit "" from the network database is mapped to the AUTOSAR unit NoUnit", range phys 0 "The range of CAN input signal AUX_8, frame RT_DL1MK3_Aux_8, 9701412 (0x940824). Range (world values): 0.0 ... 0.0 []"  # The type of CAN input signal AUX_8, frame RT_DL1MK3_Aux_8, 9701412 (0x940824). Implementation type is uint16
  app type cif_0x940724_AUX_7_t: category=VALUE, compu {phys=raw*0.1} "The scaling of CAN input signal AUX_7, frame RT_DL1MK3_Aux_7, 9701156 (0x940724). Scaling: WorldValue = 0.1*BinaryValue + 0.0 []. Unit: The unit "" from the network database is mapped to the AUTOSAR unit NoUnit", range phys 0 "The range of CAN input signal AUX_7, frame RT_DL1MK3_Aux_7, 9701156 (0x940724). Range (world values): 0.0 ... 0.0 []"  # The type of CAN input signal AUX_7, frame RT_DL1MK3_Aux_7, 9701156 (0x940724). Implementation type is uint16
  app type cif_0x940624_AUX_6_t: category=VALUE, compu {phys=raw*0.1} "The scaling of CAN input signal AUX_6, frame RT_DL1MK3_Aux_6, 9700900 (0x940624). Scaling: WorldValue = 0.1*BinaryValue + 0.0 []. Unit: The unit "" from the network database is mapped to the AUTOSAR unit NoUnit", range phys 0 "The range of CAN input signal AUX_6, frame RT_DL1MK3_Aux_6, 9700900 (0x940624). Range (world values): 0.0 ... 0.0 []"  # The type of CAN input signal AUX_6, frame RT_DL1MK3_Aux_6, 9700900 (0x940624). Implementation type is uint16
  app type cif_0x940524_AUX_5_t: category=VALUE, compu {phys=raw*0.1} "The scaling of CAN input signal AUX_5, frame RT_DL1MK3_Aux_5, 9700644 (0x940524). Scaling: WorldValue = 0.1*BinaryValue + 0.0 []. Unit: The unit "" from the network database is mapped to the AUTOSAR unit NoUnit", range phys 0 "The range of CAN input signal AUX_5, frame RT_DL1MK3_Aux_5, 9700644 (0x940524). Range (world values): 0.0 ... 0.0 []"  # The type of CAN input signal AUX_5, frame RT_DL1MK3_Aux_5, 9700644 (0x940524). Implementation type is uint16
  app type cif_0x940424_AUX_4_t: category=VALUE, compu {phys=raw*0.1} "The scaling of CAN input signal AUX_4, frame RT_DL1MK3_Aux_4, 9700388 (0x940424). Scaling: WorldValue = 0.1*BinaryValue + 0.0 []. Unit: The unit "" from the network database is mapped to the AUTOSAR unit NoUnit", range phys 0 "The range of CAN input signal AUX_4, frame RT_DL1MK3_Aux_4, 9700388 (0x940424). Range (world values): 0.0 ... 0.0 []"  # The type of CAN input signal AUX_4, frame RT_DL1MK3_Aux_4, 9700388 (0x940424). Implementation type is uint16
  app type cif_0x940324_AUX_3_t: category=VALUE, compu {phys=raw*0.1} "The scaling of CAN input signal AUX_3, frame RT_DL1MK3_Aux_3, 9700132 (0x940324). Scaling: WorldValue = 0.1*BinaryValue + 0.0 []. Unit: The unit "" from the network database is mapped to the AUTOSAR unit NoUnit", range phys 0 "The range of CAN input signal AUX_3, frame RT_DL1MK3_Aux_3, 9700132 (0x940324). Range (world values): 0.0 ... 0.0 []"  # The type of CAN input signal AUX_3, frame RT_DL1MK3_Aux_3, 9700132 (0x940324). Implementation type is uint16
  app type cif_0x940224_AUX_2_t: category=VALUE, compu {phys=raw*0.1} "The scaling of CAN input signal AUX_2, frame RT_DL1MK3_Aux_2, 9699876 (0x940224). Scaling: WorldValue = 0.1*BinaryValue + 0.0 []. Unit: The unit "" from the network database is mapped to the AUTOSAR unit NoUnit", range phys 0 "The range of CAN input signal AUX_2, frame RT_DL1MK3_Aux_2, 9699876 (0x940224). Range (world values): 0.0 ... 0.0 []"  # The type of CAN input signal AUX_2, frame RT_DL1MK3_Aux_2, 9699876 (0x940224). Implementation type is uint16
  app type cif_0x940124_AUX_1_t: category=VALUE, compu {phys=raw*0.1} "The scaling of CAN input signal AUX_1, frame RT_DL1MK3_Aux_1, 9699620 (0x940124). Scaling: WorldValue = 0.1*BinaryValue + 0.0 []. Unit: The unit "" from the network database is mapped to the AUTOSAR unit NoUnit", range phys 0 "The range of CAN input signal AUX_1, frame RT_DL1MK3_Aux_1, 9699620 (0x940124). Range (world values): 0.0 ... 0.0 []"  # The type of CAN input signal AUX_1, frame RT_DL1MK3_Aux_1, 9699620 (0x940124). Implementation type is uint16
  app type cif_0x900524_Pressure_5_t: category=VALUE, compu {phys=raw*0.1} "The scaling of CAN input signal Pressure_5, frame RT_DL1MK3_Pressure_5, 9438500 (0x900524). Scaling: WorldValue = 0.1*BinaryValue + 0.0 []. Unit: The unit "" from the network database is mapped to the AUTOSAR unit NoUnit", range phys 0 "The range of CAN input signal Pressure_5, frame RT_DL1MK3_Pressure_5, 9438500 (0x900524). Range (world values): 0.0 ... 0.0 []"  # The type of CAN input signal Pressure_5, frame RT_DL1MK3_Pressure_5, 9438500 (0x900524). Implementation type is uint32
  app type cif_0x900424_Pressure_4_t: category=VALUE, compu {phys=raw*0.1} "The scaling of CAN input signal Pressure_4, frame RT_DL1MK3_Pressure_4, 9438244 (0x900424). Scaling: WorldValue = 0.1*BinaryValue + 0.0 []. Unit: The unit "" from the network database is mapped to the AUTOSAR unit NoUnit", range phys 0 "The range of CAN input signal Pressure_4, frame RT_DL1MK3_Pressure_4, 9438244 (0x900424). Range (world values): 0.0 ... 0.0 []"  # The type of CAN input signal Pressure_4, frame RT_DL1MK3_Pressure_4, 9438244 (0x900424). Implementation type is uint32
  app type cif_0x900324_Pressure_3_t: category=VALUE, compu {phys=raw*0.1} "The scaling of CAN input signal Pressure_3, frame RT_DL1MK3_Pressure_3, 9437988 (0x900324). Scaling: WorldValue = 0.1*BinaryValue + 0.0 []. Unit: The unit "" from the network database is mapped to the AUTOSAR unit NoUnit", range phys 0 "The range of CAN input signal Pressure_3, frame RT_DL1MK3_Pressure_3, 9437988 (0x900324). Range (world values): 0.0 ... 0.0 []"  # The type of CAN input signal Pressure_3, frame RT_DL1MK3_Pressure_3, 9437988 (0x900324). Implementation type is uint32
  app type cif_0x900224_Pressure_2_t: category=VALUE, compu {phys=raw*0.1} "The scaling of CAN input signal Pressure_2, frame RT_DL1MK3_Pressure_2, 9437732 (0x900224). Scaling: WorldValue = 0.1*BinaryValue + 0.0 []. Unit: The unit "" from the network database is mapped to the AUTOSAR unit NoUnit", range phys 0 "The range of CAN input signal Pressure_2, frame RT_DL1MK3_Pressure_2, 9437732 (0x900224). Range (world values): 0.0 ... 0.0 []"  # The type of CAN input signal Pressure_2, frame RT_DL1MK3_Pressure_2, 9437732 (0x900224). Implementation type is uint32
  app type cif_0x900124_Pressure_1_t: category=VALUE, compu {phys=raw*0.1} "The scaling of CAN input signal Pressure_1, frame RT_DL1MK3_Pressure_1, 9437476 (0x900124). Scaling: WorldValue = 0.1*BinaryValue + 0.0 []. Unit: The unit "" from the network database is mapped to the AUTOSAR unit NoUnit", range phys 0 "The range of CAN input signal Pressure_1, frame RT_DL1MK3_Pressure_1, 9437476 (0x900124). Range (world values): 0.0 ... 0.0 []"  # The type of CAN input signal Pressure_1, frame RT_DL1MK3_Pressure_1, 9437476 (0x900124). Implementation type is uint32
  app type cif_0x920324_Angle_3_t: category=VALUE, compu {phys=raw*0.1} "The scaling of CAN input signal Angle_3, frame RT_DL1MK3_Angle_3, 9569060 (0x920324). Scaling: WorldValue = 0.1*BinaryValue + 0.0 []. Unit: The unit "" from the network database is mapped to the AUTOSAR unit NoUnit", range phys 0 "The range of CAN input signal Angle_3, frame RT_DL1MK3_Angle_3, 9569060 (0x920324). Range (world values): 0.0 ... 0.0 []"  # The type of CAN input signal Angle_3, frame RT_DL1MK3_Angle_3, 9569060 (0x920324). Implementation type is int16
  app type cif_0x920224_Angle_2_t: category=VALUE, compu {phys=raw*0.1} "The scaling of CAN input signal Angle_2, frame RT_DL1MK3_Angle_2, 9568804 (0x920224). Scaling: WorldValue = 0.1*BinaryValue + 0.0 []. Unit: The unit "" from the network database is mapped to the AUTOSAR unit NoUnit", range phys 0 "The range of CAN input signal Angle_2, frame RT_DL1MK3_Angle_2, 9568804 (0x920224). Range (world values): 0.0 ... 0.0 []"  # The type of CAN input signal Angle_2, frame RT_DL1MK3_Angle_2, 9568804 (0x920224). Implementation type is int16
  app type cif_0x920124_Angle_1_t: category=VALUE, compu {phys=raw*0.1} "The scaling of CAN input signal Angle_1, frame RT_DL1MK3_Angle_1, 9568548 (0x920124). Scaling: WorldValue = 0.1*BinaryValue + 0.0 []. Unit: The unit "" from the network database is mapped to the AUTOSAR unit NoUnit", range phys 0 "The range of CAN input signal Angle_1, frame RT_DL1MK3_Angle_1, 9568548 (0x920124). Range (world values): 0.0 ... 0.0 []"  # The type of CAN input signal Angle_1, frame RT_DL1MK3_Angle_1, 9568548 (0x920124). Implementation type is int16
  app type cif_0x911924_Temperature_25_t: category=VALUE, compu {phys=raw*0.1} "The scaling of CAN input signal Temperature_25, frame RT_DL1MK3_Temp_25, 9509156 (0x911924). Scaling: WorldValue = 0.1*BinaryValue + 0.0 []. Unit: The unit "" from the network database is mapped to the AUTOSAR unit NoUnit", range phys 0 "The range of CAN input signal Temperature_25, frame RT_DL1MK3_Temp_25, 9509156 (0x911924). Range (world values): 0.0 ... 0.0 []"  # The type of CAN input signal Temperature_25, frame RT_DL1MK3_Temp_25, 9509156 (0x911924). Implementation type is int16
  app type cif_0x911824_Temperature_24_t: category=VALUE, compu {phys=raw*0.1} "The scaling of CAN input signal Temperature_24, frame RT_DL1MK3_Temp_24, 9508900 (0x911824). Scaling: WorldValue = 0.1*BinaryValue + 0.0 []. Unit: The unit "" from the network database is mapped to the AUTOSAR unit NoUnit", range phys 0 "The range of CAN input signal Temperature_24, frame RT_DL1MK3_Temp_24, 9508900 (0x911824). Range (world values): 0.0 ... 0.0 []"  # The type of CAN input signal Temperature_24, frame RT_DL1MK3_Temp_24, 9508900 (0x911824). Implementation type is int16
  app type cif_0x911724_Temperature_23_t: category=VALUE, compu {phys=raw*0.1} "The scaling of CAN input signal Temperature_23, frame RT_DL1MK3_Temp_23, 9508644 (0x911724). Scaling: WorldValue = 0.1*BinaryValue + 0.0 []. Unit: The unit "" from the network database is mapped to the AUTOSAR unit NoUnit", range phys 0 "The range of CAN input signal Temperature_23, frame RT_DL1MK3_Temp_23, 9508644 (0x911724). Range (world values): 0.0 ... 0.0 []"  # The type of CAN input signal Temperature_23, frame RT_DL1MK3_Temp_23, 9508644 (0x911724). Implementation type is int16
  app type cif_0x911624_Temperature_22_t: category=VALUE, compu {phys=raw*0.1} "The scaling of CAN input signal Temperature_22, frame RT_DL1MK3_Temp_22, 9508388 (0x911624). Scaling: WorldValue = 0.1*BinaryValue + 0.0 []. Unit: The unit "" from the network database is mapped to the AUTOSAR unit NoUnit", range phys 0 "The range of CAN input signal Temperature_22, frame RT_DL1MK3_Temp_22, 9508388 (0x911624). Range (world values): 0.0 ... 0.0 []"  # The type of CAN input signal Temperature_22, frame RT_DL1MK3_Temp_22, 9508388 (0x911624). Implementation type is int16
  app type cif_0x911524_Temperature_21_t: category=VALUE, compu {phys=raw*0.1} "The scaling of CAN input signal Temperature_21, frame RT_DL1MK3_Temp_21, 9508132 (0x911524). Scaling: WorldValue = 0.1*BinaryValue + 0.0 []. Unit: The unit "" from the network database is mapped to the AUTOSAR unit NoUnit", range phys 0 "The range of CAN input signal Temperature_21, frame RT_DL1MK3_Temp_21, 9508132 (0x911524). Range (world values): 0.0 ... 0.0 []"  # The type of CAN input signal Temperature_21, frame RT_DL1MK3_Temp_21, 9508132 (0x911524). Implementation type is int16
  app type cif_0x911424_Temperature_20_t: category=VALUE, compu {phys=raw*0.1} "The scaling of CAN input signal Temperature_20, frame RT_DL1MK3_Temp_20, 9507876 (0x911424). Scaling: WorldValue = 0.1*BinaryValue + 0.0 []. Unit: The unit "" from the network database is mapped to the AUTOSAR unit NoUnit", range phys 0 "The range of CAN input signal Temperature_20, frame RT_DL1MK3_Temp_20, 9507876 (0x911424). Range (world values): 0.0 ... 0.0 []"  # The type of CAN input signal Temperature_20, frame RT_DL1MK3_Temp_20, 9507876 (0x911424). Implementation type is int16
  app type cif_0x911324_Temperature_19_t: category=VALUE, compu {phys=raw*0.1} "The scaling of CAN input signal Temperature_19, frame RT_DL1MK3_Temp_19, 9507620 (0x911324). Scaling: WorldValue = 0.1*BinaryValue + 0.0 []. Unit: The unit "" from the network database is mapped to the AUTOSAR unit NoUnit", range phys 0 "The range of CAN input signal Temperature_19, frame RT_DL1MK3_Temp_19, 9507620 (0x911324). Range (world values): 0.0 ... 0.0 []"  # The type of CAN input signal Temperature_19, frame RT_DL1MK3_Temp_19, 9507620 (0x911324). Implementation type is int16
  app type cif_0x911224_Temperature_18_t: category=VALUE, compu {phys=raw*0.1} "The scaling of CAN input signal Temperature_18, frame RT_DL1MK3_Temp_18, 9507364 (0x911224). Scaling: WorldValue = 0.1*BinaryValue + 0.0 []. Unit: The unit "" from the network database is mapped to the AUTOSAR unit NoUnit", range phys 0 "The range of CAN input signal Temperature_18, frame RT_DL1MK3_Temp_18, 9507364 (0x911224). Range (world values): 0.0 ... 0.0 []"  # The type of CAN input signal Temperature_18, frame RT_DL1MK3_Temp_18, 9507364 (0x911224). Implementation type is int16
  app type cif_0x911124_Temperature_17_t: category=VALUE, compu {phys=raw*0.1} "The scaling of CAN input signal Temperature_17, frame RT_DL1MK3_Temp_17, 9507108 (0x911124). Scaling: WorldValue = 0.1*BinaryValue + 0.0 []. Unit: The unit "" from the network database is mapped to the AUTOSAR unit NoUnit", range phys 0 "The range of CAN input signal Temperature_17, frame RT_DL1MK3_Temp_17, 9507108 (0x911124). Range (world values): 0.0 ... 0.0 []"  # The type of CAN input signal Temperature_17, frame RT_DL1MK3_Temp_17, 9507108 (0x911124). Implementation type is int16
  app type cif_0x911024_Temperature_16_t: category=VALUE, compu {phys=raw*0.1} "The scaling of CAN input signal Temperature_16, frame RT_DL1MK3_Temp_16, 9506852 (0x911024). Scaling: WorldValue = 0.1*BinaryValue + 0.0 []. Unit: The unit "" from the network database is mapped to the AUTOSAR unit NoUnit", range phys 0 "The range of CAN input signal Temperature_16, frame RT_DL1MK3_Temp_16, 9506852 (0x911024). Range (world values): 0.0 ... 0.0 []"  # The type of CAN input signal Temperature_16, frame RT_DL1MK3_Temp_16, 9506852 (0x911024). Implementation type is int16
  app type cif_0x910f24_Temperature_15_t: category=VALUE, compu {phys=raw*0.1} "The scaling of CAN input signal Temperature_15, frame RT_DL1MK3_Temp_15, 9506596 (0x910f24). Scaling: WorldValue = 0.1*BinaryValue + 0.0 []. Unit: The unit "" from the network database is mapped to the AUTOSAR unit NoUnit", range phys 0 "The range of CAN input signal Temperature_15, frame RT_DL1MK3_Temp_15, 9506596 (0x910f24). Range (world values): 0.0 ... 0.0 []"  # The type of CAN input signal Temperature_15, frame RT_DL1MK3_Temp_15, 9506596 (0x910f24). Implementation type is int16
  app type cif_0x910e24_Temperature_14_t: category=VALUE, compu {phys=raw*0.1} "The scaling of CAN input signal Temperature_14, frame RT_DL1MK3_Temp_14, 9506340 (0x910e24). Scaling: WorldValue = 0.1*BinaryValue + 0.0 []. Unit: The unit "" from the network database is mapped to the AUTOSAR unit NoUnit", range phys 0 "The range of CAN input signal Temperature_14, frame RT_DL1MK3_Temp_14, 9506340 (0x910e24). Range (world values): 0.0 ... 0.0 []"  # The type of CAN input signal Temperature_14, frame RT_DL1MK3_Temp_14, 9506340 (0x910e24). Implementation type is int16
  app type cif_0x910d24_Temperature_13_t: category=VALUE, compu {phys=raw*0.1} "The scaling of CAN input signal Temperature_13, frame RT_DL1MK3_Temp_13, 9506084 (0x910d24). Scaling: WorldValue = 0.1*BinaryValue + 0.0 []. Unit: The unit "" from the network database is mapped to the AUTOSAR unit NoUnit", range phys 0 "The range of CAN input signal Temperature_13, frame RT_DL1MK3_Temp_13, 9506084 (0x910d24). Range (world values): 0.0 ... 0.0 []"  # The type of CAN input signal Temperature_13, frame RT_DL1MK3_Temp_13, 9506084 (0x910d24). Implementation type is int16
  app type cif_0x910c24_Temperature_12_t: category=VALUE, compu {phys=raw*0.1} "The scaling of CAN input signal Temperature_12, frame RT_DL1MK3_Temp_12, 9505828 (0x910c24). Scaling: WorldValue = 0.1*BinaryValue + 0.0 []. Unit: The unit "" from the network database is mapped to the AUTOSAR unit NoUnit", range phys 0 "The range of CAN input signal Temperature_12, frame RT_DL1MK3_Temp_12, 9505828 (0x910c24). Range (world values): 0.0 ... 0.0 []"  # The type of CAN input signal Temperature_12, frame RT_DL1MK3_Temp_12, 9505828 (0x910c24). Implementation type is int16
  app type cif_0x910b24_Temperature_11_t: category=VALUE, compu {phys=raw*0.1} "The scaling of CAN input signal Temperature_11, frame RT_DL1MK3_Temp_11, 9505572 (0x910b24). Scaling: WorldValue = 0.1*BinaryValue + 0.0 []. Unit: The unit "" from the network database is mapped to the AUTOSAR unit NoUnit", range phys 0 "The range of CAN input signal Temperature_11, frame RT_DL1MK3_Temp_11, 9505572 (0x910b24). Range (world values): 0.0 ... 0.0 []"  # The type of CAN input signal Temperature_11, frame RT_DL1MK3_Temp_11, 9505572 (0x910b24). Implementation type is int16
  app type cif_0x910a24_Temperature_10_t: category=VALUE, compu {phys=raw*0.1} "The scaling of CAN input signal Temperature_10, frame RT_DL1MK3_Temp_10, 9505316 (0x910a24). Scaling: WorldValue = 0.1*BinaryValue + 0.0 []. Unit: The unit "" from the network database is mapped to the AUTOSAR unit NoUnit", range phys 0 "The range of CAN input signal Temperature_10, frame RT_DL1MK3_Temp_10, 9505316 (0x910a24). Range (world values): 0.0 ... 0.0 []"  # The type of CAN input signal Temperature_10, frame RT_DL1MK3_Temp_10, 9505316 (0x910a24). Implementation type is int16
  app type cif_0x910924_Temperature_9_t: category=VALUE, compu {phys=raw*0.1} "The scaling of CAN input signal Temperature_9, frame RT_DL1MK3_Temp_9, 9505060 (0x910924). Scaling: WorldValue = 0.1*BinaryValue + 0.0 []. Unit: The unit "" from the network database is mapped to the AUTOSAR unit NoUnit", range phys 0 "The range of CAN input signal Temperature_9, frame RT_DL1MK3_Temp_9, 9505060 (0x910924). Range (world values): 0.0 ... 0.0 []"  # The type of CAN input signal Temperature_9, frame RT_DL1MK3_Temp_9, 9505060 (0x910924). Implementation type is int16
  app type cif_0x910824_Temperature_8_t: category=VALUE, compu {phys=raw*0.1} "The scaling of CAN input signal Temperature_8, frame RT_DL1MK3_Temp_8, 9504804 (0x910824). Scaling: WorldValue = 0.1*BinaryValue + 0.0 []. Unit: The unit "" from the network database is mapped to the AUTOSAR unit NoUnit", range phys 0 "The range of CAN input signal Temperature_8, frame RT_DL1MK3_Temp_8, 9504804 (0x910824). Range (world values): 0.0 ... 0.0 []"  # The type of CAN input signal Temperature_8, frame RT_DL1MK3_Temp_8, 9504804 (0x910824). Implementation type is int16
  app type cif_0x910724_Temperature_7_t: category=VALUE, compu {phys=raw*0.1} "The scaling of CAN input signal Temperature_7, frame RT_DL1MK3_Temp_7, 9504548 (0x910724). Scaling: WorldValue = 0.1*BinaryValue + 0.0 []. Unit: The unit "" from the network database is mapped to the AUTOSAR unit NoUnit", range phys 0 "The range of CAN input signal Temperature_7, frame RT_DL1MK3_Temp_7, 9504548 (0x910724). Range (world values): 0.0 ... 0.0 []"  # The type of CAN input signal Temperature_7, frame RT_DL1MK3_Temp_7, 9504548 (0x910724). Implementation type is int16
  app type cif_0x910624_Temperature_6_t: category=VALUE, compu {phys=raw*0.1} "The scaling of CAN input signal Temperature_6, frame RT_DL1MK3_Temp_6, 9504292 (0x910624). Scaling: WorldValue = 0.1*BinaryValue + 0.0 []. Unit: The unit "" from the network database is mapped to the AUTOSAR unit NoUnit", range phys 0 "The range of CAN input signal Temperature_6, frame RT_DL1MK3_Temp_6, 9504292 (0x910624). Range (world values): 0.0 ... 0.0 []"  # The type of CAN input signal Temperature_6, frame RT_DL1MK3_Temp_6, 9504292 (0x910624). Implementation type is int16
  app type cif_0x910524_Temperature_5_t: category=VALUE, compu {phys=raw*0.1} "The scaling of CAN input signal Temperature_5, frame RT_DL1MK3_Temp_5, 9504036 (0x910524). Scaling: WorldValue = 0.1*BinaryValue + 0.0 []. Unit: The unit "" from the network database is mapped to the AUTOSAR unit NoUnit", range phys 0 "The range of CAN input signal Temperature_5, frame RT_DL1MK3_Temp_5, 9504036 (0x910524). Range (world values): 0.0 ... 0.0 []"  # The type of CAN input signal Temperature_5, frame RT_DL1MK3_Temp_5, 9504036 (0x910524). Implementation type is int16
  app type cif_0x910424_Temperature_4_t: category=VALUE, compu {phys=raw*0.1} "The scaling of CAN input signal Temperature_4, frame RT_DL1MK3_Temp_4, 9503780 (0x910424). Scaling: WorldValue = 0.1*BinaryValue + 0.0 []. Unit: The unit "" from the network database is mapped to the AUTOSAR unit NoUnit", range phys 0 "The range of CAN input signal Temperature_4, frame RT_DL1MK3_Temp_4, 9503780 (0x910424). Range (world values): 0.0 ... 0.0 []"  # The type of CAN input signal Temperature_4, frame RT_DL1MK3_Temp_4, 9503780 (0x910424). Implementation type is int16
  app type cif_0x910324_Temperature_3_t: category=VALUE, compu {phys=raw*0.1} "The scaling of CAN input signal Temperature_3, frame RT_DL1MK3_Temp_3, 9503524 (0x910324). Scaling: WorldValue = 0.1*BinaryValue + 0.0 []. Unit: The unit "" from the network database is mapped to the AUTOSAR unit NoUnit", range phys 0 "The range of CAN input signal Temperature_3, frame RT_DL1MK3_Temp_3, 9503524 (0x910324). Range (world values): 0.0 ... 0.0 []"  # The type of CAN input signal Temperature_3, frame RT_DL1MK3_Temp_3, 9503524 (0x910324). Implementation type is int16
  app type cif_0x910224_Temperature_2_t: category=VALUE, compu {phys=raw*0.1} "The scaling of CAN input signal Temperature_2, frame RT_DL1MK3_Temp_2, 9503268 (0x910224). Scaling: WorldValue = 0.1*BinaryValue + 0.0 []. Unit: The unit "" from the network database is mapped to the AUTOSAR unit NoUnit", range phys 0 "The range of CAN input signal Temperature_2, frame RT_DL1MK3_Temp_2, 9503268 (0x910224). Range (world values): 0.0 ... 0.0 []"  # The type of CAN input signal Temperature_2, frame RT_DL1MK3_Temp_2, 9503268 (0x910224). Implementation type is int16
  app type cif_0x910124_Temperature_1_t: category=VALUE, compu {phys=raw*0.1} "The scaling of CAN input signal Temperature_1, frame RT_DL1MK3_Temp_1, 9503012 (0x910124). Scaling: WorldValue = 0.1*BinaryValue + 0.0 []. Unit: The unit "" from the network database is mapped to the AUTOSAR unit NoUnit", range phys 0 "The range of CAN input signal Temperature_1, frame RT_DL1MK3_Temp_1, 9503012 (0x910124). Range (world values): 0.0 ... 0.0 []"  # The type of CAN input signal Temperature_1, frame RT_DL1MK3_Temp_1, 9503012 (0x910124). Implementation type is int16
  app type cif_0x821f24_Analog_32_t: category=VALUE, compu {phys=raw*0.001} "The scaling of CAN input signal Analog_32, frame RT_DL1MK3_Analog_32, 8527652 (0x821f24). Scaling: WorldValue = 0.001*BinaryValue + 0.0 []. Unit: The unit "" from the network database is mapped to the AUTOSAR unit NoUnit", range phys 0 "The range of CAN input signal Analog_32, frame RT_DL1MK3_Analog_32, 8527652 (0x821f24). Range (world values): 0.0 ... 0.0 []"  # The type of CAN input signal Analog_32, frame RT_DL1MK3_Analog_32, 8527652 (0x821f24). Implementation type is uint16
  app type cif_0x821e24_Analog_31_t: category=VALUE, compu {phys=raw*0.001} "The scaling of CAN input signal Analog_31, frame RT_DL1MK3_Analog_31, 8527396 (0x821e24). Scaling: WorldValue = 0.001*BinaryValue + 0.0 []. Unit: The unit "" from the network database is mapped to the AUTOSAR unit NoUnit", range phys 0 "The range of CAN input signal Analog_31, frame RT_DL1MK3_Analog_31, 8527396 (0x821e24). Range (world values): 0.0 ... 0.0 []"  # The type of CAN input signal Analog_31, frame RT_DL1MK3_Analog_31, 8527396 (0x821e24). Implementation type is uint16
  app type cif_0x821d24_Analog_30_t: category=VALUE, compu {phys=raw*0.001} "The scaling of CAN input signal Analog_30, frame RT_DL1MK3_Analog_30, 8527140 (0x821d24). Scaling: WorldValue = 0.001*BinaryValue + 0.0 []. Unit: The unit "" from the network database is mapped to the AUTOSAR unit NoUnit", range phys 0 "The range of CAN input signal Analog_30, frame RT_DL1MK3_Analog_30, 8527140 (0x821d24). Range (world values): 0.0 ... 0.0 []"  # The type of CAN input signal Analog_30, frame RT_DL1MK3_Analog_30, 8527140 (0x821d24). Implementation type is uint16
  app type cif_0x821c24_Analog_29_t: category=VALUE, compu {phys=raw*0.001} "The scaling of CAN input signal Analog_29, frame RT_DL1MK3_Analog_29, 8526884 (0x821c24). Scaling: WorldValue = 0.001*BinaryValue + 0.0 []. Unit: The unit "" from the network database is mapped to the AUTOSAR unit NoUnit", range phys 0 "The range of CAN input signal Analog_29, frame RT_DL1MK3_Analog_29, 8526884 (0x821c24). Range (world values): 0.0 ... 0.0 []"  # The type of CAN input signal Analog_29, frame RT_DL1MK3_Analog_29, 8526884 (0x821c24). Implementation type is uint16
  app type cif_0x821b24_Analog_28_t: category=VALUE, compu {phys=raw*0.001} "The scaling of CAN input signal Analog_28, frame RT_DL1MK3_Analog_28, 8526628 (0x821b24). Scaling: WorldValue = 0.001*BinaryValue + 0.0 []. Unit: The unit "" from the network database is mapped to the AUTOSAR unit NoUnit", range phys 0 "The range of CAN input signal Analog_28, frame RT_DL1MK3_Analog_28, 8526628 (0x821b24). Range (world values): 0.0 ... 0.0 []"  # The type of CAN input signal Analog_28, frame RT_DL1MK3_Analog_28, 8526628 (0x821b24). Implementation type is uint16
  app type cif_0x821a24_Analog_27_t: category=VALUE, compu {phys=raw*0.001} "The scaling of CAN input signal Analog_27, frame RT_DL1MK3_Analog_27, 8526372 (0x821a24). Scaling: WorldValue = 0.001*BinaryValue + 0.0 []. Unit: The unit "" from the network database is mapped to the AUTOSAR unit NoUnit", range phys 0 "The range of CAN input signal Analog_27, frame RT_DL1MK3_Analog_27, 8526372 (0x821a24). Range (world values): 0.0 ... 0.0 []"  # The type of CAN input signal Analog_27, frame RT_DL1MK3_Analog_27, 8526372 (0x821a24). Implementation type is uint16
  app type cif_0x821924_Analog_26_t: category=VALUE, compu {phys=raw*0.001} "The scaling of CAN input signal Analog_26, frame RT_DL1MK3_Analog_26, 8526116 (0x821924). Scaling: WorldValue = 0.001*BinaryValue + 0.0 []. Unit: The unit "" from the network database is mapped to the AUTOSAR unit NoUnit", range phys 0 "The range of CAN input signal Analog_26, frame RT_DL1MK3_Analog_26, 8526116 (0x821924). Range (world values): 0.0 ... 0.0 []"  # The type of CAN input signal Analog_26, frame RT_DL1MK3_Analog_26, 8526116 (0x821924). Implementation type is uint16
  app type cif_0x821824_Analog_25_t: category=VALUE, compu {phys=raw*0.001} "The scaling of CAN input signal Analog_25, frame RT_DL1MK3_Analog_25, 8525860 (0x821824). Scaling: WorldValue = 0.001*BinaryValue + 0.0 []. Unit: The unit "" from the network database is mapped to the AUTOSAR unit NoUnit", range phys 0 "The range of CAN input signal Analog_25, frame RT_DL1MK3_Analog_25, 8525860 (0x821824). Range (world values): 0.0 ... 0.0 []"  # The type of CAN input signal Analog_25, frame RT_DL1MK3_Analog_25, 8525860 (0x821824). Implementation type is uint16
  app type cif_0x820e24_Analog_15_t: category=VALUE, compu {phys=raw*0.001} "The scaling of CAN input signal Analog_15, frame RT_DL1MK3_Analog_15, 8523300 (0x820e24). Scaling: WorldValue = 0.001*BinaryValue + 0.0 []. Unit: The unit "" from the network database is mapped to the AUTOSAR unit NoUnit", range phys 0 "The range of CAN input signal Analog_15, frame RT_DL1MK3_Analog_15, 8523300 (0x820e24). Range (world values): 0.0 ... 0.0 []"  # The type of CAN input signal Analog_15, frame RT_DL1MK3_Analog_15, 8523300 (0x820e24). Implementation type is uint16
  app type cif_0x820d24_Analog_14_t: category=VALUE, compu {phys=raw*0.001} "The scaling of CAN input signal Analog_14, frame RT_DL1MK3_Analog_14, 8523044 (0x820d24). Scaling: WorldValue = 0.001*BinaryValue + 0.0 []. Unit: The unit "" from the network database is mapped to the AUTOSAR unit NoUnit", range phys 0 "The range of CAN input signal Analog_14, frame RT_DL1MK3_Analog_14, 8523044 (0x820d24). Range (world values): 0.0 ... 0.0 []"  # The type of CAN input signal Analog_14, frame RT_DL1MK3_Analog_14, 8523044 (0x820d24). Implementation type is uint16
  app type cif_0x821024_Analog_17_t: category=VALUE, compu {phys=raw*0.001} "The scaling of CAN input signal Analog_17, frame RT_DL1MK3_Analog_17, 8523812 (0x821024). Scaling: WorldValue = 0.001*BinaryValue + 0.0 []. Unit: The unit "" from the network database is mapped to the AUTOSAR unit NoUnit", range phys 0 "The range of CAN input signal Analog_17, frame RT_DL1MK3_Analog_17, 8523812 (0x821024). Range (world values): 0.0 ... 0.0 []"  # The type of CAN input signal Analog_17, frame RT_DL1MK3_Analog_17, 8523812 (0x821024). Implementation type is uint16
  app type cif_0x821724_Analog_24_t: category=VALUE, compu {phys=raw*0.001} "The scaling of CAN input signal Analog_24, frame RT_DL1MK3_Analog_24, 8525604 (0x821724). Scaling: WorldValue = 0.001*BinaryValue + 0.0 []. Unit: The unit "" from the network database is mapped to the AUTOSAR unit NoUnit", range phys 0 "The range of CAN input signal Analog_24, frame RT_DL1MK3_Analog_24, 8525604 (0x821724). Range (world values): 0.0 ... 0.0 []"  # The type of CAN input signal Analog_24, frame RT_DL1MK3_Analog_24, 8525604 (0x821724). Implementation type is uint16
  app type cif_0x821624_Analog_23_t: category=VALUE, compu {phys=raw*0.001} "The scaling of CAN input signal Analog_23, frame RT_DL1MK3_Analog_23, 8525348 (0x821624). Scaling: WorldValue = 0.001*BinaryValue + 0.0 []. Unit: The unit "" from the network database is mapped to the AUTOSAR unit NoUnit", range phys 0 "The range of CAN input signal Analog_23, frame RT_DL1MK3_Analog_23, 8525348 (0x821624). Range (world values): 0.0 ... 0.0 []"  # The type of CAN input signal Analog_23, frame RT_DL1MK3_Analog_23, 8525348 (0x821624). Implementation type is uint16
  app type cif_0x821524_Analog_22_t: category=VALUE, compu {phys=raw*0.001} "The scaling of CAN input signal Analog_22, frame RT_DL1MK3_Analog_22, 8525092 (0x821524). Scaling: WorldValue = 0.001*BinaryValue + 0.0 []. Unit: The unit "" from the network database is mapped to the AUTOSAR unit NoUnit", range phys 0 "The range of CAN input signal Analog_22, frame RT_DL1MK3_Analog_22, 8525092 (0x821524). Range (world values): 0.0 ... 0.0 []"  # The type of CAN input signal Analog_22, frame RT_DL1MK3_Analog_22, 8525092 (0x821524). Implementation type is uint16
  app type cif_0x821424_Analog_21_t: category=VALUE, compu {phys=raw*0.001} "The scaling of CAN input signal Analog_21, frame RT_DL1MK3_Analog_21, 8524836 (0x821424). Scaling: WorldValue = 0.001*BinaryValue + 0.0 []. Unit: The unit "" from the network database is mapped to the AUTOSAR unit NoUnit", range phys 0 "The range of CAN input signal Analog_21, frame RT_DL1MK3_Analog_21, 8524836 (0x821424). Range (world values): 0.0 ... 0.0 []"  # The type of CAN input signal Analog_21, frame RT_DL1MK3_Analog_21, 8524836 (0x821424). Implementation type is uint16
  app type cif_0x821324_Analog_20_t: category=VALUE, compu {phys=raw*0.001} "The scaling of CAN input signal Analog_20, frame RT_DL1MK3_Analog_20, 8524580 (0x821324). Scaling: WorldValue = 0.001*BinaryValue + 0.0 []. Unit: The unit "" from the network database is mapped to the AUTOSAR unit NoUnit", range phys 0 "The range of CAN input signal Analog_20, frame RT_DL1MK3_Analog_20, 8524580 (0x821324). Range (world values): 0.0 ... 0.0 []"  # The type of CAN input signal Analog_20, frame RT_DL1MK3_Analog_20, 8524580 (0x821324). Implementation type is uint16
  app type cif_0x821224_Analog_19_t: category=VALUE, compu {phys=raw*0.001} "The scaling of CAN input signal Analog_19, frame RT_DL1MK3_Analog_19, 8524324 (0x821224). Scaling: WorldValue = 0.001*BinaryValue + 0.0 []. Unit: The unit "" from the network database is mapped to the AUTOSAR unit NoUnit", range phys 0 "The range of CAN input signal Analog_19, frame RT_DL1MK3_Analog_19, 8524324 (0x821224). Range (world values): 0.0 ... 0.0 []"  # The type of CAN input signal Analog_19, frame RT_DL1MK3_Analog_19, 8524324 (0x821224). Implementation type is uint16
  app type cif_0x820f24_Analog_16_t: category=VALUE, compu {phys=raw*0.001} "The scaling of CAN input signal Analog_16, frame RT_DL1MK3_Analog_16, 8523556 (0x820f24). Scaling: WorldValue = 0.001*BinaryValue + 0.0 []. Unit: The unit "" from the network database is mapped to the AUTOSAR unit NoUnit", range phys 0 "The range of CAN input signal Analog_16, frame RT_DL1MK3_Analog_16, 8523556 (0x820f24). Range (world values): 0.0 ... 0.0 []"  # The type of CAN input signal Analog_16, frame RT_DL1MK3_Analog_16, 8523556 (0x820f24). Implementation type is uint16
  app type cif_0x821124_Analog_18_t: category=VALUE, compu {phys=raw*0.001} "The scaling of CAN input signal Analog_18, frame RT_DL1MK3_Analog_18, 8524068 (0x821124). Scaling: WorldValue = 0.001*BinaryValue + 0.0 []. Unit: The unit "" from the network database is mapped to the AUTOSAR unit NoUnit", range phys 0 "The range of CAN input signal Analog_18, frame RT_DL1MK3_Analog_18, 8524068 (0x821124). Range (world values): 0.0 ... 0.0 []"  # The type of CAN input signal Analog_18, frame RT_DL1MK3_Analog_18, 8524068 (0x821124). Implementation type is uint16
  app type cif_0x820b24_Analog_12_t: category=VALUE, compu {phys=raw*0.001} "The scaling of CAN input signal Analog_12, frame RT_DL1MK3_Analog_12, 8522532 (0x820b24). Scaling: WorldValue = 0.001*BinaryValue + 0.0 []. Unit: The unit "" from the network database is mapped to the AUTOSAR unit NoUnit", range phys 0 "The range of CAN input signal Analog_12, frame RT_DL1MK3_Analog_12, 8522532 (0x820b24). Range (world values): 0.0 ... 0.0 []"  # The type of CAN input signal Analog_12, frame RT_DL1MK3_Analog_12, 8522532 (0x820b24). Implementation type is uint16
  app type cif_0x820a24_Analog_11_t: category=VALUE, compu {phys=raw*0.001} "The scaling of CAN input signal Analog_11, frame RT_DL1MK3_Analog_11, 8522276 (0x820a24). Scaling: WorldValue = 0.001*BinaryValue + 0.0 []. Unit: The unit "" from the network database is mapped to the AUTOSAR unit NoUnit", range phys 0 "The range of CAN input signal Analog_11, frame RT_DL1MK3_Analog_11, 8522276 (0x820a24). Range (world values): 0.0 ... 0.0 []"  # The type of CAN input signal Analog_11, frame RT_DL1MK3_Analog_11, 8522276 (0x820a24). Implementation type is uint16
  app type cif_0x820924_Analog_10_t: category=VALUE, compu {phys=raw*0.001} "The scaling of CAN input signal Analog_10, frame RT_DL1MK3_Analog_10, 8522020 (0x820924). Scaling: WorldValue = 0.001*BinaryValue + 0.0 []. Unit: The unit "" from the network database is mapped to the AUTOSAR unit NoUnit", range phys 0 "The range of CAN input signal Analog_10, frame RT_DL1MK3_Analog_10, 8522020 (0x820924). Range (world values): 0.0 ... 0.0 []"  # The type of CAN input signal Analog_10, frame RT_DL1MK3_Analog_10, 8522020 (0x820924). Implementation type is uint16
  app type cif_0x820824_Analog_9_t: category=VALUE, compu {phys=raw*0.001} "The scaling of CAN input signal Analog_9, frame RT_DL1MK3_Analog_9, 8521764 (0x820824). Scaling: WorldValue = 0.001*BinaryValue + 0.0 []. Unit: The unit "" from the network database is mapped to the AUTOSAR unit NoUnit", range phys 0 "The range of CAN input signal Analog_9, frame RT_DL1MK3_Analog_9, 8521764 (0x820824). Range (world values): 0.0 ... 0.0 []"  # The type of CAN input signal Analog_9, frame RT_DL1MK3_Analog_9, 8521764 (0x820824). Implementation type is uint16
  app type cif_0x820724_Analog_8_t: category=VALUE, compu {phys=raw*0.001} "The scaling of CAN input signal Analog_8, frame RT_DL1MK3_Analog_8, 8521508 (0x820724). Scaling: WorldValue = 0.001*BinaryValue + 0.0 []. Unit: The unit "" from the network database is mapped to the AUTOSAR unit NoUnit", range phys 0 "The range of CAN input signal Analog_8, frame RT_DL1MK3_Analog_8, 8521508 (0x820724). Range (world values): 0.0 ... 0.0 []"  # The type of CAN input signal Analog_8, frame RT_DL1MK3_Analog_8, 8521508 (0x820724). Implementation type is uint16
  app type cif_0x820624_Analog_7_t: category=VALUE, compu {phys=raw*0.001} "The scaling of CAN input signal Analog_7, frame RT_DL1MK3_Analog_7, 8521252 (0x820624). Scaling: WorldValue = 0.001*BinaryValue + 0.0 []. Unit: The unit "" from the network database is mapped to the AUTOSAR unit NoUnit", range phys 0 "The range of CAN input signal Analog_7, frame RT_DL1MK3_Analog_7, 8521252 (0x820624). Range (world values): 0.0 ... 0.0 []"  # The type of CAN input signal Analog_7, frame RT_DL1MK3_Analog_7, 8521252 (0x820624). Implementation type is uint16
  app type cif_0x820524_Analog_6_t: category=VALUE, compu {phys=raw*0.001} "The scaling of CAN input signal Analog_6, frame RT_DL1MK3_Analog_6, 8520996 (0x820524). Scaling: WorldValue = 0.001*BinaryValue + 0.0 []. Unit: The unit "" from the network database is mapped to the AUTOSAR unit NoUnit", range phys 0 "The range of CAN input signal Analog_6, frame RT_DL1MK3_Analog_6, 8520996 (0x820524). Range (world values): 0.0 ... 0.0 []"  # The type of CAN input signal Analog_6, frame RT_DL1MK3_Analog_6, 8520996 (0x820524). Implementation type is uint16
  app type cif_0x820424_Analog_5_t: category=VALUE, compu {phys=raw*0.001} "The scaling of CAN input signal Analog_5, frame RT_DL1MK3_Analog_5, 8520740 (0x820424). Scaling: WorldValue = 0.001*BinaryValue + 0.0 []. Unit: The unit "" from the network database is mapped to the AUTOSAR unit NoUnit", range phys 0 "The range of CAN input signal Analog_5, frame RT_DL1MK3_Analog_5, 8520740 (0x820424). Range (world values): 0.0 ... 0.0 []"  # The type of CAN input signal Analog_5, frame RT_DL1MK3_Analog_5, 8520740 (0x820424). Implementation type is uint16
  app type cif_0x820324_Analog_4_t: category=VALUE, compu {phys=raw*0.001} "The scaling of CAN input signal Analog_4, frame RT_DL1MK3_Analog_4, 8520484 (0x820324). Scaling: WorldValue = 0.001*BinaryValue + 0.0 []. Unit: The unit "" from the network database is mapped to the AUTOSAR unit NoUnit", range phys 0 "The range of CAN input signal Analog_4, frame RT_DL1MK3_Analog_4, 8520484 (0x820324). Range (world values): 0.0 ... 0.0 []"  # The type of CAN input signal Analog_4, frame RT_DL1MK3_Analog_4, 8520484 (0x820324). Implementation type is uint16
  app type cif_0x820224_Analog_3_t: category=VALUE, compu {phys=raw*0.001} "The scaling of CAN input signal Analog_3, frame RT_DL1MK3_Analog_3, 8520228 (0x820224). Scaling: WorldValue = 0.001*BinaryValue + 0.0 []. Unit: The unit "" from the network database is mapped to the AUTOSAR unit NoUnit", range phys 0 "The range of CAN input signal Analog_3, frame RT_DL1MK3_Analog_3, 8520228 (0x820224). Range (world values): 0.0 ... 0.0 []"  # The type of CAN input signal Analog_3, frame RT_DL1MK3_Analog_3, 8520228 (0x820224). Implementation type is uint16
  app type cif_0x820124_Analog_2_t: category=VALUE, compu {phys=raw*0.001} "The scaling of CAN input signal Analog_2, frame RT_DL1MK3_Analog_2, 8519972 (0x820124). Scaling: WorldValue = 0.001*BinaryValue + 0.0 []. Unit: The unit "" from the network database is mapped to the AUTOSAR unit NoUnit", range phys 0 "The range of CAN input signal Analog_2, frame RT_DL1MK3_Analog_2, 8519972 (0x820124). Range (world values): 0.0 ... 0.0 []"  # The type of CAN input signal Analog_2, frame RT_DL1MK3_Analog_2, 8519972 (0x820124). Implementation type is uint16
  app type cif_0x820024_Analog_1_t: category=VALUE, compu {phys=raw*0.001} "The scaling of CAN input signal Analog_1, frame RT_DL1MK3_Analog_1, 8519716 (0x820024). Scaling: WorldValue = 0.001*BinaryValue + 0.0 []. Unit: The unit "" from the network database is mapped to the AUTOSAR unit NoUnit", range phys 0 "The range of CAN input signal Analog_1, frame RT_DL1MK3_Analog_1, 8519716 (0x820024). Range (world values): 0.0 ... 0.0 []"  # The type of CAN input signal Analog_1, frame RT_DL1MK3_Analog_1, 8519716 (0x820024). Implementation type is uint16
  app type cif_0x800024_Validity_Accel_Longitudinal_t:  # The type of CAN input signal Validity_Accel_Longitudinal, frame RT_DL1MK3_Accel, 8388644 (0x800024). Valid when bit is set, invalid when bit is clear. Implementation type is boolean
    category=VALUE
    compu {phys=raw} "The scaling of CAN input signal Validity_Accel_Longitudinal, frame RT_DL1MK3_Accel, 8388644 (0x800024). Scaling: WorldValue = BinaryValue []. Unit: The unit "" from the network database is mapped to the AUTOSAR unit NoUnit"
    range phys 0..1 "The range of CAN input signal Validity_Accel_Longitudinal, frame RT_DL1MK3_Accel, 8388644 (0x800024). Range (world values): 0.0 ... 1.0 []"
  app type cif_0x800024_Validity_Accel_Lateral_t:  # The type of CAN input signal Validity_Accel_Lateral, frame RT_DL1MK3_Accel, 8388644 (0x800024). Valid when bit is set, invalid when bit is clear. Implementation type is boolean
    category=VALUE
    compu {phys=raw} "The scaling of CAN input signal Validity_Accel_Lateral, frame RT_DL1MK3_Accel, 8388644 (0x800024). Scaling: WorldValue = BinaryValue []. Unit: The unit "" from the network database is mapped to the AUTOSAR unit NoUnit"
    range phys 0..1 "The range of CAN input signal Validity_Accel_Lateral, frame RT_DL1MK3_Accel, 8388644 (0x800024). Range (world values): 0.0 ... 1.0 []"
  app type cif_0x800024_Validity_Accel_Vertical_t:  # The type of CAN input signal Validity_Accel_Vertical, frame RT_DL1MK3_Accel, 8388644 (0x800024). Valid when bit is set, invalid when bit is clear. Implementation type is boolean
    category=VALUE
    compu {phys=raw} "The scaling of CAN input signal Validity_Accel_Vertical, frame RT_DL1MK3_Accel, 8388644 (0x800024). Scaling: WorldValue = BinaryValue []. Unit: The unit "" from the network database is mapped to the AUTOSAR unit NoUnit"
    range phys 0..1 "The range of CAN input signal Validity_Accel_Vertical, frame RT_DL1MK3_Accel, 8388644 (0x800024). Range (world values): 0.0 ... 1.0 []"
  app type cif_0x800024_SQC_t: category=VALUE, compu {phys=raw} "The scaling of CAN input signal SQC, frame RT_DL1MK3_Accel, 8388644 (0x800024). Scaling: WorldValue = BinaryValue []. Unit: The unit "" from the network database is mapped to the AUTOSAR unit NoUnit", range phys 0..14 "The range of CAN input signal SQC, frame RT_DL1MK3_Accel, 8388644 (0x800024). Range (world values): 0.0 ... 14.0 []"  # The type of CAN input signal SQC, frame RT_DL1MK3_Accel, 8388644 (0x800024). Sequence counter Implementation type is uint8
  app type cif_0x800024_Accuracy_Accel_t: category=VALUE, compu {phys=raw} "The scaling of CAN input signal Accuracy_Accel, frame RT_DL1MK3_Accel, 8388644 (0x800024). Scaling: WorldValue = BinaryValue []. Unit: The unit "" from the network database is mapped to the AUTOSAR unit NoUnit", range phys 0..255 "The range of CAN input signal Accuracy_Accel, frame RT_DL1MK3_Accel, 8388644 (0x800024). Range (world values): 0.0 ... 255.0 []"  # The type of CAN input signal Accuracy_Accel, frame RT_DL1MK3_Accel, 8388644 (0x800024). Dimensionless. Lower values imply but do not guarantee better accuracy than higher values. Implementation type is uint8
  app type cif_0x800024_Accel_Longitudinal_t:  # The type of CAN input signal Accel_Longitudinal, frame RT_DL1MK3_Accel, 8388644 (0x800024). Longitudinal acceleration. This is positive when the vehicle accelerates in a forwards direction. Implementation type is int16
    category=VALUE
    compu {phys=raw*0.001} "The scaling of CAN input signal Accel_Longitudinal, frame RT_DL1MK3_Accel, 8388644 (0x800024). Scaling: WorldValue = 0.001*BinaryValue + 0.0 [g]. Unit: The unit g from the network database is mapped to the AUTOSAR unit NoUnit"
    range phys -65..65 "The range of CAN input signal Accel_Longitudinal, frame RT_DL1MK3_Accel, 8388644 (0x800024). Range (world values): -65.0 ... 65.0 [g]"
  app type cif_0x800024_Accel_Lateral_t:  # The type of CAN input signal Accel_Lateral, frame RT_DL1MK3_Accel, 8388644 (0x800024). Lateral acceleration. This is positive when the vehicle accelerates towards the right, e.g. when cornering around a right-hand bend. Implementation type is int16
    category=VALUE
    compu {phys=raw*0.001} "The scaling of CAN input signal Accel_Lateral, frame RT_DL1MK3_Accel, 8388644 (0x800024). Scaling: WorldValue = 0.001*BinaryValue + 0.0 [g]. Unit: The unit g from the network database is mapped to the AUTOSAR unit NoUnit"
    range phys -65..65 "The range of CAN input signal Accel_Lateral, frame RT_DL1MK3_Accel, 8388644 (0x800024). Range (world values): -65.0 ... 65.0 [g]"
  app type cif_0x800024_Accel_Vertical_t:  # The type of CAN input signal Accel_Vertical, frame RT_DL1MK3_Accel, 8388644 (0x800024). Vertical acceleration. This is positive when the vehicle accelerates in an upwards direction, e.g. when travelling through a dip. Implementation type is int16
    category=VALUE
    compu {phys=raw*0.001} "The scaling of CAN input signal Accel_Vertical, frame RT_DL1MK3_Accel, 8388644 (0x800024). Scaling: WorldValue = 0.001*BinaryValue + 0.0 [g]. Unit: The unit g from the network database is mapped to the AUTOSAR unit NoUnit"
    range phys -65..65 "The range of CAN input signal Accel_Vertical, frame RT_DL1MK3_Accel, 8388644 (0x800024). Range (world values): -65.0 ... 65.0 [g]"
  app type cif_0x8f3222_Virtual_4_Vel_NED_D_t:  # The type of CAN input signal Virtual_4_Vel_NED_D, frame RT_SB_INS_Vpt_4_Vel_NED_2, 9384482 (0x8f3222). VELNED D velocity. This is the velocity vector directly downwards towards the Earth centre at the current local Earth surface position. Implementation type is int32
    category=VALUE
    compu {phys=raw*0.0001} "The scaling of CAN input signal Virtual_4_Vel_NED_D, frame RT_SB_INS_Vpt_4_Vel_NED_2, 9384482 (0x8f3222). Scaling: WorldValue = 1.0E-4*BinaryValue + 0.0 [m/s]. Unit: The unit m/s from the network database is mapped to the AUTOSAR unit NoUnit"
    range phys -838..838 "The range of CAN input signal Virtual_4_Vel_NED_D, frame RT_SB_INS_Vpt_4_Vel_NED_2, 9384482 (0x8f3222). Range (world values): -838.0 ... 838.0 [m/s]"
  app type cif_0x8f3222_Virtual_4_Heading_t:  # The type of CAN input signal Virtual_4_Heading, frame RT_SB_INS_Vpt_4_Vel_NED_2, 9384482 (0x8f3222). This is GPS heading, the direction that the vehicle is travelling in the local horizontal plane. Implementation type is int16
    category=VALUE
    compu {phys=raw*0.01} "The scaling of CAN input signal Virtual_4_Heading, frame RT_SB_INS_Vpt_4_Vel_NED_2, 9384482 (0x8f3222). Scaling: WorldValue = 0.01*BinaryValue + 0.0 [degrees]. Unit: The unit degrees from the network database is mapped to the AUTOSAR unit NoUnit"
    range phys -180..180 "The range of CAN input signal Virtual_4_Heading, frame RT_SB_INS_Vpt_4_Vel_NED_2, 9384482 (0x8f3222). Range (world values): -180.0 ... 180.0 [degrees]"
  app type cif_0x8f3222_Virtual_4_Slip_t:  # The type of CAN input signal Virtual_4_Slip, frame RT_SB_INS_Vpt_4_Vel_NED_2, 9384482 (0x8f3222). Slip is defined as the difference between yaw and heading. Implementation type is int16
    category=VALUE
    compu {phys=raw*0.01} "The scaling of CAN input signal Virtual_4_Slip, frame RT_SB_INS_Vpt_4_Vel_NED_2, 9384482 (0x8f3222). Scaling: WorldValue = 0.01*BinaryValue + 0.0 [degrees]. Unit: The unit degrees from the network database is mapped to the AUTOSAR unit NoUnit"
    range phys -180..180 "The range of CAN input signal Virtual_4_Slip, frame RT_SB_INS_Vpt_4_Vel_NED_2, 9384482 (0x8f3222). Range (world values): -180.0 ... 180.0 [degrees]"
  app type cif_0x8f3122_Virtual_4_Vel_NED_N_t:  # The type of CAN input signal Virtual_4_Vel_NED_N, frame RT_SB_INS_Vpt_4_Vel_NED_1, 9384226 (0x8f3122). VELNED N velocity. This is the velocity vector directly North at the current local Earth surface position. Implementation type is int32
    category=VALUE
    compu {phys=raw*0.0001} "The scaling of CAN input signal Virtual_4_Vel_NED_N, frame RT_SB_INS_Vpt_4_Vel_NED_1, 9384226 (0x8f3122). Scaling: WorldValue = 1.0E-4*BinaryValue + 0.0 [m/s]. Unit: The unit m/s from the network database is mapped to the AUTOSAR unit NoUnit"
    range phys -838..838 "The range of CAN input signal Virtual_4_Vel_NED_N, frame RT_SB_INS_Vpt_4_Vel_NED_1, 9384226 (0x8f3122). Range (world values): -838.0 ... 838.0 [m/s]"
  app type cif_0x8f3122_Virtual_4_Vel_NED_E_t:  # The type of CAN input signal Virtual_4_Vel_NED_E, frame RT_SB_INS_Vpt_4_Vel_NED_1, 9384226 (0x8f3122). VELNED E velocity. This is the velocity vector directly East at the current local Earth surface position. Implementation type is int32
    category=VALUE
    compu {phys=raw*0.0001} "The scaling of CAN input signal Virtual_4_Vel_NED_E, frame RT_SB_INS_Vpt_4_Vel_NED_1, 9384226 (0x8f3122). Scaling: WorldValue = 1.0E-4*BinaryValue + 0.0 [m/s]. Unit: The unit m/s from the network database is mapped to the AUTOSAR unit NoUnit"
    range phys -838..838 "The range of CAN input signal Virtual_4_Vel_NED_E, frame RT_SB_INS_Vpt_4_Vel_NED_1, 9384226 (0x8f3122). Range (world values): -838.0 ... 838.0 [m/s]"
  app type cif_0x8f3022_Virtual_4_Offset_X_t:  # The type of CAN input signal Virtual_4_Offset_X, frame RT_SB_INS_Vpt_4_Offset, 9383970 (0x8f3022). X offset of the virtual point in the vehicle body frame. Implementation type is int16
    category=VALUE
    compu {phys=raw*0.001} "The scaling of CAN input signal Virtual_4_Offset_X, frame RT_SB_INS_Vpt_4_Offset, 9383970 (0x8f3022). Scaling: WorldValue = 0.001*BinaryValue + 0.0 [m]. Unit: The unit m from the network database is mapped to the AUTOSAR unit NoUnit"
    range phys -32.768..32.767 "The range of CAN input signal Virtual_4_Offset_X, frame RT_SB_INS_Vpt_4_Offset, 9383970 (0x8f3022). Range (world values): -32.768 ... 32.767 [m]"
  app type cif_0x8f3022_Virtual_4_Offset_Y_t:  # The type of CAN input signal Virtual_4_Offset_Y, frame RT_SB_INS_Vpt_4_Offset, 9383970 (0x8f3022). Y offset of the virtual point in the vehicle body frame. Implementation type is int16
    category=VALUE
    compu {phys=raw*0.001} "The scaling of CAN input signal Virtual_4_Offset_Y, frame RT_SB_INS_Vpt_4_Offset, 9383970 (0x8f3022). Scaling: WorldValue = 0.001*BinaryValue + 0.0 [m]. Unit: The unit m from the network database is mapped to the AUTOSAR unit NoUnit"
    range phys -32.768..32.767 "The range of CAN input signal Virtual_4_Offset_Y, frame RT_SB_INS_Vpt_4_Offset, 9383970 (0x8f3022). Range (world values): -32.768 ... 32.767 [m]"
  app type cif_0x8f3022_Virtual_4_Offset_Z_t:  # The type of CAN input signal Virtual_4_Offset_Z, frame RT_SB_INS_Vpt_4_Offset, 9383970 (0x8f3022). Z offset (+ve downwards) of the virtual point in the vehicle body frame. Implementation type is int16
    category=VALUE
    compu {phys=raw*0.001} "The scaling of CAN input signal Virtual_4_Offset_Z, frame RT_SB_INS_Vpt_4_Offset, 9383970 (0x8f3022). Scaling: WorldValue = 0.001*BinaryValue + 0.0 [m]. Unit: The unit m from the network database is mapped to the AUTOSAR unit NoUnit"
    range phys -32.768..32.767 "The range of CAN input signal Virtual_4_Offset_Z, frame RT_SB_INS_Vpt_4_Offset, 9383970 (0x8f3022). Range (world values): -32.768 ... 32.767 [m]"
  app type cif_0x8f2222_Virtual_3_Vel_NED_D_t:  # The type of CAN input signal Virtual_3_Vel_NED_D, frame RT_SB_INS_Vpt_3_Vel_NED_2, 9380386 (0x8f2222). VELNED D velocity. This is the velocity vector directly downwards towards the Earth centre at the current local Earth surface position. Implementation type is int32
    category=VALUE
    compu {phys=raw*0.0001} "The scaling of CAN input signal Virtual_3_Vel_NED_D, frame RT_SB_INS_Vpt_3_Vel_NED_2, 9380386 (0x8f2222). Scaling: WorldValue = 1.0E-4*BinaryValue + 0.0 [m/s]. Unit: The unit m/s from the network database is mapped to the AUTOSAR unit NoUnit"
    range phys -838..838 "The range of CAN input signal Virtual_3_Vel_NED_D, frame RT_SB_INS_Vpt_3_Vel_NED_2, 9380386 (0x8f2222). Range (world values): -838.0 ... 838.0 [m/s]"
  app type cif_0x8f2222_Virtual_3_Heading_t:  # The type of CAN input signal Virtual_3_Heading, frame RT_SB_INS_Vpt_3_Vel_NED_2, 9380386 (0x8f2222). This is GPS heading, the direction that the vehicle is travelling in the local horizontal plane. Implementation type is int16
    category=VALUE
    compu {phys=raw*0.01} "The scaling of CAN input signal Virtual_3_Heading, frame RT_SB_INS_Vpt_3_Vel_NED_2, 9380386 (0x8f2222). Scaling: WorldValue = 0.01*BinaryValue + 0.0 [degrees]. Unit: The unit degrees from the network database is mapped to the AUTOSAR unit NoUnit"
    range phys -180..180 "The range of CAN input signal Virtual_3_Heading, frame RT_SB_INS_Vpt_3_Vel_NED_2, 9380386 (0x8f2222). Range (world values): -180.0 ... 180.0 [degrees]"
  app type cif_0x8f2222_Virtual_3_Slip_t:  # The type of CAN input signal Virtual_3_Slip, frame RT_SB_INS_Vpt_3_Vel_NED_2, 9380386 (0x8f2222). Slip is defined as the difference between yaw and heading. Implementation type is int16
    category=VALUE
    compu {phys=raw*0.01} "The scaling of CAN input signal Virtual_3_Slip, frame RT_SB_INS_Vpt_3_Vel_NED_2, 9380386 (0x8f2222). Scaling: WorldValue = 0.01*BinaryValue + 0.0 [degrees]. Unit: The unit degrees from the network database is mapped to the AUTOSAR unit NoUnit"
    range phys -180..180 "The range of CAN input signal Virtual_3_Slip, frame RT_SB_INS_Vpt_3_Vel_NED_2, 9380386 (0x8f2222). Range (world values): -180.0 ... 180.0 [degrees]"
  app type cif_0x8f2122_Virtual_3_Vel_NED_N_t:  # The type of CAN input signal Virtual_3_Vel_NED_N, frame RT_SB_INS_Vpt_3_Vel_NED_1, 9380130 (0x8f2122). VELNED N velocity. This is the velocity vector directly North at the current local Earth surface position. Implementation type is int32
    category=VALUE
    compu {phys=raw*0.0001} "The scaling of CAN input signal Virtual_3_Vel_NED_N, frame RT_SB_INS_Vpt_3_Vel_NED_1, 9380130 (0x8f2122). Scaling: WorldValue = 1.0E-4*BinaryValue + 0.0 [m/s]. Unit: The unit m/s from the network database is mapped to the AUTOSAR unit NoUnit"
    range phys -838..838 "The range of CAN input signal Virtual_3_Vel_NED_N, frame RT_SB_INS_Vpt_3_Vel_NED_1, 9380130 (0x8f2122). Range (world values): -838.0 ... 838.0 [m/s]"
  app type cif_0x8f2122_Virtual_3_Vel_NED_E_t:  # The type of CAN input signal Virtual_3_Vel_NED_E, frame RT_SB_INS_Vpt_3_Vel_NED_1, 9380130 (0x8f2122). VELNED E velocity. This is the velocity vector directly East at the current local Earth surface position. Implementation type is int32
    category=VALUE
    compu {phys=raw*0.0001} "The scaling of CAN input signal Virtual_3_Vel_NED_E, frame RT_SB_INS_Vpt_3_Vel_NED_1, 9380130 (0x8f2122). Scaling: WorldValue = 1.0E-4*BinaryValue + 0.0 [m/s]. Unit: The unit m/s from the network database is mapped to the AUTOSAR unit NoUnit"
    range phys -838..838 "The range of CAN input signal Virtual_3_Vel_NED_E, frame RT_SB_INS_Vpt_3_Vel_NED_1, 9380130 (0x8f2122). Range (world values): -838.0 ... 838.0 [m/s]"
  app type cif_0x8f2022_Virtual_3_Offset_X_t:  # The type of CAN input signal Virtual_3_Offset_X, frame RT_SB_INS_Vpt_3_Offset, 9379874 (0x8f2022). X offset of the virtual point in the vehicle body frame. Implementation type is int16
    category=VALUE
    compu {phys=raw*0.001} "The scaling of CAN input signal Virtual_3_Offset_X, frame RT_SB_INS_Vpt_3_Offset, 9379874 (0x8f2022). Scaling: WorldValue = 0.001*BinaryValue + 0.0 [m]. Unit: The unit m from the network database is mapped to the AUTOSAR unit NoUnit"
    range phys -32.768..32.767 "The range of CAN input signal Virtual_3_Offset_X, frame RT_SB_INS_Vpt_3_Offset, 9379874 (0x8f2022). Range (world values): -32.768 ... 32.767 [m]"
  app type cif_0x8f2022_Virtual_3_Offset_Y_t:  # The type of CAN input signal Virtual_3_Offset_Y, frame RT_SB_INS_Vpt_3_Offset, 9379874 (0x8f2022). Y offset of the virtual point in the vehicle body frame. Implementation type is int16
    category=VALUE
    compu {phys=raw*0.001} "The scaling of CAN input signal Virtual_3_Offset_Y, frame RT_SB_INS_Vpt_3_Offset, 9379874 (0x8f2022). Scaling: WorldValue = 0.001*BinaryValue + 0.0 [m]. Unit: The unit m from the network database is mapped to the AUTOSAR unit NoUnit"
    range phys -32.768..32.767 "The range of CAN input signal Virtual_3_Offset_Y, frame RT_SB_INS_Vpt_3_Offset, 9379874 (0x8f2022). Range (world values): -32.768 ... 32.767 [m]"
  app type cif_0x8f2022_Virtual_3_Offset_Z_t:  # The type of CAN input signal Virtual_3_Offset_Z, frame RT_SB_INS_Vpt_3_Offset, 9379874 (0x8f2022). Z offset (+ve downwards) of the virtual point in the vehicle body frame. Implementation type is int16
    category=VALUE
    compu {phys=raw*0.001} "The scaling of CAN input signal Virtual_3_Offset_Z, frame RT_SB_INS_Vpt_3_Offset, 9379874 (0x8f2022). Scaling: WorldValue = 0.001*BinaryValue + 0.0 [m]. Unit: The unit m from the network database is mapped to the AUTOSAR unit NoUnit"
    range phys -32.768..32.767 "The range of CAN input signal Virtual_3_Offset_Z, frame RT_SB_INS_Vpt_3_Offset, 9379874 (0x8f2022). Range (world values): -32.768 ... 32.767 [m]"
  app type cif_0x8f1222_Virtual_2_Vel_NED_D_t:  # The type of CAN input signal Virtual_2_Vel_NED_D, frame RT_SB_INS_Vpt_2_Vel_NED_2, 9376290 (0x8f1222). VELNED D velocity. This is the velocity vector directly downwards towards the Earth centre at the current local Earth surface position. Implementation type is int32
    category=VALUE
    compu {phys=raw*0.0001} "The scaling of CAN input signal Virtual_2_Vel_NED_D, frame RT_SB_INS_Vpt_2_Vel_NED_2, 9376290 (0x8f1222). Scaling: WorldValue = 1.0E-4*BinaryValue + 0.0 [m/s]. Unit: The unit m/s from the network database is mapped to the AUTOSAR unit NoUnit"
    range phys -838..838 "The range of CAN input signal Virtual_2_Vel_NED_D, frame RT_SB_INS_Vpt_2_Vel_NED_2, 9376290 (0x8f1222). Range (world values): -838.0 ... 838.0 [m/s]"
  app type cif_0x8f1222_Virtual_2_Heading_t:  # The type of CAN input signal Virtual_2_Heading, frame RT_SB_INS_Vpt_2_Vel_NED_2, 9376290 (0x8f1222). This is GPS heading, the direction that the vehicle is travelling in the local horizontal plane. Implementation type is int16
    category=VALUE
    compu {phys=raw*0.01} "The scaling of CAN input signal Virtual_2_Heading, frame RT_SB_INS_Vpt_2_Vel_NED_2, 9376290 (0x8f1222). Scaling: WorldValue = 0.01*BinaryValue + 0.0 [degrees]. Unit: The unit degrees from the network database is mapped to the AUTOSAR unit NoUnit"
    range phys -180..180 "The range of CAN input signal Virtual_2_Heading, frame RT_SB_INS_Vpt_2_Vel_NED_2, 9376290 (0x8f1222). Range (world values): -180.0 ... 180.0 [degrees]"
  app type cif_0x8f1222_Virtual_2_Slip_t:  # The type of CAN input signal Virtual_2_Slip, frame RT_SB_INS_Vpt_2_Vel_NED_2, 9376290 (0x8f1222). Slip is defined as the difference between yaw and heading. Implementation type is int16
    category=VALUE
    compu {phys=raw*0.01} "The scaling of CAN input signal Virtual_2_Slip, frame RT_SB_INS_Vpt_2_Vel_NED_2, 9376290 (0x8f1222). Scaling: WorldValue = 0.01*BinaryValue + 0.0 [degrees]. Unit: The unit degrees from the network database is mapped to the AUTOSAR unit NoUnit"
    range phys -180..180 "The range of CAN input signal Virtual_2_Slip, frame RT_SB_INS_Vpt_2_Vel_NED_2, 9376290 (0x8f1222). Range (world values): -180.0 ... 180.0 [degrees]"
  app type cif_0x8f1122_Virtual_2_Vel_NED_N_t:  # The type of CAN input signal Virtual_2_Vel_NED_N, frame RT_SB_INS_Vpt_2_Vel_NED_1, 9376034 (0x8f1122). VELNED N velocity. This is the velocity vector directly North at the current local Earth surface position. Implementation type is int32
    category=VALUE
    compu {phys=raw*0.0001} "The scaling of CAN input signal Virtual_2_Vel_NED_N, frame RT_SB_INS_Vpt_2_Vel_NED_1, 9376034 (0x8f1122). Scaling: WorldValue = 1.0E-4*BinaryValue + 0.0 [m/s]. Unit: The unit m/s from the network database is mapped to the AUTOSAR unit NoUnit"
    range phys -838..838 "The range of CAN input signal Virtual_2_Vel_NED_N, frame RT_SB_INS_Vpt_2_Vel_NED_1, 9376034 (0x8f1122). Range (world values): -838.0 ... 838.0 [m/s]"
  app type cif_0x8f1122_Virtual_2_Vel_NED_E_t:  # The type of CAN input signal Virtual_2_Vel_NED_E, frame RT_SB_INS_Vpt_2_Vel_NED_1, 9376034 (0x8f1122). VELNED E velocity. This is the velocity vector directly East at the current local Earth surface position. Implementation type is int32
    category=VALUE
    compu {phys=raw*0.0001} "The scaling of CAN input signal Virtual_2_Vel_NED_E, frame RT_SB_INS_Vpt_2_Vel_NED_1, 9376034 (0x8f1122). Scaling: WorldValue = 1.0E-4*BinaryValue + 0.0 [m/s]. Unit: The unit m/s from the network database is mapped to the AUTOSAR unit NoUnit"
    range phys -838..838 "The range of CAN input signal Virtual_2_Vel_NED_E, frame RT_SB_INS_Vpt_2_Vel_NED_1, 9376034 (0x8f1122). Range (world values): -838.0 ... 838.0 [m/s]"
  app type cif_0x8f1022_Virtual_2_Offset_X_t:  # The type of CAN input signal Virtual_2_Offset_X, frame RT_SB_INS_Vpt_2_Offset, 9375778 (0x8f1022). X offset of the virtual point in the vehicle body frame. Implementation type is int16
    category=VALUE
    compu {phys=raw*0.001} "The scaling of CAN input signal Virtual_2_Offset_X, frame RT_SB_INS_Vpt_2_Offset, 9375778 (0x8f1022). Scaling: WorldValue = 0.001*BinaryValue + 0.0 [m]. Unit: The unit m from the network database is mapped to the AUTOSAR unit NoUnit"
    range phys -32.768..32.767 "The range of CAN input signal Virtual_2_Offset_X, frame RT_SB_INS_Vpt_2_Offset, 9375778 (0x8f1022). Range (world values): -32.768 ... 32.767 [m]"
  app type cif_0x8f1022_Virtual_2_Offset_Y_t:  # The type of CAN input signal Virtual_2_Offset_Y, frame RT_SB_INS_Vpt_2_Offset, 9375778 (0x8f1022). Y offset of the virtual point in the vehicle body frame. Implementation type is int16
    category=VALUE
    compu {phys=raw*0.001} "The scaling of CAN input signal Virtual_2_Offset_Y, frame RT_SB_INS_Vpt_2_Offset, 9375778 (0x8f1022). Scaling: WorldValue = 0.001*BinaryValue + 0.0 [m]. Unit: The unit m from the network database is mapped to the AUTOSAR unit NoUnit"
    range phys -32.768..32.767 "The range of CAN input signal Virtual_2_Offset_Y, frame RT_SB_INS_Vpt_2_Offset, 9375778 (0x8f1022). Range (world values): -32.768 ... 32.767 [m]"
  app type cif_0x8f1022_Virtual_2_Offset_Z_t:  # The type of CAN input signal Virtual_2_Offset_Z, frame RT_SB_INS_Vpt_2_Offset, 9375778 (0x8f1022). Z offset (+ve downwards) of the virtual point in the vehicle body frame. Implementation type is int16
    category=VALUE
    compu {phys=raw*0.001} "The scaling of CAN input signal Virtual_2_Offset_Z, frame RT_SB_INS_Vpt_2_Offset, 9375778 (0x8f1022). Scaling: WorldValue = 0.001*BinaryValue + 0.0 [m]. Unit: The unit m from the network database is mapped to the AUTOSAR unit NoUnit"
    range phys -32.768..32.767 "The range of CAN input signal Virtual_2_Offset_Z, frame RT_SB_INS_Vpt_2_Offset, 9375778 (0x8f1022). Range (world values): -32.768 ... 32.767 [m]"
  app type cif_0x8f0222_Virtual_1_Vel_NED_D_t:  # The type of CAN input signal Virtual_1_Vel_NED_D, frame RT_SB_INS_Vpt_1_Vel_NED_2, 9372194 (0x8f0222). VELNED D velocity. This is the velocity vector directly downwards towards the Earth centre at the current local Earth surface position. Implementation type is int32
    category=VALUE
    compu {phys=raw*0.0001} "The scaling of CAN input signal Virtual_1_Vel_NED_D, frame RT_SB_INS_Vpt_1_Vel_NED_2, 9372194 (0x8f0222). Scaling: WorldValue = 1.0E-4*BinaryValue + 0.0 [m/s]. Unit: The unit m/s from the network database is mapped to the AUTOSAR unit NoUnit"
    range phys -838..838 "The range of CAN input signal Virtual_1_Vel_NED_D, frame RT_SB_INS_Vpt_1_Vel_NED_2, 9372194 (0x8f0222). Range (world values): -838.0 ... 838.0 [m/s]"
  app type cif_0x8f0222_Virtual_1_Heading_t:  # The type of CAN input signal Virtual_1_Heading, frame RT_SB_INS_Vpt_1_Vel_NED_2, 9372194 (0x8f0222). This is GPS heading, the direction that the vehicle is travelling in the local horizontal plane. Implementation type is int16
    category=VALUE
    compu {phys=raw*0.01} "The scaling of CAN input signal Virtual_1_Heading, frame RT_SB_INS_Vpt_1_Vel_NED_2, 9372194 (0x8f0222). Scaling: WorldValue = 0.01*BinaryValue + 0.0 [degrees]. Unit: The unit degrees from the network database is mapped to the AUTOSAR unit NoUnit"
    range phys -180..180 "The range of CAN input signal Virtual_1_Heading, frame RT_SB_INS_Vpt_1_Vel_NED_2, 9372194 (0x8f0222). Range (world values): -180.0 ... 180.0 [degrees]"
  app type cif_0x8f0222_Virtual_1_Slip_t:  # The type of CAN input signal Virtual_1_Slip, frame RT_SB_INS_Vpt_1_Vel_NED_2, 9372194 (0x8f0222). Slip is defined as the difference between yaw and heading. Implementation type is int16
    category=VALUE
    compu {phys=raw*0.01} "The scaling of CAN input signal Virtual_1_Slip, frame RT_SB_INS_Vpt_1_Vel_NED_2, 9372194 (0x8f0222). Scaling: WorldValue = 0.01*BinaryValue + 0.0 [degrees]. Unit: The unit degrees from the network database is mapped to the AUTOSAR unit NoUnit"
    range phys -180..180 "The range of CAN input signal Virtual_1_Slip, frame RT_SB_INS_Vpt_1_Vel_NED_2, 9372194 (0x8f0222). Range (world values): -180.0 ... 180.0 [degrees]"
  app type cif_0x8f0122_Virtual_1_Vel_NED_N_t:  # The type of CAN input signal Virtual_1_Vel_NED_N, frame RT_SB_INS_Vpt_1_Vel_NED_1, 9371938 (0x8f0122). VELNED N velocity. This is the velocity vector directly North at the current local Earth surface position. Implementation type is int32
    category=VALUE
    compu {phys=raw*0.0001} "The scaling of CAN input signal Virtual_1_Vel_NED_N, frame RT_SB_INS_Vpt_1_Vel_NED_1, 9371938 (0x8f0122). Scaling: WorldValue = 1.0E-4*BinaryValue + 0.0 [m/s]. Unit: The unit m/s from the network database is mapped to the AUTOSAR unit NoUnit"
    range phys -838..838 "The range of CAN input signal Virtual_1_Vel_NED_N, frame RT_SB_INS_Vpt_1_Vel_NED_1, 9371938 (0x8f0122). Range (world values): -838.0 ... 838.0 [m/s]"
  app type cif_0x8f0122_Virtual_1_Vel_NED_E_t:  # The type of CAN input signal Virtual_1_Vel_NED_E, frame RT_SB_INS_Vpt_1_Vel_NED_1, 9371938 (0x8f0122). VELNED E velocity. This is the velocity vector directly East at the current local Earth surface position. Implementation type is int32
    category=VALUE
    compu {phys=raw*0.0001} "The scaling of CAN input signal Virtual_1_Vel_NED_E, frame RT_SB_INS_Vpt_1_Vel_NED_1, 9371938 (0x8f0122). Scaling: WorldValue = 1.0E-4*BinaryValue + 0.0 [m/s]. Unit: The unit m/s from the network database is mapped to the AUTOSAR unit NoUnit"
    range phys -838..838 "The range of CAN input signal Virtual_1_Vel_NED_E, frame RT_SB_INS_Vpt_1_Vel_NED_1, 9371938 (0x8f0122). Range (world values): -838.0 ... 838.0 [m/s]"
  app type cif_0x8f0022_Virtual_1_Offset_X_t:  # The type of CAN input signal Virtual_1_Offset_X, frame RT_SB_INS_Vpt_1_Offset, 9371682 (0x8f0022). X offset of the virtual point in the vehicle body frame. Implementation type is int16
    category=VALUE
    compu {phys=raw*0.001} "The scaling of CAN input signal Virtual_1_Offset_X, frame RT_SB_INS_Vpt_1_Offset, 9371682 (0x8f0022). Scaling: WorldValue = 0.001*BinaryValue + 0.0 [m]. Unit: The unit m from the network database is mapped to the AUTOSAR unit NoUnit"
    range phys -32.768..32.767 "The range of CAN input signal Virtual_1_Offset_X, frame RT_SB_INS_Vpt_1_Offset, 9371682 (0x8f0022). Range (world values): -32.768 ... 32.767 [m]"
  app type cif_0x8f0022_Virtual_1_Offset_Y_t:  # The type of CAN input signal Virtual_1_Offset_Y, frame RT_SB_INS_Vpt_1_Offset, 9371682 (0x8f0022). Y offset of the virtual point in the vehicle body frame. Implementation type is int16
    category=VALUE
    compu {phys=raw*0.001} "The scaling of CAN input signal Virtual_1_Offset_Y, frame RT_SB_INS_Vpt_1_Offset, 9371682 (0x8f0022). Scaling: WorldValue = 0.001*BinaryValue + 0.0 [m]. Unit: The unit m from the network database is mapped to the AUTOSAR unit NoUnit"
    range phys -32.768..32.767 "The range of CAN input signal Virtual_1_Offset_Y, frame RT_SB_INS_Vpt_1_Offset, 9371682 (0x8f0022). Range (world values): -32.768 ... 32.767 [m]"
  app type cif_0x8f0022_Virtual_1_Offset_Z_t:  # The type of CAN input signal Virtual_1_Offset_Z, frame RT_SB_INS_Vpt_1_Offset, 9371682 (0x8f0022). Z offset (+ve downwards) of the virtual point in the vehicle body frame. Implementation type is int16
    category=VALUE
    compu {phys=raw*0.001} "The scaling of CAN input signal Virtual_1_Offset_Z, frame RT_SB_INS_Vpt_1_Offset, 9371682 (0x8f0022). Scaling: WorldValue = 0.001*BinaryValue + 0.0 [m]. Unit: The unit m from the network database is mapped to the AUTOSAR unit NoUnit"
    range phys -32.768..32.767 "The range of CAN input signal Virtual_1_Offset_Z, frame RT_SB_INS_Vpt_1_Offset, 9371682 (0x8f0022). Range (world values): -32.768 ... 32.767 [m]"
  app type cif_0x8e1622_Validity_INS_Slip_t: category=VALUE, compu {phys=raw} "The scaling of CAN input signal Validity_INS_Slip, frame RT_SB_INS_Slip, 9311778 (0x8e1622). Scaling: WorldValue = BinaryValue []. Unit: The unit "" from the network database is mapped to the AUTOSAR unit NoUnit", range phys 0..1 "The range of CAN input signal Validity_INS_Slip, frame RT_SB_INS_Slip, 9311778 (0x8e1622). Range (world values): 0.0 ... 1.0 []"  # The type of CAN input signal Validity_INS_Slip, frame RT_SB_INS_Slip, 9311778 (0x8e1622). Implementation type is boolean
  app type cif_0x8e1622_Validity_INS_Squat_t: category=VALUE, compu {phys=raw} "The scaling of CAN input signal Validity_INS_Squat, frame RT_SB_INS_Slip, 9311778 (0x8e1622). Scaling: WorldValue = BinaryValue []. Unit: The unit "" from the network database is mapped to the AUTOSAR unit NoUnit", range phys 0..1 "The range of CAN input signal Validity_INS_Squat, frame RT_SB_INS_Slip, 9311778 (0x8e1622). Range (world values): 0.0 ... 1.0 []"  # The type of CAN input signal Validity_INS_Squat, frame RT_SB_INS_Slip, 9311778 (0x8e1622). Implementation type is boolean
  app type cif_0x8e1622_Accuracy_INS_Slip_t: category=VALUE, compu {phys=raw} "The scaling of CAN input signal Accuracy_INS_Slip, frame RT_SB_INS_Slip, 9311778 (0x8e1622). Scaling: WorldValue = BinaryValue []. Unit: The unit "" from the network database is mapped to the AUTOSAR unit NoUnit", range phys 0..255 "The range of CAN input signal Accuracy_INS_Slip, frame RT_SB_INS_Slip, 9311778 (0x8e1622). Range (world values): 0.0 ... 255.0 []"  # The type of CAN input signal Accuracy_INS_Slip, frame RT_SB_INS_Slip, 9311778 (0x8e1622). Dimensionless. Lower values imply but do not guarantee better accuracy than higher values. Implementation type is uint8
  app type cif_0x8e1622_INS_Slip_t:  # The type of CAN input signal INS_Slip, frame RT_SB_INS_Slip, 9311778 (0x8e1622). Slip is defined as the difference between yaw and heading Implementation type is int16
    category=VALUE
    compu {phys=raw*0.01} "The scaling of CAN input signal INS_Slip, frame RT_SB_INS_Slip, 9311778 (0x8e1622). Scaling: WorldValue = 0.01*BinaryValue + 0.0 [degrees]. Unit: The unit degrees from the network database is mapped to the AUTOSAR unit NoUnit"
    range phys -360..360 "The range of CAN input signal INS_Slip, frame RT_SB_INS_Slip, 9311778 (0x8e1622). Range (world values): -360.0 ... 360.0 [degrees]"
  app type cif_0x8e1622_Accuracy_INS_Squat_t: category=VALUE, compu {phys=raw} "The scaling of CAN input signal Accuracy_INS_Squat, frame RT_SB_INS_Slip, 9311778 (0x8e1622). Scaling: WorldValue = BinaryValue []. Unit: The unit "" from the network database is mapped to the AUTOSAR unit NoUnit", range phys 0..255 "The range of CAN input signal Accuracy_INS_Squat, frame RT_SB_INS_Slip, 9311778 (0x8e1622). Range (world values): 0.0 ... 255.0 []"  # The type of CAN input signal Accuracy_INS_Squat, frame RT_SB_INS_Slip, 9311778 (0x8e1622). Dimensionless. Lower values imply but do not guarantee better accuracy than higher values. Implementation type is uint8
  app type cif_0x8e1622_INS_Squat_t:  # The type of CAN input signal INS_Squat, frame RT_SB_INS_Slip, 9311778 (0x8e1622). Squat is defined as the difference between pitch and gradient Implementation type is int16
    category=VALUE
    compu {phys=raw*0.01} "The scaling of CAN input signal INS_Squat, frame RT_SB_INS_Slip, 9311778 (0x8e1622). Scaling: WorldValue = 0.01*BinaryValue + 0.0 [degrees]. Unit: The unit degrees from the network database is mapped to the AUTOSAR unit NoUnit"
    range phys -360..360 "The range of CAN input signal INS_Squat, frame RT_SB_INS_Slip, 9311778 (0x8e1622). Range (world values): -360.0 ... 360.0 [degrees]"
  app type cif_0x8e1322_Validity_INS_Vel_ECEF_Y_t:  # The type of CAN input signal Validity_INS_Vel_ECEF_Y, frame RT_SB_INS_Vel_ECEF_2, 9311010 (0x8e1322). Valid when bit is set, invalid when bit is clear. Implementation type is boolean
    category=VALUE
    compu {phys=raw} "The scaling of CAN input signal Validity_INS_Vel_ECEF_Y, frame RT_SB_INS_Vel_ECEF_2, 9311010 (0x8e1322). Scaling: WorldValue = BinaryValue []. Unit: The unit "" from the network database is mapped to the AUTOSAR unit NoUnit"
    range phys 0..1 "The range of CAN input signal Validity_INS_Vel_ECEF_Y, frame RT_SB_INS_Vel_ECEF_2, 9311010 (0x8e1322). Range (world values): 0.0 ... 1.0 []"
  app type cif_0x8e1322_Validity_INS_Vel_ECEF_Z_t:  # The type of CAN input signal Validity_INS_Vel_ECEF_Z, frame RT_SB_INS_Vel_ECEF_2, 9311010 (0x8e1322). Valid when bit is set, invalid when bit is clear. Implementation type is boolean
    category=VALUE
    compu {phys=raw} "The scaling of CAN input signal Validity_INS_Vel_ECEF_Z, frame RT_SB_INS_Vel_ECEF_2, 9311010 (0x8e1322). Scaling: WorldValue = BinaryValue []. Unit: The unit "" from the network database is mapped to the AUTOSAR unit NoUnit"
    range phys 0..1 "The range of CAN input signal Validity_INS_Vel_ECEF_Z, frame RT_SB_INS_Vel_ECEF_2, 9311010 (0x8e1322). Range (world values): 0.0 ... 1.0 []"
  app type cif_0x8e1322_INS_Vel_ECEF_Y_t:  # The type of CAN input signal INS_Vel_ECEF_Y, frame RT_SB_INS_Vel_ECEF_2, 9311010 (0x8e1322). ECEF Y velocity. The ECEF Y axis originates from the Earth centre, and the positive Y axis intersects the Earth surface at zero degrees latittude and 90 degrees longitude. Implementation type is int32
    category=VALUE
    compu {phys=raw*0.0001} "The scaling of CAN input signal INS_Vel_ECEF_Y, frame RT_SB_INS_Vel_ECEF_2, 9311010 (0x8e1322). Scaling: WorldValue = 1.0E-4*BinaryValue + 0.0 [m/s]. Unit: The unit m/s from the network database is mapped to the AUTOSAR unit NoUnit"
    range phys -838..838 "The range of CAN input signal INS_Vel_ECEF_Y, frame RT_SB_INS_Vel_ECEF_2, 9311010 (0x8e1322). Range (world values): -838.0 ... 838.0 [m/s]"
  app type cif_0x8e1322_INS_Vel_ECEF_Z_t:  # The type of CAN input signal INS_Vel_ECEF_Z, frame RT_SB_INS_Vel_ECEF_2, 9311010 (0x8e1322). ECEF Z velocity. The ECEF Z axis originates from the Earth centre, and the positive Z axis intersects the Earth surface at the North Pole. Implementation type is int32
    category=VALUE
    compu {phys=raw*0.0001} "The scaling of CAN input signal INS_Vel_ECEF_Z, frame RT_SB_INS_Vel_ECEF_2, 9311010 (0x8e1322). Scaling: WorldValue = 1.0E-4*BinaryValue + 0.0 [m/s]. Unit: The unit m/s from the network database is mapped to the AUTOSAR unit NoUnit"
    range phys -838..838 "The range of CAN input signal INS_Vel_ECEF_Z, frame RT_SB_INS_Vel_ECEF_2, 9311010 (0x8e1322). Range (world values): -838.0 ... 838.0 [m/s]"
  app type cif_0x8e1222_Validity_INS_Vel_ECEF_X_t:  # The type of CAN input signal Validity_INS_Vel_ECEF_X, frame RT_SB_INS_Vel_ECEF_1, 9310754 (0x8e1222). Valid when bit is set, invalid when bit is clear. Implementation type is boolean
    category=VALUE
    compu {phys=raw} "The scaling of CAN input signal Validity_INS_Vel_ECEF_X, frame RT_SB_INS_Vel_ECEF_1, 9310754 (0x8e1222). Scaling: WorldValue = BinaryValue []. Unit: The unit "" from the network database is mapped to the AUTOSAR unit NoUnit"
    range phys 0..1 "The range of CAN input signal Validity_INS_Vel_ECEF_X, frame RT_SB_INS_Vel_ECEF_1, 9310754 (0x8e1222). Range (world values): 0.0 ... 1.0 []"
  app type cif_0x8e1222_Accuracy_INS_Vel_ECEF_X_t:  # The type of CAN input signal Accuracy_INS_Vel_ECEF_X, frame RT_SB_INS_Vel_ECEF_1, 9310754 (0x8e1222). Implementation type is uint8
    category=VALUE
    compu {phys=raw} "The scaling of CAN input signal Accuracy_INS_Vel_ECEF_X, frame RT_SB_INS_Vel_ECEF_1, 9310754 (0x8e1222). Scaling: WorldValue = BinaryValue []. Unit: The unit "" from the network database is mapped to the AUTOSAR unit NoUnit"
    range phys 0..255 "The range of CAN input signal Accuracy_INS_Vel_ECEF_X, frame RT_SB_INS_Vel_ECEF_1, 9310754 (0x8e1222). Range (world values): 0.0 ... 255.0 []"
  app type cif_0x8e1222_Accuracy_INS_Vel_ECEF_Y_t:  # The type of CAN input signal Accuracy_INS_Vel_ECEF_Y, frame RT_SB_INS_Vel_ECEF_1, 9310754 (0x8e1222). Implementation type is uint8
    category=VALUE
    compu {phys=raw} "The scaling of CAN input signal Accuracy_INS_Vel_ECEF_Y, frame RT_SB_INS_Vel_ECEF_1, 9310754 (0x8e1222). Scaling: WorldValue = BinaryValue []. Unit: The unit "" from the network database is mapped to the AUTOSAR unit NoUnit"
    range phys 0..255 "The range of CAN input signal Accuracy_INS_Vel_ECEF_Y, frame RT_SB_INS_Vel_ECEF_1, 9310754 (0x8e1222). Range (world values): 0.0 ... 255.0 []"
  app type cif_0x8e1222_Accuracy_INS_Vel_ECEF_Z_t:  # The type of CAN input signal Accuracy_INS_Vel_ECEF_Z, frame RT_SB_INS_Vel_ECEF_1, 9310754 (0x8e1222). Implementation type is uint8
    category=VALUE
    compu {phys=raw} "The scaling of CAN input signal Accuracy_INS_Vel_ECEF_Z, frame RT_SB_INS_Vel_ECEF_1, 9310754 (0x8e1222). Scaling: WorldValue = BinaryValue []. Unit: The unit "" from the network database is mapped to the AUTOSAR unit NoUnit"
    range phys 0..255 "The range of CAN input signal Accuracy_INS_Vel_ECEF_Z, frame RT_SB_INS_Vel_ECEF_1, 9310754 (0x8e1222). Range (world values): 0.0 ... 255.0 []"
  app type cif_0x8e1222_INS_Vel_ECEF_X_t:  # The type of CAN input signal INS_Vel_ECEF_X, frame RT_SB_INS_Vel_ECEF_1, 9310754 (0x8e1222). ECEF X velocity. The ECEF X axis originates from the Earth centre, and the positive X axis intersects the Earth surface at zero degrees latittude and zero degrees longitude (the intersection of the equator and the prime meridian). Implementation type is int32
    category=VALUE
    compu {phys=raw*0.0001} "The scaling of CAN input signal INS_Vel_ECEF_X, frame RT_SB_INS_Vel_ECEF_1, 9310754 (0x8e1222). Scaling: WorldValue = 1.0E-4*BinaryValue + 0.0 [m/s]. Unit: The unit m/s from the network database is mapped to the AUTOSAR unit NoUnit"
    range phys -838..838 "The range of CAN input signal INS_Vel_ECEF_X, frame RT_SB_INS_Vel_ECEF_1, 9310754 (0x8e1222). Range (world values): -838.0 ... 838.0 [m/s]"
  app type cif_0x8e1122_Validity_INS_Vel_NED_D_t:  # The type of CAN input signal Validity_INS_Vel_NED_D, frame RT_SB_INS_Vel_NED_2, 9310498 (0x8e1122). Valid when bit is set, invalid when bit is clear. Implementation type is boolean
    category=VALUE
    compu {phys=raw} "The scaling of CAN input signal Validity_INS_Vel_NED_D, frame RT_SB_INS_Vel_NED_2, 9310498 (0x8e1122). Scaling: WorldValue = BinaryValue []. Unit: The unit "" from the network database is mapped to the AUTOSAR unit NoUnit"
    range phys 0..1 "The range of CAN input signal Validity_INS_Vel_NED_D, frame RT_SB_INS_Vel_NED_2, 9310498 (0x8e1122). Range (world values): 0.0 ... 1.0 []"
  app type cif_0x8e1122_Accuracy_INS_Vel_D_t:  # The type of CAN input signal Accuracy_INS_Vel_D, frame RT_SB_INS_Vel_NED_2, 9310498 (0x8e1122). Implementation type is uint8
    category=VALUE
    compu {phys=raw} "The scaling of CAN input signal Accuracy_INS_Vel_D, frame RT_SB_INS_Vel_NED_2, 9310498 (0x8e1122). Scaling: WorldValue = BinaryValue []. Unit: The unit "" from the network database is mapped to the AUTOSAR unit NoUnit"
    range phys 0..255 "The range of CAN input signal Accuracy_INS_Vel_D, frame RT_SB_INS_Vel_NED_2, 9310498 (0x8e1122). Range (world values): 0.0 ... 255.0 []"
  app type cif_0x8e1122_INS_Vel_NED_D_t:  # The type of CAN input signal INS_Vel_NED_D, frame RT_SB_INS_Vel_NED_2, 9310498 (0x8e1122). VELNED D velocity. This is the velocity vector directly downwards towards the Earth centre at the current local Earth surface position. Implementation type is int32
    category=VALUE
    compu {phys=raw*0.0001} "The scaling of CAN input signal INS_Vel_NED_D, frame RT_SB_INS_Vel_NED_2, 9310498 (0x8e1122). Scaling: WorldValue = 1.0E-4*BinaryValue + 0.0 [m/s]. Unit: The unit m/s from the network database is mapped to the AUTOSAR unit NoUnit"
    range phys -838..838 "The range of CAN input signal INS_Vel_NED_D, frame RT_SB_INS_Vel_NED_2, 9310498 (0x8e1122). Range (world values): -838.0 ... 838.0 [m/s]"
  app type cif_0x8e1022_Validity_INS_Vel_NED_N_t:  # The type of CAN input signal Validity_INS_Vel_NED_N, frame RT_SB_INS_Vel_NED_1, 9310242 (0x8e1022). Valid when bit is set, invalid when bit is clear. Implementation type is boolean
    category=VALUE
    compu {phys=raw} "The scaling of CAN input signal Validity_INS_Vel_NED_N, frame RT_SB_INS_Vel_NED_1, 9310242 (0x8e1022). Scaling: WorldValue = BinaryValue []. Unit: The unit "" from the network database is mapped to the AUTOSAR unit NoUnit"
    range phys 0..1 "The range of CAN input signal Validity_INS_Vel_NED_N, frame RT_SB_INS_Vel_NED_1, 9310242 (0x8e1022). Range (world values): 0.0 ... 1.0 []"
  app type cif_0x8e1022_Validity_INS_Vel_NED_E_t:  # The type of CAN input signal Validity_INS_Vel_NED_E, frame RT_SB_INS_Vel_NED_1, 9310242 (0x8e1022). Valid when bit is set, invalid when bit is clear. Implementation type is boolean
    category=VALUE
    compu {phys=raw} "The scaling of CAN input signal Validity_INS_Vel_NED_E, frame RT_SB_INS_Vel_NED_1, 9310242 (0x8e1022). Scaling: WorldValue = BinaryValue []. Unit: The unit "" from the network database is mapped to the AUTOSAR unit NoUnit"
    range phys 0..1 "The range of CAN input signal Validity_INS_Vel_NED_E, frame RT_SB_INS_Vel_NED_1, 9310242 (0x8e1022). Range (world values): 0.0 ... 1.0 []"
