[part 3 of 4: package /cif_swcCanInterface/CANBus_CAN_RT/applicationDataTypes]
AUTOSAR XML (schema 4-1-3)
package /cif_swcCanInterface/CANBus_CAN_RT/applicationDataTypes  (continued)
  app type cif_0x8e1022_Accuracy_INS_Vel_NE_t:  # The type of CAN input signal Accuracy_INS_Vel_NE, frame RT_SB_INS_Vel_NED_1, 9310242 (0x8e1022). Implementation type is uint8
    category=VALUE
    compu {phys=raw} "The scaling of CAN input signal Accuracy_INS_Vel_NE, frame RT_SB_INS_Vel_NED_1, 9310242 (0x8e1022). Scaling: WorldValue = BinaryValue []. Unit: The unit "" from the network database is mapped to the AUTOSAR unit NoUnit"
    range phys 0..255 "The range of CAN input signal Accuracy_INS_Vel_NE, frame RT_SB_INS_Vel_NED_1, 9310242 (0x8e1022). Range (world values): 0.0 ... 255.0 []"
  app type cif_0x8e1022_INS_Vel_NED_N_t:  # The type of CAN input signal INS_Vel_NED_N, frame RT_SB_INS_Vel_NED_1, 9310242 (0x8e1022). VELNED N velocity. This is the velocity vector directly North at the current local Earth surface position. Implementation type is int32
    category=VALUE
    compu {phys=raw*0.0001} "The scaling of CAN input signal INS_Vel_NED_N, frame RT_SB_INS_Vel_NED_1, 9310242 (0x8e1022). Scaling: WorldValue = 1.0E-4*BinaryValue + 0.0 [m/s]. Unit: The unit m/s from the network database is mapped to the AUTOSAR unit NoUnit"
    range phys -838..838 "The range of CAN input signal INS_Vel_NED_N, frame RT_SB_INS_Vel_NED_1, 9310242 (0x8e1022). Range (world values): -838.0 ... 838.0 [m/s]"
  app type cif_0x8e1022_INS_Vel_NED_E_t:  # The type of CAN input signal INS_Vel_NED_E, frame RT_SB_INS_Vel_NED_1, 9310242 (0x8e1022). VELNED E velocity. This is the velocity vector directly East at the current local Earth surface position. Implementation type is int32
    category=VALUE
    compu {phys=raw*0.0001} "The scaling of CAN input signal INS_Vel_NED_E, frame RT_SB_INS_Vel_NED_1, 9310242 (0x8e1022). Scaling: WorldValue = 1.0E-4*BinaryValue + 0.0 [m/s]. Unit: The unit m/s from the network database is mapped to the AUTOSAR unit NoUnit"
    range phys -838..838 "The range of CAN input signal INS_Vel_NED_E, frame RT_SB_INS_Vel_NED_1, 9310242 (0x8e1022). Range (world values): -838.0 ... 838.0 [m/s]"
  app type cif_0x8e0522_INS_Pos_ECEF_Y_t:  # The type of CAN input signal INS_Pos_ECEF_Y, frame RT_SB_INS_Pos_ECEF_2, 9307426 (0x8e0522). ECEF Y position. The ECEF Y axis originates from the Earth centre, and the positive Y axis intersects the Earth surface at zero degrees latittude and 90 degrees longitude. Implementation type is int32
    category=VALUE
    compu {phys=raw*0.01} "The scaling of CAN input signal INS_Pos_ECEF_Y, frame RT_SB_INS_Pos_ECEF_2, 9307426 (0x8e0522). Scaling: WorldValue = 0.01*BinaryValue + 0.0 [m]. Unit: The unit m from the network database is mapped to the AUTOSAR unit NoUnit"
    range phys -10000000..10000000 "The range of CAN input signal INS_Pos_ECEF_Y, frame RT_SB_INS_Pos_ECEF_2, 9307426 (0x8e0522). Range (world values): -1.0E7 ... 1.0E7 [m]"
  app type cif_0x8e0522_INS_Pos_ECEF_Z_t:  # The type of CAN input signal INS_Pos_ECEF_Z, frame RT_SB_INS_Pos_ECEF_2, 9307426 (0x8e0522). ECEF Z position. The ECEF Z axis originates from the Earth centre, and the positive Z axis intersects the Earth surface at the North Pole. Implementation type is int32
    category=VALUE
    compu {phys=raw*0.01} "The scaling of CAN input signal INS_Pos_ECEF_Z, frame RT_SB_INS_Pos_ECEF_2, 9307426 (0x8e0522). Scaling: WorldValue = 0.01*BinaryValue + 0.0 [m]. Unit: The unit m from the network database is mapped to the AUTOSAR unit NoUnit"
    range phys -10000000..10000000 "The range of CAN input signal INS_Pos_ECEF_Z, frame RT_SB_INS_Pos_ECEF_2, 9307426 (0x8e0522). Range (world values): -1.0E7 ... 1.0E7 [m]"
  app type cif_0x8e0422_Validity_INS_Pos_ECEF_X_t:  # The type of CAN input signal Validity_INS_Pos_ECEF_X, frame RT_SB_INS_Pos_ECEF_1, 9307170 (0x8e0422). Valid when bit is set, invalid when bit is clear. Implementation type is boolean
    category=VALUE
    compu {phys=raw} "The scaling of CAN input signal Validity_INS_Pos_ECEF_X, frame RT_SB_INS_Pos_ECEF_1, 9307170 (0x8e0422). Scaling: WorldValue = BinaryValue []. Unit: The unit "" from the network database is mapped to the AUTOSAR unit NoUnit"
    range phys 0..1 "The range of CAN input signal Validity_INS_Pos_ECEF_X, frame RT_SB_INS_Pos_ECEF_1, 9307170 (0x8e0422). Range (world values): 0.0 ... 1.0 []"
  app type cif_0x8e0422_Validity_INS_Pos_ECEF_Y_t:  # The type of CAN input signal Validity_INS_Pos_ECEF_Y, frame RT_SB_INS_Pos_ECEF_1, 9307170 (0x8e0422). Valid when bit is set, invalid when bit is clear. Implementation type is boolean
    category=VALUE
    compu {phys=raw} "The scaling of CAN input signal Validity_INS_Pos_ECEF_Y, frame RT_SB_INS_Pos_ECEF_1, 9307170 (0x8e0422). Scaling: WorldValue = BinaryValue []. Unit: The unit "" from the network database is mapped to the AUTOSAR unit NoUnit"
    range phys 0..1 "The range of CAN input signal Validity_INS_Pos_ECEF_Y, frame RT_SB_INS_Pos_ECEF_1, 9307170 (0x8e0422). Range (world values): 0.0 ... 1.0 []"
  app type cif_0x8e0422_Validity_INS_Pos_ECEF_Z_t:  # The type of CAN input signal Validity_INS_Pos_ECEF_Z, frame RT_SB_INS_Pos_ECEF_1, 9307170 (0x8e0422). Valid when bit is set, invalid when bit is clear. Implementation type is boolean
    category=VALUE
    compu {phys=raw} "The scaling of CAN input signal Validity_INS_Pos_ECEF_Z, frame RT_SB_INS_Pos_ECEF_1, 9307170 (0x8e0422). Scaling: WorldValue = BinaryValue []. Unit: The unit "" from the network database is mapped to the AUTOSAR unit NoUnit"
    range phys 0..1 "The range of CAN input signal Validity_INS_Pos_ECEF_Z, frame RT_SB_INS_Pos_ECEF_1, 9307170 (0x8e0422). Range (world values): 0.0 ... 1.0 []"
  app type cif_0x8e0422_Accuracy_INS_Pos_ECEF_X_t:  # The type of CAN input signal Accuracy_INS_Pos_ECEF_X, frame RT_SB_INS_Pos_ECEF_1, 9307170 (0x8e0422). Dimensionless. Lower values imply but do not guarantee better accuracy than higher values. Implementation type is uint8
    category=VALUE
    compu {phys=raw} "The scaling of CAN input signal Accuracy_INS_Pos_ECEF_X, frame RT_SB_INS_Pos_ECEF_1, 9307170 (0x8e0422). Scaling: WorldValue = BinaryValue []. Unit: The unit "" from the network database is mapped to the AUTOSAR unit NoUnit"
    range phys 0..255 "The range of CAN input signal Accuracy_INS_Pos_ECEF_X, frame RT_SB_INS_Pos_ECEF_1, 9307170 (0x8e0422). Range (world values): 0.0 ... 255.0 []"
  app type cif_0x8e0422_Accuracy_INS_Pos_ECEF_Y_t:  # The type of CAN input signal Accuracy_INS_Pos_ECEF_Y, frame RT_SB_INS_Pos_ECEF_1, 9307170 (0x8e0422). Dimensionless. Lower values imply but do not guarantee better accuracy than higher values. Implementation type is uint8
    category=VALUE
    compu {phys=raw} "The scaling of CAN input signal Accuracy_INS_Pos_ECEF_Y, frame RT_SB_INS_Pos_ECEF_1, 9307170 (0x8e0422). Scaling: WorldValue = BinaryValue []. Unit: The unit "" from the network database is mapped to the AUTOSAR unit NoUnit"
    range phys 0..255 "The range of CAN input signal Accuracy_INS_Pos_ECEF_Y, frame RT_SB_INS_Pos_ECEF_1, 9307170 (0x8e0422). Range (world values): 0.0 ... 255.0 []"
  app type cif_0x8e0422_Accuracy_INS_Pos_ECEF_Z_t:  # The type of CAN input signal Accuracy_INS_Pos_ECEF_Z, frame RT_SB_INS_Pos_ECEF_1, 9307170 (0x8e0422). Dimensionless. Lower values imply but do not guarantee better accuracy than higher values. Implementation type is uint8
    category=VALUE
    compu {phys=raw} "The scaling of CAN input signal Accuracy_INS_Pos_ECEF_Z, frame RT_SB_INS_Pos_ECEF_1, 9307170 (0x8e0422). Scaling: WorldValue = BinaryValue []. Unit: The unit "" from the network database is mapped to the AUTOSAR unit NoUnit"
    range phys 0..255 "The range of CAN input signal Accuracy_INS_Pos_ECEF_Z, frame RT_SB_INS_Pos_ECEF_1, 9307170 (0x8e0422). Range (world values): 0.0 ... 255.0 []"
  app type cif_0x8e0422_INS_Pos_ECEF_X_t:  # The type of CAN input signal INS_Pos_ECEF_X, frame RT_SB_INS_Pos_ECEF_1, 9307170 (0x8e0422). ECEF X position. The ECEF X axis originates from the Earth centre, and the positive X axis intersects the Earth surface at zero degrees latittude and zero degrees longitude (the intersection of the equator and the prime meridian). Implementation type is int32
    category=VALUE
    compu {phys=raw*0.01} "The scaling of CAN input signal INS_Pos_ECEF_X, frame RT_SB_INS_Pos_ECEF_1, 9307170 (0x8e0422). Scaling: WorldValue = 0.01*BinaryValue + 0.0 [m]. Unit: The unit m from the network database is mapped to the AUTOSAR unit NoUnit"
    range phys -10000000..10000000 "The range of CAN input signal INS_Pos_ECEF_X, frame RT_SB_INS_Pos_ECEF_1, 9307170 (0x8e0422). Range (world values): -1.0E7 ... 1.0E7 [m]"
  app type cif_0x8e0322_INS_Pos_LLH_Longitude_t:  # The type of CAN input signal INS_Pos_LLH_Longitude, frame RT_SB_INS_Pos_LLH_2, 9306914 (0x8e0322). Implementation type is int32
    category=VALUE
    compu {phys=raw*1e-07} "The scaling of CAN input signal INS_Pos_LLH_Longitude, frame RT_SB_INS_Pos_LLH_2, 9306914 (0x8e0322). Scaling: WorldValue = 1.0E-7*BinaryValue + 0.0 [degrees]. Unit: The unit degrees from the network database is mapped to the AUTOSAR unit NoUnit"
    range phys -180..180 "The range of CAN input signal INS_Pos_LLH_Longitude, frame RT_SB_INS_Pos_LLH_2, 9306914 (0x8e0322). Range (world values): -180.0 ... 180.0 [degrees]"
  app type cif_0x8e0322_INS_Pos_LLH_Altitude_t:  # The type of CAN input signal INS_Pos_LLH_Altitude, frame RT_SB_INS_Pos_LLH_2, 9306914 (0x8e0322). Implementation type is int32
    category=VALUE
    compu {phys=raw*0.001} "The scaling of CAN input signal INS_Pos_LLH_Altitude, frame RT_SB_INS_Pos_LLH_2, 9306914 (0x8e0322). Scaling: WorldValue = 0.001*BinaryValue + 0.0 [m]. Unit: The unit m from the network database is mapped to the AUTOSAR unit NoUnit"
    range phys -1000..100000 "The range of CAN input signal INS_Pos_LLH_Altitude, frame RT_SB_INS_Pos_LLH_2, 9306914 (0x8e0322). Range (world values): -1000.0 ... 100000.0 [m]"
  app type cif_0x8e0222_Validity_INS_Pos_LLH_Latitude_t:  # The type of CAN input signal Validity_INS_Pos_LLH_Latitude, frame RT_SB_INS_Pos_LLH_1, 9306658 (0x8e0222). Valid when bit is set, invalid when bit is clear. Implementation type is boolean
    category=VALUE
    compu {phys=raw} "The scaling of CAN input signal Validity_INS_Pos_LLH_Latitude, frame RT_SB_INS_Pos_LLH_1, 9306658 (0x8e0222). Scaling: WorldValue = BinaryValue []. Unit: The unit "" from the network database is mapped to the AUTOSAR unit NoUnit"
    range phys 0..1 "The range of CAN input signal Validity_INS_Pos_LLH_Latitude, frame RT_SB_INS_Pos_LLH_1, 9306658 (0x8e0222). Range (world values): 0.0 ... 1.0 []"
  app type cif_0x8e0222_Validity_INS_Pos_LLH_Longitude_t:  # The type of CAN input signal Validity_INS_Pos_LLH_Longitude, frame RT_SB_INS_Pos_LLH_1, 9306658 (0x8e0222). Valid when bit is set, invalid when bit is clear. Implementation type is boolean
    category=VALUE
    compu {phys=raw} "The scaling of CAN input signal Validity_INS_Pos_LLH_Longitude, frame RT_SB_INS_Pos_LLH_1, 9306658 (0x8e0222). Scaling: WorldValue = BinaryValue []. Unit: The unit "" from the network database is mapped to the AUTOSAR unit NoUnit"
    range phys 0..1 "The range of CAN input signal Validity_INS_Pos_LLH_Longitude, frame RT_SB_INS_Pos_LLH_1, 9306658 (0x8e0222). Range (world values): 0.0 ... 1.0 []"
  app type cif_0x8e0222_Validity_INS_Pos_LLH_Altitude_t:  # The type of CAN input signal Validity_INS_Pos_LLH_Altitude, frame RT_SB_INS_Pos_LLH_1, 9306658 (0x8e0222). Valid when bit is set, invalid when bit is clear. Implementation type is boolean
    category=VALUE
    compu {phys=raw} "The scaling of CAN input signal Validity_INS_Pos_LLH_Altitude, frame RT_SB_INS_Pos_LLH_1, 9306658 (0x8e0222). Scaling: WorldValue = BinaryValue []. Unit: The unit "" from the network database is mapped to the AUTOSAR unit NoUnit"
    range phys 0..1 "The range of CAN input signal Validity_INS_Pos_LLH_Altitude, frame RT_SB_INS_Pos_LLH_1, 9306658 (0x8e0222). Range (world values): 0.0 ... 1.0 []"
  app type cif_0x8e0222_Accuracy_INS_Pos_LLH_Latitude_t:  # The type of CAN input signal Accuracy_INS_Pos_LLH_Latitude, frame RT_SB_INS_Pos_LLH_1, 9306658 (0x8e0222). This accuracy value applies to both 2D and 3D GPS speed. Implementation type is uint8
    category=VALUE
    compu {phys=raw} "The scaling of CAN input signal Accuracy_INS_Pos_LLH_Latitude, frame RT_SB_INS_Pos_LLH_1, 9306658 (0x8e0222). Scaling: WorldValue = BinaryValue []. Unit: The unit "" from the network database is mapped to the AUTOSAR unit NoUnit"
    range phys 0..255 "The range of CAN input signal Accuracy_INS_Pos_LLH_Latitude, frame RT_SB_INS_Pos_LLH_1, 9306658 (0x8e0222). Range (world values): 0.0 ... 255.0 []"
  app type cif_0x8e0222_Accuracy_INS_Pos_LLH_Longitude_t:  # The type of CAN input signal Accuracy_INS_Pos_LLH_Longitude, frame RT_SB_INS_Pos_LLH_1, 9306658 (0x8e0222). This accuracy value applies to both 2D and 3D GPS speed. Implementation type is uint8
    category=VALUE
    compu {phys=raw} "The scaling of CAN input signal Accuracy_INS_Pos_LLH_Longitude, frame RT_SB_INS_Pos_LLH_1, 9306658 (0x8e0222). Scaling: WorldValue = BinaryValue []. Unit: The unit "" from the network database is mapped to the AUTOSAR unit NoUnit"
    range phys 0..255 "The range of CAN input signal Accuracy_INS_Pos_LLH_Longitude, frame RT_SB_INS_Pos_LLH_1, 9306658 (0x8e0222). Range (world values): 0.0 ... 255.0 []"
  app type cif_0x8e0222_Accuracy_INS_Pos_LLH_Altitude_t:  # The type of CAN input signal Accuracy_INS_Pos_LLH_Altitude, frame RT_SB_INS_Pos_LLH_1, 9306658 (0x8e0222). This accuracy value applies to both 2D and 3D GPS speed. Implementation type is uint8
    category=VALUE
    compu {phys=raw} "The scaling of CAN input signal Accuracy_INS_Pos_LLH_Altitude, frame RT_SB_INS_Pos_LLH_1, 9306658 (0x8e0222). Scaling: WorldValue = BinaryValue []. Unit: The unit "" from the network database is mapped to the AUTOSAR unit NoUnit"
    range phys 0..255 "The range of CAN input signal Accuracy_INS_Pos_LLH_Altitude, frame RT_SB_INS_Pos_LLH_1, 9306658 (0x8e0222). Range (world values): 0.0 ... 255.0 []"
  app type cif_0x8e0222_INS_Pos_LLH_Latitude_t:  # The type of CAN input signal INS_Pos_LLH_Latitude, frame RT_SB_INS_Pos_LLH_1, 9306658 (0x8e0222). Implementation type is int32
    category=VALUE
    compu {phys=raw*1e-07} "The scaling of CAN input signal INS_Pos_LLH_Latitude, frame RT_SB_INS_Pos_LLH_1, 9306658 (0x8e0222). Scaling: WorldValue = 1.0E-7*BinaryValue + 0.0 [degrees]. Unit: The unit degrees from the network database is mapped to the AUTOSAR unit NoUnit"
    range phys -90..90 "The range of CAN input signal INS_Pos_LLH_Latitude, frame RT_SB_INS_Pos_LLH_1, 9306658 (0x8e0222). Range (world values): -90.0 ... 90.0 [degrees]"
  app type cif_0x8e1522_Validity_INS_Heading_t:  # The type of CAN input signal Validity_INS_Heading, frame RT_SB_INS_Heading_Gradient_2, 9311522 (0x8e1522). Valid when bit is set, invalid when bit is clear. Implementation type is boolean
    category=VALUE
    compu {phys=raw} "The scaling of CAN input signal Validity_INS_Heading, frame RT_SB_INS_Heading_Gradient_2, 9311522 (0x8e1522). Scaling: WorldValue = BinaryValue []. Unit: The unit "" from the network database is mapped to the AUTOSAR unit NoUnit"
    range phys 0..1 "The range of CAN input signal Validity_INS_Heading, frame RT_SB_INS_Heading_Gradient_2, 9311522 (0x8e1522). Range (world values): 0.0 ... 1.0 []"
  app type cif_0x8e1522_Validity_INS_Gradient_t:  # The type of CAN input signal Validity_INS_Gradient, frame RT_SB_INS_Heading_Gradient_2, 9311522 (0x8e1522). Valid when bit is set, invalid when bit is clear. Implementation type is boolean
    category=VALUE
    compu {phys=raw} "The scaling of CAN input signal Validity_INS_Gradient, frame RT_SB_INS_Heading_Gradient_2, 9311522 (0x8e1522). Scaling: WorldValue = BinaryValue []. Unit: The unit "" from the network database is mapped to the AUTOSAR unit NoUnit"
    range phys 0..1 "The range of CAN input signal Validity_INS_Gradient, frame RT_SB_INS_Heading_Gradient_2, 9311522 (0x8e1522). Range (world values): 0.0 ... 1.0 []"
  app type cif_0x8e1522_Accuracy_INS_Heading_t:  # The type of CAN input signal Accuracy_INS_Heading, frame RT_SB_INS_Heading_Gradient_2, 9311522 (0x8e1522). Dimensionless. Lower values imply but do not guarantee better accuracy than higher values. Implementation type is uint8
    category=VALUE
    compu {phys=raw} "The scaling of CAN input signal Accuracy_INS_Heading, frame RT_SB_INS_Heading_Gradient_2, 9311522 (0x8e1522). Scaling: WorldValue = BinaryValue []. Unit: The unit "" from the network database is mapped to the AUTOSAR unit NoUnit"
    range phys 0..255 "The range of CAN input signal Accuracy_INS_Heading, frame RT_SB_INS_Heading_Gradient_2, 9311522 (0x8e1522). Range (world values): 0.0 ... 255.0 []"
  app type cif_0x8e1522_INS_Heading_2_t:  # The type of CAN input signal INS_Heading_2, frame RT_SB_INS_Heading_Gradient_2, 9311522 (0x8e1522). This is GPS heading in the range 0 - 360., the direction that the vehicle is travelling in the local horizontal plane. Implementation type is uint16
    category=VALUE
    compu {phys=raw*0.01} "The scaling of CAN input signal INS_Heading_2, frame RT_SB_INS_Heading_Gradient_2, 9311522 (0x8e1522). Scaling: WorldValue = 0.01*BinaryValue + 0.0 [degrees]. Unit: The unit degrees from the network database is mapped to the AUTOSAR unit NoUnit"
    range phys 0..360 "The range of CAN input signal INS_Heading_2, frame RT_SB_INS_Heading_Gradient_2, 9311522 (0x8e1522). Range (world values): 0.0 ... 360.0 [degrees]"
  app type cif_0x8e1522_Accuracy_INS_Gradient_t:  # The type of CAN input signal Accuracy_INS_Gradient, frame RT_SB_INS_Heading_Gradient_2, 9311522 (0x8e1522). Dimensionless. Lower values imply but do not guarantee better accuracy than higher values. Implementation type is uint8
    category=VALUE
    compu {phys=raw} "The scaling of CAN input signal Accuracy_INS_Gradient, frame RT_SB_INS_Heading_Gradient_2, 9311522 (0x8e1522). Scaling: WorldValue = BinaryValue []. Unit: The unit "" from the network database is mapped to the AUTOSAR unit NoUnit"
    range phys 0..255 "The range of CAN input signal Accuracy_INS_Gradient, frame RT_SB_INS_Heading_Gradient_2, 9311522 (0x8e1522). Range (world values): 0.0 ... 255.0 []"
  app type cif_0x8e1522_INS_Gradient_t:  # The type of CAN input signal INS_Gradient, frame RT_SB_INS_Heading_Gradient_2, 9311522 (0x8e1522). This is GPS gradient, i.e. the vertical direction that the vehicle is travelling, NOT pointing (pitch). Implementation type is int16
    category=VALUE
    compu {phys=raw*0.01} "The scaling of CAN input signal INS_Gradient, frame RT_SB_INS_Heading_Gradient_2, 9311522 (0x8e1522). Scaling: WorldValue = 0.01*BinaryValue + 0.0 [degrees]. Unit: The unit degrees from the network database is mapped to the AUTOSAR unit NoUnit"
    range phys -90..90 "The range of CAN input signal INS_Gradient, frame RT_SB_INS_Heading_Gradient_2, 9311522 (0x8e1522). Range (world values): -90.0 ... 90.0 [degrees]"
  app type cif_0x8e1422_Validity_INS_Heading_t:  # The type of CAN input signal Validity_INS_Heading, frame RT_SB_INS_Heading_Gradient, 9311266 (0x8e1422). Valid when bit is set, invalid when bit is clear. Implementation type is boolean
    category=VALUE
    compu {phys=raw} "The scaling of CAN input signal Validity_INS_Heading, frame RT_SB_INS_Heading_Gradient, 9311266 (0x8e1422). Scaling: WorldValue = BinaryValue []. Unit: The unit "" from the network database is mapped to the AUTOSAR unit NoUnit"
    range phys 0..1 "The range of CAN input signal Validity_INS_Heading, frame RT_SB_INS_Heading_Gradient, 9311266 (0x8e1422). Range (world values): 0.0 ... 1.0 []"
  app type cif_0x8e1422_Validity_INS_Gradient_t:  # The type of CAN input signal Validity_INS_Gradient, frame RT_SB_INS_Heading_Gradient, 9311266 (0x8e1422). Valid when bit is set, invalid when bit is clear. Implementation type is boolean
    category=VALUE
    compu {phys=raw} "The scaling of CAN input signal Validity_INS_Gradient, frame RT_SB_INS_Heading_Gradient, 9311266 (0x8e1422). Scaling: WorldValue = BinaryValue []. Unit: The unit "" from the network database is mapped to the AUTOSAR unit NoUnit"
    range phys 0..1 "The range of CAN input signal Validity_INS_Gradient, frame RT_SB_INS_Heading_Gradient, 9311266 (0x8e1422). Range (world values): 0.0 ... 1.0 []"
  app type cif_0x8e1422_Accuracy_INS_Heading_t:  # The type of CAN input signal Accuracy_INS_Heading, frame RT_SB_INS_Heading_Gradient, 9311266 (0x8e1422). Dimensionless. Lower values imply but do not guarantee better accuracy than higher values. Implementation type is uint8
    category=VALUE
    compu {phys=raw} "The scaling of CAN input signal Accuracy_INS_Heading, frame RT_SB_INS_Heading_Gradient, 9311266 (0x8e1422). Scaling: WorldValue = BinaryValue []. Unit: The unit "" from the network database is mapped to the AUTOSAR unit NoUnit"
    range phys 0..255 "The range of CAN input signal Accuracy_INS_Heading, frame RT_SB_INS_Heading_Gradient, 9311266 (0x8e1422). Range (world values): 0.0 ... 255.0 []"
  app type cif_0x8e1422_INS_Heading_t:  # The type of CAN input signal INS_Heading, frame RT_SB_INS_Heading_Gradient, 9311266 (0x8e1422). This is GPS heading, the direction that the vehicle is travelling in the local horizontal plane. Implementation type is int16
    category=VALUE
    compu {phys=raw*0.01} "The scaling of CAN input signal INS_Heading, frame RT_SB_INS_Heading_Gradient, 9311266 (0x8e1422). Scaling: WorldValue = 0.01*BinaryValue + 0.0 [degrees]. Unit: The unit degrees from the network database is mapped to the AUTOSAR unit NoUnit"
    range phys -180..180 "The range of CAN input signal INS_Heading, frame RT_SB_INS_Heading_Gradient, 9311266 (0x8e1422). Range (world values): -180.0 ... 180.0 [degrees]"
  app type cif_0x8e1422_Accuracy_INS_Gradient_t:  # The type of CAN input signal Accuracy_INS_Gradient, frame RT_SB_INS_Heading_Gradient, 9311266 (0x8e1422). Dimensionless. Lower values imply but do not guarantee better accuracy than higher values. Implementation type is uint8
    category=VALUE
    compu {phys=raw} "The scaling of CAN input signal Accuracy_INS_Gradient, frame RT_SB_INS_Heading_Gradient, 9311266 (0x8e1422). Scaling: WorldValue = BinaryValue []. Unit: The unit "" from the network database is mapped to the AUTOSAR unit NoUnit"
    range phys 0..255 "The range of CAN input signal Accuracy_INS_Gradient, frame RT_SB_INS_Heading_Gradient, 9311266 (0x8e1422). Range (world values): 0.0 ... 255.0 []"
  app type cif_0x8e1422_INS_Gradient_t:  # The type of CAN input signal INS_Gradient, frame RT_SB_INS_Heading_Gradient, 9311266 (0x8e1422). This is GPS gradient, i.e. the vertical direction that the vehicle is travelling, NOT pointing (pitch). Implementation type is int16
    category=VALUE
    compu {phys=raw*0.01} "The scaling of CAN input signal INS_Gradient, frame RT_SB_INS_Heading_Gradient, 9311266 (0x8e1422). Scaling: WorldValue = 0.01*BinaryValue + 0.0 [degrees]. Unit: The unit degrees from the network database is mapped to the AUTOSAR unit NoUnit"
    range phys -90..90 "The range of CAN input signal INS_Gradient, frame RT_SB_INS_Heading_Gradient, 9311266 (0x8e1422). Range (world values): -90.0 ... 90.0 [degrees]"
  app type cif_0x8e0022_INS_Status_t: category=VALUE, compu {phys=raw} "The scaling of CAN input signal INS_Status, frame RT_SB_INS_Status, 9306146 (0x8e0022). Scaling: WorldValue = BinaryValue []. Unit: The unit "" from the network database is mapped to the AUTOSAR unit NoUnit", range phys 0..255 "The range of CAN input signal INS_Status, frame RT_SB_INS_Status, 9306146 (0x8e0022). Range (world values): 0.0 ... 255.0 []"  # The type of CAN input signal INS_Status, frame RT_SB_INS_Status, 9306146 (0x8e0022). Implementation type is uint8
  app type cif_0x8e0122_Validity_Yaw_t: category=VALUE, compu {phys=raw} "The scaling of CAN input signal Validity_Yaw, frame RT_SB_INS_Attitude, 9306402 (0x8e0122). Scaling: WorldValue = BinaryValue []. Unit: The unit "" from the network database is mapped to the AUTOSAR unit NoUnit", range phys 0..1 "The range of CAN input signal Validity_Yaw, frame RT_SB_INS_Attitude, 9306402 (0x8e0122). Range (world values): 0.0 ... 1.0 []"  # The type of CAN input signal Validity_Yaw, frame RT_SB_INS_Attitude, 9306402 (0x8e0122). Implementation type is boolean
  app type cif_0x8e0122_Validity_Pitch_t: category=VALUE, compu {phys=raw} "The scaling of CAN input signal Validity_Pitch, frame RT_SB_INS_Attitude, 9306402 (0x8e0122). Scaling: WorldValue = BinaryValue []. Unit: The unit "" from the network database is mapped to the AUTOSAR unit NoUnit", range phys 0..1 "The range of CAN input signal Validity_Pitch, frame RT_SB_INS_Attitude, 9306402 (0x8e0122). Range (world values): 0.0 ... 1.0 []"  # The type of CAN input signal Validity_Pitch, frame RT_SB_INS_Attitude, 9306402 (0x8e0122). Implementation type is boolean
  app type cif_0x8e0122_Validity_Roll_t: category=VALUE, compu {phys=raw} "The scaling of CAN input signal Validity_Roll, frame RT_SB_INS_Attitude, 9306402 (0x8e0122). Scaling: WorldValue = BinaryValue []. Unit: The unit "" from the network database is mapped to the AUTOSAR unit NoUnit", range phys 0..1 "The range of CAN input signal Validity_Roll, frame RT_SB_INS_Attitude, 9306402 (0x8e0122). Range (world values): 0.0 ... 1.0 []"  # The type of CAN input signal Validity_Roll, frame RT_SB_INS_Attitude, 9306402 (0x8e0122). Implementation type is boolean
  app type cif_0x8e0122_Accuracy_Attitude_t:  # The type of CAN input signal Accuracy_Attitude, frame RT_SB_INS_Attitude, 9306402 (0x8e0122). Implementation type is uint8
    category=VALUE
    compu {phys=raw} "The scaling of CAN input signal Accuracy_Attitude, frame RT_SB_INS_Attitude, 9306402 (0x8e0122). Scaling: WorldValue = BinaryValue []. Unit: The unit "" from the network database is mapped to the AUTOSAR unit NoUnit"
    range phys 0..255 "The range of CAN input signal Accuracy_Attitude, frame RT_SB_INS_Attitude, 9306402 (0x8e0122). Range (world values): 0.0 ... 255.0 []"
  app type cif_0x8e0122_Attitude_Yaw_t:  # The type of CAN input signal Attitude_Yaw, frame RT_SB_INS_Attitude, 9306402 (0x8e0122). Implementation type is int16
    category=VALUE
    compu {phys=raw*0.01} "The scaling of CAN input signal Attitude_Yaw, frame RT_SB_INS_Attitude, 9306402 (0x8e0122). Scaling: WorldValue = 0.01*BinaryValue + 0.0 [degrees]. Unit: The unit degrees from the network database is mapped to the AUTOSAR unit NoUnit"
    range phys -360..360 "The range of CAN input signal Attitude_Yaw, frame RT_SB_INS_Attitude, 9306402 (0x8e0122). Range (world values): -360.0 ... 360.0 [degrees]"
  app type cif_0x8e0122_Attitude_Pitch_t:  # The type of CAN input signal Attitude_Pitch, frame RT_SB_INS_Attitude, 9306402 (0x8e0122). Implementation type is int16
    category=VALUE
    compu {phys=raw*0.01} "The scaling of CAN input signal Attitude_Pitch, frame RT_SB_INS_Attitude, 9306402 (0x8e0122). Scaling: WorldValue = 0.01*BinaryValue + 0.0 [degrees]. Unit: The unit degrees from the network database is mapped to the AUTOSAR unit NoUnit"
    range phys -360..360 "The range of CAN input signal Attitude_Pitch, frame RT_SB_INS_Attitude, 9306402 (0x8e0122). Range (world values): -360.0 ... 360.0 [degrees]"
  app type cif_0x8e0122_Attitude_Roll_t:  # The type of CAN input signal Attitude_Roll, frame RT_SB_INS_Attitude, 9306402 (0x8e0122). Implementation type is int16
    category=VALUE
    compu {phys=raw*0.01} "The scaling of CAN input signal Attitude_Roll, frame RT_SB_INS_Attitude, 9306402 (0x8e0122). Scaling: WorldValue = 0.01*BinaryValue + 0.0 [degrees]. Unit: The unit degrees from the network database is mapped to the AUTOSAR unit NoUnit"
    range phys -360..360 "The range of CAN input signal Attitude_Roll, frame RT_SB_INS_Attitude, 9306402 (0x8e0122). Range (world values): -360.0 ... 360.0 [degrees]"
  app type cif_0x8d0122_Validity_Status_Timestamp_t:  # The type of CAN input signal Validity_Status_Timestamp, frame RT_SB_Output_Status, 9240866 (0x8d0122). Valid when bit is set, invalid when bit is clear. Implementation type is boolean
    category=VALUE
    compu {phys=raw} "The scaling of CAN input signal Validity_Status_Timestamp, frame RT_SB_Output_Status, 9240866 (0x8d0122). Scaling: WorldValue = BinaryValue []. Unit: The unit "" from the network database is mapped to the AUTOSAR unit NoUnit"
    range phys 0..1 "The range of CAN input signal Validity_Status_Timestamp, frame RT_SB_Output_Status, 9240866 (0x8d0122). Range (world values): 0.0 ... 1.0 []"
  app type cif_0x8d0122_Status_Analogue_1_t: category=VALUE, compu {phys=raw} "The scaling of CAN input signal Status_Analogue_1, frame RT_SB_Output_Status, 9240866 (0x8d0122). Scaling: WorldValue = BinaryValue []. Unit: The unit "" from the network database is mapped to the AUTOSAR unit NoUnit", range phys 0..1 "The range of CAN input signal Status_Analogue_1, frame RT_SB_Output_Status, 9240866 (0x8d0122). Range (world values): 0.0 ... 1.0 []"  # The type of CAN input signal Status_Analogue_1, frame RT_SB_Output_Status, 9240866 (0x8d0122). Analogue output status for channel 1. Implementation type is boolean
  app type cif_0x8d0122_Status_Analogue_2_t: category=VALUE, compu {phys=raw} "The scaling of CAN input signal Status_Analogue_2, frame RT_SB_Output_Status, 9240866 (0x8d0122). Scaling: WorldValue = BinaryValue []. Unit: The unit "" from the network database is mapped to the AUTOSAR unit NoUnit", range phys 0..1 "The range of CAN input signal Status_Analogue_2, frame RT_SB_Output_Status, 9240866 (0x8d0122). Range (world values): 0.0 ... 1.0 []"  # The type of CAN input signal Status_Analogue_2, frame RT_SB_Output_Status, 9240866 (0x8d0122). Analogue output status for channel 1. Implementation type is boolean
  app type cif_0x8d0122_Status_Analogue_3_t: category=VALUE, compu {phys=raw} "The scaling of CAN input signal Status_Analogue_3, frame RT_SB_Output_Status, 9240866 (0x8d0122). Scaling: WorldValue = BinaryValue []. Unit: The unit "" from the network database is mapped to the AUTOSAR unit NoUnit", range phys 0..1 "The range of CAN input signal Status_Analogue_3, frame RT_SB_Output_Status, 9240866 (0x8d0122). Range (world values): 0.0 ... 1.0 []"  # The type of CAN input signal Status_Analogue_3, frame RT_SB_Output_Status, 9240866 (0x8d0122). Analogue output status for channel 3. Implementation type is boolean
  app type cif_0x8d0122_Status_Analogue_4_t: category=VALUE, compu {phys=raw} "The scaling of CAN input signal Status_Analogue_4, frame RT_SB_Output_Status, 9240866 (0x8d0122). Scaling: WorldValue = BinaryValue []. Unit: The unit "" from the network database is mapped to the AUTOSAR unit NoUnit", range phys 0..1 "The range of CAN input signal Status_Analogue_4, frame RT_SB_Output_Status, 9240866 (0x8d0122). Range (world values): 0.0 ... 1.0 []"  # The type of CAN input signal Status_Analogue_4, frame RT_SB_Output_Status, 9240866 (0x8d0122). Analogue output status for channel 4. Implementation type is boolean
  app type cif_0x8d0122_Status_Pulse_Output_t:  # The type of CAN input signal Status_Pulse_Output, frame RT_SB_Output_Status, 9240866 (0x8d0122). Pulse output activity status Implementation type is boolean
    category=VALUE
    compu {phys=raw} "The scaling of CAN input signal Status_Pulse_Output, frame RT_SB_Output_Status, 9240866 (0x8d0122). Scaling: WorldValue = BinaryValue []. Unit: The unit "" from the network database is mapped to the AUTOSAR unit NoUnit"
    range phys 0..1 "The range of CAN input signal Status_Pulse_Output, frame RT_SB_Output_Status, 9240866 (0x8d0122). Range (world values): 0.0 ... 1.0 []"
  app type cif_0x8d0122_Status_Serial_Output_1_t:  # The type of CAN input signal Status_Serial_Output_1, frame RT_SB_Output_Status, 9240866 (0x8d0122). Status output of serial port 1 Implementation type is boolean
    category=VALUE
    compu {phys=raw} "The scaling of CAN input signal Status_Serial_Output_1, frame RT_SB_Output_Status, 9240866 (0x8d0122). Scaling: WorldValue = BinaryValue []. Unit: The unit "" from the network database is mapped to the AUTOSAR unit NoUnit"
    range phys 0..1 "The range of CAN input signal Status_Serial_Output_1, frame RT_SB_Output_Status, 9240866 (0x8d0122). Range (world values): 0.0 ... 1.0 []"
  app type cif_0x8d0122_Status_Serial_Output_2_t:  # The type of CAN input signal Status_Serial_Output_2, frame RT_SB_Output_Status, 9240866 (0x8d0122). Status output of serial port 1 Implementation type is boolean
    category=VALUE
    compu {phys=raw} "The scaling of CAN input signal Status_Serial_Output_2, frame RT_SB_Output_Status, 9240866 (0x8d0122). Scaling: WorldValue = BinaryValue []. Unit: The unit "" from the network database is mapped to the AUTOSAR unit NoUnit"
    range phys 0..1 "The range of CAN input signal Status_Serial_Output_2, frame RT_SB_Output_Status, 9240866 (0x8d0122). Range (world values): 0.0 ... 1.0 []"
  app type cif_0x8d0122_Status_Trigger_t: category=VALUE, compu {phys=raw} "The scaling of CAN input signal Status_Trigger, frame RT_SB_Output_Status, 9240866 (0x8d0122). Scaling: WorldValue = BinaryValue []. Unit: The unit "" from the network database is mapped to the AUTOSAR unit NoUnit", range phys 0..1 "The range of CAN input signal Status_Trigger, frame RT_SB_Output_Status, 9240866 (0x8d0122). Range (world values): 0.0 ... 1.0 []"  # The type of CAN input signal Status_Trigger, frame RT_SB_Output_Status, 9240866 (0x8d0122). Status of the trigger input Implementation type is boolean
  app type cif_0x8d0122_GPS_Time_t:  # The type of CAN input signal GPS_Time, frame RT_SB_Output_Status, 9240866 (0x8d0122). GPS time is the time in seconds since midnight GMT on Saturday night. Implementation type is uint32
    category=VALUE
    compu {phys=raw*0.001; unit s} "The scaling of CAN input signal GPS_Time, frame RT_SB_Output_Status, 9240866 (0x8d0122). Scaling: WorldValue = 0.001*BinaryValue + 0.0 [s]. Unit: The unit s from the network database is mapped to the AUTOSAR unit Sec"
    range phys 0..604800 "The range of CAN input signal GPS_Time, frame RT_SB_Output_Status, 9240866 (0x8d0122). Range (world values): 0.0 ... 604800.0 [s]"
  app type cif_0x8c1622_Validity_GPS_Heading_t:  # The type of CAN input signal Validity_GPS_Heading, frame RT_SB_GPS_Heading_Gradient_2, 9180706 (0x8c1622). Valid when bit is set, invalid when bit is clear. Implementation type is boolean
    category=VALUE
    compu {phys=raw} "The scaling of CAN input signal Validity_GPS_Heading, frame RT_SB_GPS_Heading_Gradient_2, 9180706 (0x8c1622). Scaling: WorldValue = BinaryValue []. Unit: The unit "" from the network database is mapped to the AUTOSAR unit NoUnit"
    range phys 0..1 "The range of CAN input signal Validity_GPS_Heading, frame RT_SB_GPS_Heading_Gradient_2, 9180706 (0x8c1622). Range (world values): 0.0 ... 1.0 []"
  app type cif_0x8c1622_Validity_GPS_Gradient_t:  # The type of CAN input signal Validity_GPS_Gradient, frame RT_SB_GPS_Heading_Gradient_2, 9180706 (0x8c1622). Valid when bit is set, invalid when bit is clear. Implementation type is boolean
    category=VALUE
    compu {phys=raw} "The scaling of CAN input signal Validity_GPS_Gradient, frame RT_SB_GPS_Heading_Gradient_2, 9180706 (0x8c1622). Scaling: WorldValue = BinaryValue []. Unit: The unit "" from the network database is mapped to the AUTOSAR unit NoUnit"
    range phys 0..1 "The range of CAN input signal Validity_GPS_Gradient, frame RT_SB_GPS_Heading_Gradient_2, 9180706 (0x8c1622). Range (world values): 0.0 ... 1.0 []"
  app type cif_0x8c1622_Accuracy_GPS_Heading_t:  # The type of CAN input signal Accuracy_GPS_Heading, frame RT_SB_GPS_Heading_Gradient_2, 9180706 (0x8c1622). Dimensionless. Lower values imply but do not guarantee better accuracy than higher values. Implementation type is uint8
    category=VALUE
    compu {phys=raw} "The scaling of CAN input signal Accuracy_GPS_Heading, frame RT_SB_GPS_Heading_Gradient_2, 9180706 (0x8c1622). Scaling: WorldValue = BinaryValue []. Unit: The unit "" from the network database is mapped to the AUTOSAR unit NoUnit"
    range phys 0..255 "The range of CAN input signal Accuracy_GPS_Heading, frame RT_SB_GPS_Heading_Gradient_2, 9180706 (0x8c1622). Range (world values): 0.0 ... 255.0 []"
  app type cif_0x8c1622_GPS_Heading_2_t:  # The type of CAN input signal GPS_Heading_2, frame RT_SB_GPS_Heading_Gradient_2, 9180706 (0x8c1622). This is GPS heading in the range 0 - 360., the direction that the vehicle is travelling in the local horizontal plane. Implementation type is uint16
    category=VALUE
    compu {phys=raw*0.01} "The scaling of CAN input signal GPS_Heading_2, frame RT_SB_GPS_Heading_Gradient_2, 9180706 (0x8c1622). Scaling: WorldValue = 0.01*BinaryValue + 0.0 [degrees]. Unit: The unit degrees from the network database is mapped to the AUTOSAR unit NoUnit"
    range phys 0..360 "The range of CAN input signal GPS_Heading_2, frame RT_SB_GPS_Heading_Gradient_2, 9180706 (0x8c1622). Range (world values): 0.0 ... 360.0 [degrees]"
  app type cif_0x8c1622_Accuracy_GPS_Gradient_t:  # The type of CAN input signal Accuracy_GPS_Gradient, frame RT_SB_GPS_Heading_Gradient_2, 9180706 (0x8c1622). Dimensionless. Lower values imply but do not guarantee better accuracy than higher values. Implementation type is uint8
    category=VALUE
    compu {phys=raw} "The scaling of CAN input signal Accuracy_GPS_Gradient, frame RT_SB_GPS_Heading_Gradient_2, 9180706 (0x8c1622). Scaling: WorldValue = BinaryValue []. Unit: The unit "" from the network database is mapped to the AUTOSAR unit NoUnit"
    range phys 0..255 "The range of CAN input signal Accuracy_GPS_Gradient, frame RT_SB_GPS_Heading_Gradient_2, 9180706 (0x8c1622). Range (world values): 0.0 ... 255.0 []"
  app type cif_0x8c1622_GPS_Gradient_t:  # The type of CAN input signal GPS_Gradient, frame RT_SB_GPS_Heading_Gradient_2, 9180706 (0x8c1622). This is GPS gradient, i.e. the vertical direction that the vehicle is travelling, NOT pointing (pitch). Implementation type is int16
    category=VALUE
    compu {phys=raw*0.01} "The scaling of CAN input signal GPS_Gradient, frame RT_SB_GPS_Heading_Gradient_2, 9180706 (0x8c1622). Scaling: WorldValue = 0.01*BinaryValue + 0.0 [degrees]. Unit: The unit degrees from the network database is mapped to the AUTOSAR unit NoUnit"
    range phys -90..90 "The range of CAN input signal GPS_Gradient, frame RT_SB_GPS_Heading_Gradient_2, 9180706 (0x8c1622). Range (world values): -90.0 ... 90.0 [degrees]"
  app type cif_0x802122_Validity_Cumulative_Time_t:  # The type of CAN input signal Validity_Cumulative_Time, frame RT_SB_Cumulative_Distance_2, 8397090 (0x802122). Valid when bit is set, invalid when bit is clear. Implementation type is boolean
    category=VALUE
    compu {phys=raw} "The scaling of CAN input signal Validity_Cumulative_Time, frame RT_SB_Cumulative_Distance_2, 8397090 (0x802122). Scaling: WorldValue = BinaryValue []. Unit: The unit "" from the network database is mapped to the AUTOSAR unit NoUnit"
    range phys 0..1 "The range of CAN input signal Validity_Cumulative_Time, frame RT_SB_Cumulative_Distance_2, 8397090 (0x802122). Range (world values): 0.0 ... 1.0 []"
  app type cif_0x802122_Validity_Cumulative_Distance_t:  # The type of CAN input signal Validity_Cumulative_Distance, frame RT_SB_Cumulative_Distance_2, 8397090 (0x802122). Valid when bit is set, invalid when bit is clear. Implementation type is boolean
    category=VALUE
    compu {phys=raw} "The scaling of CAN input signal Validity_Cumulative_Distance, frame RT_SB_Cumulative_Distance_2, 8397090 (0x802122). Scaling: WorldValue = BinaryValue []. Unit: The unit "" from the network database is mapped to the AUTOSAR unit NoUnit"
    range phys 0..1 "The range of CAN input signal Validity_Cumulative_Distance, frame RT_SB_Cumulative_Distance_2, 8397090 (0x802122). Range (world values): 0.0 ... 1.0 []"
  app type cif_0x802122_Cumulative_Time_t:  # The type of CAN input signal Cumulative_Time, frame RT_SB_Cumulative_Distance_2, 8397090 (0x802122). Implementation type is uint32
    category=VALUE
    compu {phys=raw*0.01; unit s} "The scaling of CAN input signal Cumulative_Time, frame RT_SB_Cumulative_Distance_2, 8397090 (0x802122). Scaling: WorldValue = 0.01*BinaryValue + 0.0 [s]. Unit: The unit s from the network database is mapped to the AUTOSAR unit Sec"
    range phys 0..167772 "The range of CAN input signal Cumulative_Time, frame RT_SB_Cumulative_Distance_2, 8397090 (0x802122). Range (world values): 0.0 ... 167772.0 [s]"
  app type cif_0x802122_Cumulative_Distance_t:  # The type of CAN input signal Cumulative_Distance, frame RT_SB_Cumulative_Distance_2, 8397090 (0x802122). Implementation type is uint32
    category=VALUE
    compu {phys=raw*0.001} "The scaling of CAN input signal Cumulative_Distance, frame RT_SB_Cumulative_Distance_2, 8397090 (0x802122). Scaling: WorldValue = 0.001*BinaryValue + 0.0 [m]. Unit: The unit m from the network database is mapped to the AUTOSAR unit NoUnit"
    range phys 0..4294970 "The range of CAN input signal Cumulative_Distance, frame RT_SB_Cumulative_Distance_2, 8397090 (0x802122). Range (world values): 0.0 ... 4294970.0 [m]"
  app type cif_0x802022_Validity_Cumulative_Time_t:  # The type of CAN input signal Validity_Cumulative_Time, frame RT_SB_Cumulative_Distance_1, 8396834 (0x802022). Valid when bit is set, invalid when bit is clear. Implementation type is boolean
    category=VALUE
    compu {phys=raw} "The scaling of CAN input signal Validity_Cumulative_Time, frame RT_SB_Cumulative_Distance_1, 8396834 (0x802022). Scaling: WorldValue = BinaryValue []. Unit: The unit "" from the network database is mapped to the AUTOSAR unit NoUnit"
    range phys 0..1 "The range of CAN input signal Validity_Cumulative_Time, frame RT_SB_Cumulative_Distance_1, 8396834 (0x802022). Range (world values): 0.0 ... 1.0 []"
  app type cif_0x802022_Validity_Cumulative_Distance_t:  # The type of CAN input signal Validity_Cumulative_Distance, frame RT_SB_Cumulative_Distance_1, 8396834 (0x802022). Valid when bit is set, invalid when bit is clear. Implementation type is boolean
    category=VALUE
    compu {phys=raw} "The scaling of CAN input signal Validity_Cumulative_Distance, frame RT_SB_Cumulative_Distance_1, 8396834 (0x802022). Scaling: WorldValue = BinaryValue []. Unit: The unit "" from the network database is mapped to the AUTOSAR unit NoUnit"
    range phys 0..1 "The range of CAN input signal Validity_Cumulative_Distance, frame RT_SB_Cumulative_Distance_1, 8396834 (0x802022). Range (world values): 0.0 ... 1.0 []"
  app type cif_0x802022_Cumulative_Time_t:  # The type of CAN input signal Cumulative_Time, frame RT_SB_Cumulative_Distance_1, 8396834 (0x802022). Implementation type is uint32
    category=VALUE
    compu {phys=raw*0.01; unit s} "The scaling of CAN input signal Cumulative_Time, frame RT_SB_Cumulative_Distance_1, 8396834 (0x802022). Scaling: WorldValue = 0.01*BinaryValue + 0.0 [s]. Unit: The unit s from the network database is mapped to the AUTOSAR unit Sec"
    range phys 0..167772 "The range of CAN input signal Cumulative_Time, frame RT_SB_Cumulative_Distance_1, 8396834 (0x802022). Range (world values): 0.0 ... 167772.0 [s]"
  app type cif_0x802022_Cumulative_Distance_t:  # The type of CAN input signal Cumulative_Distance, frame RT_SB_Cumulative_Distance_1, 8396834 (0x802022). Implementation type is uint32
    category=VALUE
    compu {phys=raw*0.001} "The scaling of CAN input signal Cumulative_Distance, frame RT_SB_Cumulative_Distance_1, 8396834 (0x802022). Scaling: WorldValue = 0.001*BinaryValue + 0.0 [m]. Unit: The unit m from the network database is mapped to the AUTOSAR unit NoUnit"
    range phys 0..4294970 "The range of CAN input signal Cumulative_Distance, frame RT_SB_Cumulative_Distance_1, 8396834 (0x802022). Range (world values): 0.0 ... 4294970.0 [m]"
  app type cif_0x8d0022_Validity_Trigger_Timestamp_t:  # The type of CAN input signal Validity_Trigger_Timestamp, frame RT_SB_Trigger_Timestamp, 9240610 (0x8d0022). Valid when bit is set, invalid when bit is clear. Implementation type is boolean
    category=VALUE
    compu {phys=raw} "The scaling of CAN input signal Validity_Trigger_Timestamp, frame RT_SB_Trigger_Timestamp, 9240610 (0x8d0022). Scaling: WorldValue = BinaryValue []. Unit: The unit "" from the network database is mapped to the AUTOSAR unit NoUnit"
    range phys 0..1 "The range of CAN input signal Validity_Trigger_Timestamp, frame RT_SB_Trigger_Timestamp, 9240610 (0x8d0022). Range (world values): 0.0 ... 1.0 []"
  app type cif_0x8d0022_Accuracy_Trigger_Timestamp_t:  # The type of CAN input signal Accuracy_Trigger_Timestamp, frame RT_SB_Trigger_Timestamp, 9240610 (0x8d0022). Dimensionless. Lower values imply but do not guarantee better accuracy than higher values. Implementation type is uint8
    category=VALUE
    compu {phys=raw} "The scaling of CAN input signal Accuracy_Trigger_Timestamp, frame RT_SB_Trigger_Timestamp, 9240610 (0x8d0022). Scaling: WorldValue = BinaryValue []. Unit: The unit "" from the network database is mapped to the AUTOSAR unit NoUnit"
    range phys 0..255 "The range of CAN input signal Accuracy_Trigger_Timestamp, frame RT_SB_Trigger_Timestamp, 9240610 (0x8d0022). Range (world values): 0.0 ... 255.0 []"
  app type cif_0x8d0022_Trigger_Number_t:  # The type of CAN input signal Trigger_Number, frame RT_SB_Trigger_Timestamp, 9240610 (0x8d0022). This is the ID of the trigger that generated the event, as marked on the case of the logger Implementation type is uint8
    category=VALUE
    compu {phys=raw+1} "The scaling of CAN input signal Trigger_Number, frame RT_SB_Trigger_Timestamp, 9240610 (0x8d0022). Scaling: WorldValue = 1.0*BinaryValue + 1.0 []. Unit: The unit "" from the network database is mapped to the AUTOSAR unit NoUnit"
    range phys 0..128 "The range of CAN input signal Trigger_Number, frame RT_SB_Trigger_Timestamp, 9240610 (0x8d0022). Range (world values): 0.0 ... 128.0 []"
  app type cif_0x8d0022_Trigger_Timestamp_Type_t:  # The type of CAN input signal Trigger_Timestamp_Type, frame RT_SB_Trigger_Timestamp, 9240610 (0x8d0022). Implementation type is boolean
    category=VALUE
    compu {phys=raw} "The scaling of CAN input signal Trigger_Timestamp_Type, frame RT_SB_Trigger_Timestamp, 9240610 (0x8d0022). Scaling: WorldValue = BinaryValue []. Unit: The unit "" from the network database is mapped to the AUTOSAR unit NoUnit"
    range phys 0..1 "The range of CAN input signal Trigger_Timestamp_Type, frame RT_SB_Trigger_Timestamp, 9240610 (0x8d0022). Range (world values): 0.0 ... 1.0 []"
  app type cif_0x8d0022_GPS_High_Resolution_Time_t:  # The type of CAN input signal GPS_High_Resolution_Time, frame RT_SB_Trigger_Timestamp, 9240610 (0x8d0022). GPS time of week to micro-second resolution. Implementation type is uint64
    category=VALUE
    compu {phys=raw*1e-06; unit s} "The scaling of CAN input signal GPS_High_Resolution_Time, frame RT_SB_Trigger_Timestamp, 9240610 (0x8d0022). Scaling: WorldValue = 1.0E-6*BinaryValue + 0.0 [s]. Unit: The unit s from the network database is mapped to the AUTOSAR unit Sec"
    range phys 0..604800 "The range of CAN input signal GPS_High_Resolution_Time, frame RT_SB_Trigger_Timestamp, 9240610 (0x8d0022). Range (world values): 0.0 ... 604800.0 [s]"
  app type cif_0x800121_Validity_Gyro_Rate_Yaw_t:  # The type of CAN input signal Validity_Gyro_Rate_Yaw, frame RT_IMU06_Gyro_Rates, 8388897 (0x800121). Valid when bit is set, invalid when bit is clear. Implementation type is boolean
    category=VALUE
    compu {phys=raw} "The scaling of CAN input signal Validity_Gyro_Rate_Yaw, frame RT_IMU06_Gyro_Rates, 8388897 (0x800121). Scaling: WorldValue = BinaryValue []. Unit: The unit "" from the network database is mapped to the AUTOSAR unit NoUnit"
    range phys 0..1 "The range of CAN input signal Validity_Gyro_Rate_Yaw, frame RT_IMU06_Gyro_Rates, 8388897 (0x800121). Range (world values): 0.0 ... 1.0 []"
  app type cif_0x800121_Validity_Gyro_Rate_Pitch_t:  # The type of CAN input signal Validity_Gyro_Rate_Pitch, frame RT_IMU06_Gyro_Rates, 8388897 (0x800121). Valid when bit is set, invalid when bit is clear. Implementation type is boolean
    category=VALUE
    compu {phys=raw} "The scaling of CAN input signal Validity_Gyro_Rate_Pitch, frame RT_IMU06_Gyro_Rates, 8388897 (0x800121). Scaling: WorldValue = BinaryValue []. Unit: The unit "" from the network database is mapped to the AUTOSAR unit NoUnit"
    range phys 0..1 "The range of CAN input signal Validity_Gyro_Rate_Pitch, frame RT_IMU06_Gyro_Rates, 8388897 (0x800121). Range (world values): 0.0 ... 1.0 []"
  app type cif_0x800121_Validity_Gyro_Rate_Roll_t:  # The type of CAN input signal Validity_Gyro_Rate_Roll, frame RT_IMU06_Gyro_Rates, 8388897 (0x800121). Valid when bit is set, invalid when bit is clear. Implementation type is boolean
    category=VALUE
    compu {phys=raw} "The scaling of CAN input signal Validity_Gyro_Rate_Roll, frame RT_IMU06_Gyro_Rates, 8388897 (0x800121). Scaling: WorldValue = BinaryValue []. Unit: The unit "" from the network database is mapped to the AUTOSAR unit NoUnit"
    range phys 0..1 "The range of CAN input signal Validity_Gyro_Rate_Roll, frame RT_IMU06_Gyro_Rates, 8388897 (0x800121). Range (world values): 0.0 ... 1.0 []"
  app type cif_0x800121_Accuracy_Gyro_Rates_t: category=VALUE, compu {phys=raw} "The scaling of CAN input signal Accuracy_Gyro_Rates, frame RT_IMU06_Gyro_Rates, 8388897 (0x800121). Scaling: WorldValue = BinaryValue []. Unit: The unit "" from the network database is mapped to the AUTOSAR unit NoUnit", range phys 0 "The range of CAN input signal Accuracy_Gyro_Rates, frame RT_IMU06_Gyro_Rates, 8388897 (0x800121). Range (world values): 0.0 ... 0.0 []"  # The type of CAN input signal Accuracy_Gyro_Rates, frame RT_IMU06_Gyro_Rates, 8388897 (0x800121). Dimensionless. Lower values imply but do not guarantee better accuracy than higher values. Implementation type is uint8
  app type cif_0x800121_Gyro_Rate_Yaw_t:  # The type of CAN input signal Gyro_Rate_Yaw, frame RT_IMU06_Gyro_Rates, 8388897 (0x800121). Yaw rate is positive for clockwise rotation when looking down on the vehicle from above. Implementation type is int16
    category=VALUE
    compu {phys=raw*0.01} "The scaling of CAN input signal Gyro_Rate_Yaw, frame RT_IMU06_Gyro_Rates, 8388897 (0x800121). Scaling: WorldValue = 0.01*BinaryValue + 0.0 [degrees/s]. Unit: The unit degrees/s from the network database is mapped to the AUTOSAR unit NoUnit"
    range phys -327..327 "The range of CAN input signal Gyro_Rate_Yaw, frame RT_IMU06_Gyro_Rates, 8388897 (0x800121). Range (world values): -327.0 ... 327.0 [degrees/s]"
  app type cif_0x800121_Gyro_Rate_Pitch_t:  # The type of CAN input signal Gyro_Rate_Pitch, frame RT_IMU06_Gyro_Rates, 8388897 (0x800121). Pitch rate is positive for clockwise rotation when looking at the left hand side of the vehicle from the left of the vehicle. Implementation type is int16
    category=VALUE
    compu {phys=raw*0.01} "The scaling of CAN input signal Gyro_Rate_Pitch, frame RT_IMU06_Gyro_Rates, 8388897 (0x800121). Scaling: WorldValue = 0.01*BinaryValue + 0.0 [degrees/s]. Unit: The unit degrees/s from the network database is mapped to the AUTOSAR unit NoUnit"
    range phys -327..327 "The range of CAN input signal Gyro_Rate_Pitch, frame RT_IMU06_Gyro_Rates, 8388897 (0x800121). Range (world values): -327.0 ... 327.0 [degrees/s]"
  app type cif_0x800121_Gyro_Rate_Roll_t:  # The type of CAN input signal Gyro_Rate_Roll, frame RT_IMU06_Gyro_Rates, 8388897 (0x800121). Roll rate is positive for clockwise rotation when looking at the rear of the vehicle from behind the vehicle. Implementation type is int16
    category=VALUE
    compu {phys=raw*0.01} "The scaling of CAN input signal Gyro_Rate_Roll, frame RT_IMU06_Gyro_Rates, 8388897 (0x800121). Scaling: WorldValue = 0.01*BinaryValue + 0.0 [degrees/s]. Unit: The unit degrees/s from the network database is mapped to the AUTOSAR unit NoUnit"
    range phys -327..327 "The range of CAN input signal Gyro_Rate_Roll, frame RT_IMU06_Gyro_Rates, 8388897 (0x800121). Range (world values): -327.0 ... 327.0 [degrees/s]"
  app type cif_0x800021_Validity_Accel_Longitudinal_t:  # The type of CAN input signal Validity_Accel_Longitudinal, frame RT_IMU06_Accel, 8388641 (0x800021). Valid when bit is set, invalid when bit is clear. Implementation type is boolean
    category=VALUE
    compu {phys=raw} "The scaling of CAN input signal Validity_Accel_Longitudinal, frame RT_IMU06_Accel, 8388641 (0x800021). Scaling: WorldValue = BinaryValue []. Unit: The unit "" from the network database is mapped to the AUTOSAR unit NoUnit"
    range phys 0..1 "The range of CAN input signal Validity_Accel_Longitudinal, frame RT_IMU06_Accel, 8388641 (0x800021). Range (world values): 0.0 ... 1.0 []"
  app type cif_0x800021_Validity_Accel_Lateral_t: category=VALUE, compu {phys=raw} "The scaling of CAN input signal Validity_Accel_Lateral, frame RT_IMU06_Accel, 8388641 (0x800021). Scaling: WorldValue = BinaryValue []. Unit: The unit "" from the network database is mapped to the AUTOSAR unit NoUnit", range phys 0..1 "The range of CAN input signal Validity_Accel_Lateral, frame RT_IMU06_Accel, 8388641 (0x800021). Range (world values): 0.0 ... 1.0 []"  # The type of CAN input signal Validity_Accel_Lateral, frame RT_IMU06_Accel, 8388641 (0x800021). Valid when bit is set, invalid when bit is clear. Implementation type is boolean
  app type cif_0x800021_Validity_Accel_Vertical_t:  # The type of CAN input signal Validity_Accel_Vertical, frame RT_IMU06_Accel, 8388641 (0x800021). Valid when bit is set, invalid when bit is clear. Implementation type is boolean
    category=VALUE
    compu {phys=raw} "The scaling of CAN input signal Validity_Accel_Vertical, frame RT_IMU06_Accel, 8388641 (0x800021). Scaling: WorldValue = BinaryValue []. Unit: The unit "" from the network database is mapped to the AUTOSAR unit NoUnit"
    range phys 0..1 "The range of CAN input signal Validity_Accel_Vertical, frame RT_IMU06_Accel, 8388641 (0x800021). Range (world values): 0.0 ... 1.0 []"
  app type cif_0x800021_Accuracy_Accel_t: category=VALUE, compu {phys=raw} "The scaling of CAN input signal Accuracy_Accel, frame RT_IMU06_Accel, 8388641 (0x800021). Scaling: WorldValue = BinaryValue []. Unit: The unit "" from the network database is mapped to the AUTOSAR unit NoUnit", range phys 0..255 "The range of CAN input signal Accuracy_Accel, frame RT_IMU06_Accel, 8388641 (0x800021). Range (world values): 0.0 ... 255.0 []"  # The type of CAN input signal Accuracy_Accel, frame RT_IMU06_Accel, 8388641 (0x800021). Dimensionless. Lower values imply but do not guarantee better accuracy than higher values. Implementation type is uint8
  app type cif_0x800021_Accel_Longitudinal_t:  # The type of CAN input signal Accel_Longitudinal, frame RT_IMU06_Accel, 8388641 (0x800021). Longitudinal acceleration. This is positive when the vehicle accelerates in a forwards direction. Implementation type is int16
    category=VALUE
    compu {phys=raw*0.001} "The scaling of CAN input signal Accel_Longitudinal, frame RT_IMU06_Accel, 8388641 (0x800021). Scaling: WorldValue = 0.001*BinaryValue + 0.0 [g]. Unit: The unit g from the network database is mapped to the AUTOSAR unit NoUnit"
    range phys -65..65 "The range of CAN input signal Accel_Longitudinal, frame RT_IMU06_Accel, 8388641 (0x800021). Range (world values): -65.0 ... 65.0 [g]"
  app type cif_0x800021_Accel_Lateral_t:  # The type of CAN input signal Accel_Lateral, frame RT_IMU06_Accel, 8388641 (0x800021). Lateral acceleration. This is positive when the vehicle accelerates towards the right, e.g. when cornering around a right-hand bend. Implementation type is int16
    category=VALUE
    compu {phys=raw*0.001} "The scaling of CAN input signal Accel_Lateral, frame RT_IMU06_Accel, 8388641 (0x800021). Scaling: WorldValue = 0.001*BinaryValue + 0.0 [g]. Unit: The unit g from the network database is mapped to the AUTOSAR unit NoUnit"
    range phys -65..65 "The range of CAN input signal Accel_Lateral, frame RT_IMU06_Accel, 8388641 (0x800021). Range (world values): -65.0 ... 65.0 [g]"
  app type cif_0x800021_Accel_Vertical_t:  # The type of CAN input signal Accel_Vertical, frame RT_IMU06_Accel, 8388641 (0x800021). Vertical acceleration. This is positive when the vehicle accelerates in an upwards direction, e.g. when travelling through a dip. Implementation type is int16
    category=VALUE
    compu {phys=raw*0.001} "The scaling of CAN input signal Accel_Vertical, frame RT_IMU06_Accel, 8388641 (0x800021). Scaling: WorldValue = 0.001*BinaryValue + 0.0 [g]. Unit: The unit g from the network database is mapped to the AUTOSAR unit NoUnit"
    range phys -65..65 "The range of CAN input signal Accel_Vertical, frame RT_IMU06_Accel, 8388641 (0x800021). Range (world values): -65.0 ... 65.0 [g]"
  app type cif_0x801022_Validity_Speed_t: category=VALUE, compu {phys=raw} "The scaling of CAN input signal Validity_Speed, frame RT_SB_Speed, 8392738 (0x801022). Scaling: WorldValue = BinaryValue []. Unit: The unit "" from the network database is mapped to the AUTOSAR unit NoUnit", range phys 0..1 "The range of CAN input signal Validity_Speed, frame RT_SB_Speed, 8392738 (0x801022). Range (world values): 0.0 ... 1.0 []"  # The type of CAN input signal Validity_Speed, frame RT_SB_Speed, 8392738 (0x801022). Valid when bit is set, invalid when bit is clear. Implementation type is boolean
  app type cif_0x801022_Accuracy_Speed_t: category=VALUE, compu {phys=raw} "The scaling of CAN input signal Accuracy_Speed, frame RT_SB_Speed, 8392738 (0x801022). Scaling: WorldValue = BinaryValue []. Unit: The unit "" from the network database is mapped to the AUTOSAR unit NoUnit", range phys 0..255 "The range of CAN input signal Accuracy_Speed, frame RT_SB_Speed, 8392738 (0x801022). Range (world values): 0.0 ... 255.0 []"  # The type of CAN input signal Accuracy_Speed, frame RT_SB_Speed, 8392738 (0x801022). Dimensionless. Lower values imply but do not guarantee better accuracy than higher values. Implementation type is uint8
  app type cif_0x801022_Speed_t:  # The type of CAN input signal Speed, frame RT_SB_Speed, 8392738 (0x801022). Implementation type is int32
    category=VALUE
    compu {phys=raw*1e-05} "The scaling of CAN input signal Speed, frame RT_SB_Speed, 8392738 (0x801022). Scaling: WorldValue = 1.0E-5*BinaryValue + 0.0 [m/s]. Unit: The unit m/s from the network database is mapped to the AUTOSAR unit NoUnit"
    range phys -20000..20000 "The range of CAN input signal Speed, frame RT_SB_Speed, 8392738 (0x801022). Range (world values): -20000.0 ... 20000.0 [m/s]"
  app type cif_0x8c2122_Validity_RTK_Slip_t: category=VALUE, compu {phys=raw} "The scaling of CAN input signal Validity_RTK_Slip, frame RT_SB_RTK_Slip, 9183522 (0x8c2122). Scaling: WorldValue = BinaryValue []. Unit: The unit "" from the network database is mapped to the AUTOSAR unit NoUnit", range phys 0..1 "The range of CAN input signal Validity_RTK_Slip, frame RT_SB_RTK_Slip, 9183522 (0x8c2122). Range (world values): 0.0 ... 1.0 []"  # The type of CAN input signal Validity_RTK_Slip, frame RT_SB_RTK_Slip, 9183522 (0x8c2122). Valid when bit is set, invalid when bit is clear. Implementation type is boolean
  app type cif_0x8c2122_Validity_RTK_Squat_t: category=VALUE, compu {phys=raw} "The scaling of CAN input signal Validity_RTK_Squat, frame RT_SB_RTK_Slip, 9183522 (0x8c2122). Scaling: WorldValue = BinaryValue []. Unit: The unit "" from the network database is mapped to the AUTOSAR unit NoUnit", range phys 0..1 "The range of CAN input signal Validity_RTK_Squat, frame RT_SB_RTK_Slip, 9183522 (0x8c2122). Range (world values): 0.0 ... 1.0 []"  # The type of CAN input signal Validity_RTK_Squat, frame RT_SB_RTK_Slip, 9183522 (0x8c2122). Valid when bit is set, invalid when bit is clear. Implementation type is boolean
  app type cif_0x8c2122_Validity_RTK_Baseline_t: category=VALUE, compu {phys=raw} "The scaling of CAN input signal Validity_RTK_Baseline, frame RT_SB_RTK_Slip, 9183522 (0x8c2122). Scaling: WorldValue = BinaryValue []. Unit: The unit "" from the network database is mapped to the AUTOSAR unit NoUnit", range phys 0..1 "The range of CAN input signal Validity_RTK_Baseline, frame RT_SB_RTK_Slip, 9183522 (0x8c2122). Range (world values): 0.0 ... 1.0 []"  # The type of CAN input signal Validity_RTK_Baseline, frame RT_SB_RTK_Slip, 9183522 (0x8c2122). Valid when bit is set, invalid when bit is clear. Implementation type is boolean
  app type cif_0x8c2122_Accuracy_RTK_Baseline_t:  # The type of CAN input signal Accuracy_RTK_Baseline, frame RT_SB_RTK_Slip, 9183522 (0x8c2122). Implementation type is uint8
    category=VALUE
    compu {phys=raw} "The scaling of CAN input signal Accuracy_RTK_Baseline, frame RT_SB_RTK_Slip, 9183522 (0x8c2122). Scaling: WorldValue = BinaryValue []. Unit: The unit "" from the network database is mapped to the AUTOSAR unit NoUnit"
    range phys 0..255 "The range of CAN input signal Accuracy_RTK_Baseline, frame RT_SB_RTK_Slip, 9183522 (0x8c2122). Range (world values): 0.0 ... 255.0 []"
  app type cif_0x8c2122_RTK_Slip_t:  # The type of CAN input signal RTK_Slip, frame RT_SB_RTK_Slip, 9183522 (0x8c2122). Slip is defined as the difference between yaw and heading. Implementation type is int16
    category=VALUE
    compu {phys=raw*0.01} "The scaling of CAN input signal RTK_Slip, frame RT_SB_RTK_Slip, 9183522 (0x8c2122). Scaling: WorldValue = 0.01*BinaryValue + 0.0 [degrees]. Unit: The unit degrees from the network database is mapped to the AUTOSAR unit NoUnit"
    range phys -360..360 "The range of CAN input signal RTK_Slip, frame RT_SB_RTK_Slip, 9183522 (0x8c2122). Range (world values): -360.0 ... 360.0 [degrees]"
  app type cif_0x8c2122_RTK_Squat_t:  # The type of CAN input signal RTK_Squat, frame RT_SB_RTK_Slip, 9183522 (0x8c2122). Squat is defined as the difference between pitch and gradient. Implementation type is int16
    category=VALUE
    compu {phys=raw*0.01} "The scaling of CAN input signal RTK_Squat, frame RT_SB_RTK_Slip, 9183522 (0x8c2122). Scaling: WorldValue = 0.01*BinaryValue + 0.0 [degrees]. Unit: The unit degrees from the network database is mapped to the AUTOSAR unit NoUnit"
    range phys -360..360 "The range of CAN input signal RTK_Squat, frame RT_SB_RTK_Slip, 9183522 (0x8c2122). Range (world values): -360.0 ... 360.0 [degrees]"
  app type cif_0x8c2122_RTK_Baseline_t:  # The type of CAN input signal RTK_Baseline, frame RT_SB_RTK_Slip, 9183522 (0x8c2122). This is the estimated baseline length calculated by the RTK solution. Implementation type is uint16
    category=VALUE
    compu {phys=raw; unit m} "The scaling of CAN input signal RTK_Baseline, frame RT_SB_RTK_Slip, 9183522 (0x8c2122). Scaling: WorldValue = BinaryValue [mm]. Unit: The unit mm from the network database is mapped to the AUTOSAR unit MilliMtr"
    range phys 0..65535 "The range of CAN input signal RTK_Baseline, frame RT_SB_RTK_Slip, 9183522 (0x8c2122). Range (world values): 0.0 ... 65535.0 [mm]"
  app type cif_0x8c2022_Validity_RTK_Yaw_t: category=VALUE, compu {phys=raw} "The scaling of CAN input signal Validity_RTK_Yaw, frame RT_SB_RTK_Attitude, 9183266 (0x8c2022). Scaling: WorldValue = BinaryValue []. Unit: The unit "" from the network database is mapped to the AUTOSAR unit NoUnit", range phys 0..1 "The range of CAN input signal Validity_RTK_Yaw, frame RT_SB_RTK_Attitude, 9183266 (0x8c2022). Range (world values): 0.0 ... 1.0 []"  # The type of CAN input signal Validity_RTK_Yaw, frame RT_SB_RTK_Attitude, 9183266 (0x8c2022). Valid when bit is set, invalid when bit is clear. Implementation type is boolean
  app type cif_0x8c2022_Validity_RTK_Pitch_t: category=VALUE, compu {phys=raw} "The scaling of CAN input signal Validity_RTK_Pitch, frame RT_SB_RTK_Attitude, 9183266 (0x8c2022). Scaling: WorldValue = BinaryValue []. Unit: The unit "" from the network database is mapped to the AUTOSAR unit NoUnit", range phys 0..1 "The range of CAN input signal Validity_RTK_Pitch, frame RT_SB_RTK_Attitude, 9183266 (0x8c2022). Range (world values): 0.0 ... 1.0 []"  # The type of CAN input signal Validity_RTK_Pitch, frame RT_SB_RTK_Attitude, 9183266 (0x8c2022). Valid when bit is set, invalid when bit is clear. Implementation type is boolean
  app type cif_0x8c2022_Validity_RTK_Roll_t: category=VALUE, compu {phys=raw} "The scaling of CAN input signal Validity_RTK_Roll, frame RT_SB_RTK_Attitude, 9183266 (0x8c2022). Scaling: WorldValue = BinaryValue []. Unit: The unit "" from the network database is mapped to the AUTOSAR unit NoUnit", range phys 0..1 "The range of CAN input signal Validity_RTK_Roll, frame RT_SB_RTK_Attitude, 9183266 (0x8c2022). Range (world values): 0.0 ... 1.0 []"  # The type of CAN input signal Validity_RTK_Roll, frame RT_SB_RTK_Attitude, 9183266 (0x8c2022). Valid when bit is set, invalid when bit is clear. Implementation type is boolean
  app type cif_0x8c2022_Accuracy_RTK_Attitude_t:  # The type of CAN input signal Accuracy_RTK_Attitude, frame RT_SB_RTK_Attitude, 9183266 (0x8c2022). Note that RTK yaw is typically up to about 4 times more accurate than RTK pitch or roll. Implementation type is uint8
    category=VALUE
    compu {phys=raw} "The scaling of CAN input signal Accuracy_RTK_Attitude, frame RT_SB_RTK_Attitude, 9183266 (0x8c2022). Scaling: WorldValue = BinaryValue []. Unit: The unit "" from the network database is mapped to the AUTOSAR unit NoUnit"
    range phys 0..255 "The range of CAN input signal Accuracy_RTK_Attitude, frame RT_SB_RTK_Attitude, 9183266 (0x8c2022). Range (world values): 0.0 ... 255.0 []"
  app type cif_0x8c2022_RTK_Attitude_Yaw_t:  # The type of CAN input signal RTK_Attitude_Yaw, frame RT_SB_RTK_Attitude, 9183266 (0x8c2022). RTK attitude is determined from the MB-RTK solution only. Yaw is positive for a clockwise rotational displacement from due North, looking down on the vehicle from above. Implementation type is int16
    category=VALUE
    compu {phys=raw*0.01} "The scaling of CAN input signal RTK_Attitude_Yaw, frame RT_SB_RTK_Attitude, 9183266 (0x8c2022). Scaling: WorldValue = 0.01*BinaryValue + 0.0 [degrees]. Unit: The unit degrees from the network database is mapped to the AUTOSAR unit NoUnit"
    range phys -360..360 "The range of CAN input signal RTK_Attitude_Yaw, frame RT_SB_RTK_Attitude, 9183266 (0x8c2022). Range (world values): -360.0 ... 360.0 [degrees]"
  app type cif_0x8c2022_RTK_Attitude_Pitch_t:  # The type of CAN input signal RTK_Attitude_Pitch, frame RT_SB_RTK_Attitude, 9183266 (0x8c2022). RTK attitude is determined from the MB-RTK solution only. Pitch is positive for a clockwise rotational displacement from the local horizontal plane when looking at the vehicle from the left hand side of it. Implementation type is int16
    category=VALUE
    compu {phys=raw*0.01} "The scaling of CAN input signal RTK_Attitude_Pitch, frame RT_SB_RTK_Attitude, 9183266 (0x8c2022). Scaling: WorldValue = 0.01*BinaryValue + 0.0 [degrees]. Unit: The unit degrees from the network database is mapped to the AUTOSAR unit NoUnit"
    range phys -90..90 "The range of CAN input signal RTK_Attitude_Pitch, frame RT_SB_RTK_Attitude, 9183266 (0x8c2022). Range (world values): -90.0 ... 90.0 [degrees]"
  app type cif_0x8c2022_RTK_Attitude_Roll_t:  # The type of CAN input signal RTK_Attitude_Roll, frame RT_SB_RTK_Attitude, 9183266 (0x8c2022). RTK attitude is determined from the MB-RTK solution only. Roll is positive for a clockwise rotational displacement relative to the local horizontal plane when looking at the vehicle from the rear of it. Implementation type is int16
    category=VALUE
    compu {phys=raw*0.01} "The scaling of CAN input signal RTK_Attitude_Roll, frame RT_SB_RTK_Attitude, 9183266 (0x8c2022). Scaling: WorldValue = 0.01*BinaryValue + 0.0 [degrees]. Unit: The unit degrees from the network database is mapped to the AUTOSAR unit NoUnit"
    range phys -90..90 "The range of CAN input signal RTK_Attitude_Roll, frame RT_SB_RTK_Attitude, 9183266 (0x8c2022). Range (world values): -90.0 ... 90.0 [degrees]"
  app type cif_0x8c3022_Validity_GPS_Lateral_Accel_t:  # The type of CAN input signal Validity_GPS_Lateral_Accel, frame RT_SB_GPS_Mcycle_Lean, 9187362 (0x8c3022). Valid when bit is set, invalid when bit is clear. Implementation type is boolean
    category=VALUE
    compu {phys=raw} "The scaling of CAN input signal Validity_GPS_Lateral_Accel, frame RT_SB_GPS_Mcycle_Lean, 9187362 (0x8c3022). Scaling: WorldValue = BinaryValue []. Unit: The unit "" from the network database is mapped to the AUTOSAR unit NoUnit"
    range phys 0..1 "The range of CAN input signal Validity_GPS_Lateral_Accel, frame RT_SB_GPS_Mcycle_Lean, 9187362 (0x8c3022). Range (world values): 0.0 ... 1.0 []"
  app type cif_0x8c3022_Validity_GPS_Mcycle_Lean_t:  # The type of CAN input signal Validity_GPS_Mcycle_Lean, frame RT_SB_GPS_Mcycle_Lean, 9187362 (0x8c3022). Valid when bit is set, invalid when bit is clear. Implementation type is boolean
    category=VALUE
    compu {phys=raw} "The scaling of CAN input signal Validity_GPS_Mcycle_Lean, frame RT_SB_GPS_Mcycle_Lean, 9187362 (0x8c3022). Scaling: WorldValue = BinaryValue []. Unit: The unit "" from the network database is mapped to the AUTOSAR unit NoUnit"
    range phys 0..1 "The range of CAN input signal Validity_GPS_Mcycle_Lean, frame RT_SB_GPS_Mcycle_Lean, 9187362 (0x8c3022). Range (world values): 0.0 ... 1.0 []"
  app type cif_0x8c3022_Accuracy_GPS_Lateral_Accel_t:  # The type of CAN input signal Accuracy_GPS_Lateral_Accel, frame RT_SB_GPS_Mcycle_Lean, 9187362 (0x8c3022). This accuracy value applies to both GPS-derived lateral acceleration and motorcycle lean angle, since both are derived from the rate of change of GPS heading. Implementation type is uint8
    category=VALUE
    compu {phys=raw} "The scaling of CAN input signal Accuracy_GPS_Lateral_Accel, frame RT_SB_GPS_Mcycle_Lean, 9187362 (0x8c3022). Scaling: WorldValue = BinaryValue []. Unit: The unit "" from the network database is mapped to the AUTOSAR unit NoUnit"
    range phys 0..255 "The range of CAN input signal Accuracy_GPS_Lateral_Accel, frame RT_SB_GPS_Mcycle_Lean, 9187362 (0x8c3022). Range (world values): 0.0 ... 255.0 []"
  app type cif_0x8c3022_GPS_Lateral_Accel_t:  # The type of CAN input signal GPS_Lateral_Accel, frame RT_SB_GPS_Mcycle_Lean, 9187362 (0x8c3022). GPS-derived lateral acceleration. This is derived by differentiating GPS heading - it is much more noisy than lateral accel from the accelerometers, but useful for m/cycle applications. Implementation type is int16
    category=VALUE
    compu {phys=raw*0.001} "The scaling of CAN input signal GPS_Lateral_Accel, frame RT_SB_GPS_Mcycle_Lean, 9187362 (0x8c3022). Scaling: WorldValue = 0.001*BinaryValue + 0.0 [g]. Unit: The unit g from the network database is mapped to the AUTOSAR unit NoUnit"
    range phys -65..65 "The range of CAN input signal GPS_Lateral_Accel, frame RT_SB_GPS_Mcycle_Lean, 9187362 (0x8c3022). Range (world values): -65.0 ... 65.0 [g]"
  app type cif_0x8c3022_GPS_Mcycle_Lean_Angle_t:  # The type of CAN input signal GPS_Mcycle_Lean_Angle, frame RT_SB_GPS_Mcycle_Lean, 9187362 (0x8c3022). Motorcycle lean angle, derived from rate of change of heading from GPS. This is the lean angle of the centre of mass of the combined bike + rider. Implementation type is int16
    category=VALUE
    compu {phys=raw*0.01} "The scaling of CAN input signal GPS_Mcycle_Lean_Angle, frame RT_SB_GPS_Mcycle_Lean, 9187362 (0x8c3022). Scaling: WorldValue = 0.01*BinaryValue + 0.0 [degrees]. Unit: The unit degrees from the network database is mapped to the AUTOSAR unit NoUnit"
    range phys -90..90 "The range of CAN input signal GPS_Mcycle_Lean_Angle, frame RT_SB_GPS_Mcycle_Lean, 9187362 (0x8c3022). Range (world values): -90.0 ... 90.0 [degrees]"
  app type cif_0x8c0022_GPS_Status_t: category=VALUE, compu {phys=raw} "The scaling of CAN input signal GPS_Status, frame RT_SB_GPS_Status, 9175074 (0x8c0022). Scaling: WorldValue = BinaryValue []. Unit: The unit "" from the network database is mapped to the AUTOSAR unit NoUnit", range phys 0..255 "The range of CAN input signal GPS_Status, frame RT_SB_GPS_Status, 9175074 (0x8c0022). Range (world values): 0.0 ... 255.0 []"  # The type of CAN input signal GPS_Status, frame RT_SB_GPS_Status, 9175074 (0x8c0022). Implementation type is uint8
  app type cif_0x8c0022_Firmware_Version_Major_t:  # The type of CAN input signal Firmware_Version_Major, frame RT_SB_GPS_Status, 9175074 (0x8c0022). Implementation type is uint8
    category=VALUE
    compu {phys=raw} "The scaling of CAN input signal Firmware_Version_Major, frame RT_SB_GPS_Status, 9175074 (0x8c0022). Scaling: WorldValue = BinaryValue []. Unit: The unit "" from the network database is mapped to the AUTOSAR unit NoUnit"
    range phys 0..255 "The range of CAN input signal Firmware_Version_Major, frame RT_SB_GPS_Status, 9175074 (0x8c0022). Range (world values): 0.0 ... 255.0 []"
  app type cif_0x8c0022_Firmware_Version_Intermediate_t:  # The type of CAN input signal Firmware_Version_Intermediate, frame RT_SB_GPS_Status, 9175074 (0x8c0022). Implementation type is uint8
    category=VALUE
    compu {phys=raw} "The scaling of CAN input signal Firmware_Version_Intermediate, frame RT_SB_GPS_Status, 9175074 (0x8c0022). Scaling: WorldValue = BinaryValue []. Unit: The unit "" from the network database is mapped to the AUTOSAR unit NoUnit"
    range phys 0..255 "The range of CAN input signal Firmware_Version_Intermediate, frame RT_SB_GPS_Status, 9175074 (0x8c0022). Range (world values): 0.0 ... 255.0 []"
  app type cif_0x8c0022_Firmware_Version_Minor_t:  # The type of CAN input signal Firmware_Version_Minor, frame RT_SB_GPS_Status, 9175074 (0x8c0022). Implementation type is uint8
    category=VALUE
    compu {phys=raw} "The scaling of CAN input signal Firmware_Version_Minor, frame RT_SB_GPS_Status, 9175074 (0x8c0022). Scaling: WorldValue = BinaryValue []. Unit: The unit "" from the network database is mapped to the AUTOSAR unit NoUnit"
    range phys 0..255 "The range of CAN input signal Firmware_Version_Minor, frame RT_SB_GPS_Status, 9175074 (0x8c0022). Range (world values): 0.0 ... 255.0 []"
  app type cif_0x8c0022_GPS_nSv_t: category=VALUE, compu {phys=raw} "The scaling of CAN input signal GPS_nSv, frame RT_SB_GPS_Status, 9175074 (0x8c0022). Scaling: WorldValue = BinaryValue []. Unit: The unit "" from the network database is mapped to the AUTOSAR unit NoUnit", range phys 0..16 "The range of CAN input signal GPS_nSv, frame RT_SB_GPS_Status, 9175074 (0x8c0022). Range (world values): 0.0 ... 16.0 []"  # The type of CAN input signal GPS_nSv, frame RT_SB_GPS_Status, 9175074 (0x8c0022). Number of satellites used in GPS solution Implementation type is uint8
  app type cif_0x8c0022_GPS_nSv_2_t: category=VALUE, compu {phys=raw} "The scaling of CAN input signal GPS_nSv_2, frame RT_SB_GPS_Status, 9175074 (0x8c0022). Scaling: WorldValue = BinaryValue []. Unit: The unit "" from the network database is mapped to the AUTOSAR unit NoUnit", range phys 0..16 "The range of CAN input signal GPS_nSv_2, frame RT_SB_GPS_Status, 9175074 (0x8c0022). Range (world values): 0.0 ... 16.0 []"  # The type of CAN input signal GPS_nSv_2, frame RT_SB_GPS_Status, 9175074 (0x8c0022). Number of satellites used in GPS solution by module 2 on RTK units... Implementation type is uint8
  app type cif_0x8c0022_GPS_nSv_RTK_t: category=VALUE, compu {phys=raw} "The scaling of CAN input signal GPS_nSv_RTK, frame RT_SB_GPS_Status, 9175074 (0x8c0022). Scaling: WorldValue = BinaryValue []. Unit: The unit "" from the network database is mapped to the AUTOSAR unit NoUnit", range phys 0..16 "The range of CAN input signal GPS_nSv_RTK, frame RT_SB_GPS_Status, 9175074 (0x8c0022). Range (world values): 0.0 ... 16.0 []"  # The type of CAN input signal GPS_nSv_RTK, frame RT_SB_GPS_Status, 9175074 (0x8c0022). Number of common satellites available to RTK solution Implementation type is uint8
  app type cif_0x8c0022_RTK_Status_t: category=VALUE, compu {phys=raw} "The scaling of CAN input signal RTK_Status, frame RT_SB_GPS_Status, 9175074 (0x8c0022). Scaling: WorldValue = BinaryValue []. Unit: The unit "" from the network database is mapped to the AUTOSAR unit NoUnit", range phys 0..255 "The range of CAN input signal RTK_Status, frame RT_SB_GPS_Status, 9175074 (0x8c0022). Range (world values): 0.0 ... 255.0 []"  # The type of CAN input signal RTK_Status, frame RT_SB_GPS_Status, 9175074 (0x8c0022). Implementation type is uint8
  app type cif_0x8c0522_GPS_Pos_ECEF_Y_t:  # The type of CAN input signal GPS_Pos_ECEF_Y, frame RT_SB_GPS_Pos_ECEF_2, 9176354 (0x8c0522). ECEF Y position. The ECEF Y axis originates from the Earth centre, and the positive Y axis intersects the Earth surface at zero degrees latittude and 90 degrees longitude. Implementation type is int32
    category=VALUE
    compu {phys=raw*0.01} "The scaling of CAN input signal GPS_Pos_ECEF_Y, frame RT_SB_GPS_Pos_ECEF_2, 9176354 (0x8c0522). Scaling: WorldValue = 0.01*BinaryValue + 0.0 [m]. Unit: The unit m from the network database is mapped to the AUTOSAR unit NoUnit"
    range phys -10000000..10000000 "The range of CAN input signal GPS_Pos_ECEF_Y, frame RT_SB_GPS_Pos_ECEF_2, 9176354 (0x8c0522). Range (world values): -1.0E7 ... 1.0E7 [m]"
  app type cif_0x8c0522_GPS_Pos_ECEF_Z_t:  # The type of CAN input signal GPS_Pos_ECEF_Z, frame RT_SB_GPS_Pos_ECEF_2, 9176354 (0x8c0522). ECEF Z position. The ECEF Z axis originates from the Earth centre, and the positive Z axis intersects the Earth surface at the North Pole. Implementation type is int32
    category=VALUE
    compu {phys=raw*0.01} "The scaling of CAN input signal GPS_Pos_ECEF_Z, frame RT_SB_GPS_Pos_ECEF_2, 9176354 (0x8c0522). Scaling: WorldValue = 0.01*BinaryValue + 0.0 [m]. Unit: The unit m from the network database is mapped to the AUTOSAR unit NoUnit"
    range phys -10000000..10000000 "The range of CAN input signal GPS_Pos_ECEF_Z, frame RT_SB_GPS_Pos_ECEF_2, 9176354 (0x8c0522). Range (world values): -1.0E7 ... 1.0E7 [m]"
  app type cif_0x8c0422_Validity_GPS_Pos_ECEF_X_t:  # The type of CAN input signal Validity_GPS_Pos_ECEF_X, frame RT_SB_GPS_Pos_ECEF_1, 9176098 (0x8c0422). Valid when bit is set, invalid when bit is clear. Implementation type is boolean
    category=VALUE
    compu {phys=raw} "The scaling of CAN input signal Validity_GPS_Pos_ECEF_X, frame RT_SB_GPS_Pos_ECEF_1, 9176098 (0x8c0422). Scaling: WorldValue = BinaryValue []. Unit: The unit "" from the network database is mapped to the AUTOSAR unit NoUnit"
    range phys 0..1 "The range of CAN input signal Validity_GPS_Pos_ECEF_X, frame RT_SB_GPS_Pos_ECEF_1, 9176098 (0x8c0422). Range (world values): 0.0 ... 1.0 []"
  app type cif_0x8c0422_Validity_GPS_Pos_ECEF_Y_t:  # The type of CAN input signal Validity_GPS_Pos_ECEF_Y, frame RT_SB_GPS_Pos_ECEF_1, 9176098 (0x8c0422). Valid when bit is set, invalid when bit is clear. Implementation type is boolean
    category=VALUE
    compu {phys=raw} "The scaling of CAN input signal Validity_GPS_Pos_ECEF_Y, frame RT_SB_GPS_Pos_ECEF_1, 9176098 (0x8c0422). Scaling: WorldValue = BinaryValue []. Unit: The unit "" from the network database is mapped to the AUTOSAR unit NoUnit"
    range phys 0..1 "The range of CAN input signal Validity_GPS_Pos_ECEF_Y, frame RT_SB_GPS_Pos_ECEF_1, 9176098 (0x8c0422). Range (world values): 0.0 ... 1.0 []"
  app type cif_0x8c0422_Validity_GPS_Pos_ECEF_Z_t:  # The type of CAN input signal Validity_GPS_Pos_ECEF_Z, frame RT_SB_GPS_Pos_ECEF_1, 9176098 (0x8c0422). Valid when bit is set, invalid when bit is clear. Implementation type is boolean
    category=VALUE
    compu {phys=raw} "The scaling of CAN input signal Validity_GPS_Pos_ECEF_Z, frame RT_SB_GPS_Pos_ECEF_1, 9176098 (0x8c0422). Scaling: WorldValue = BinaryValue []. Unit: The unit "" from the network database is mapped to the AUTOSAR unit NoUnit"
    range phys 0..1 "The range of CAN input signal Validity_GPS_Pos_ECEF_Z, frame RT_SB_GPS_Pos_ECEF_1, 9176098 (0x8c0422). Range (world values): 0.0 ... 1.0 []"
  app type cif_0x8c0422_Accuracy_GPS_Pos_ECEF_X_t:  # The type of CAN input signal Accuracy_GPS_Pos_ECEF_X, frame RT_SB_GPS_Pos_ECEF_1, 9176098 (0x8c0422). Dimensionless. Lower values imply but do not guarantee better accuracy than higher values. Implementation type is uint8
    category=VALUE
    compu {phys=raw} "The scaling of CAN input signal Accuracy_GPS_Pos_ECEF_X, frame RT_SB_GPS_Pos_ECEF_1, 9176098 (0x8c0422). Scaling: WorldValue = BinaryValue []. Unit: The unit "" from the network database is mapped to the AUTOSAR unit NoUnit"
    range phys 0..255 "The range of CAN input signal Accuracy_GPS_Pos_ECEF_X, frame RT_SB_GPS_Pos_ECEF_1, 9176098 (0x8c0422). Range (world values): 0.0 ... 255.0 []"
  app type cif_0x8c0422_Accuracy_GPS_Pos_ECEF_Y_t:  # The type of CAN input signal Accuracy_GPS_Pos_ECEF_Y, frame RT_SB_GPS_Pos_ECEF_1, 9176098 (0x8c0422). Dimensionless. Lower values imply but do not guarantee better accuracy than higher values. Implementation type is uint8
    category=VALUE
    compu {phys=raw} "The scaling of CAN input signal Accuracy_GPS_Pos_ECEF_Y, frame RT_SB_GPS_Pos_ECEF_1, 9176098 (0x8c0422). Scaling: WorldValue = BinaryValue []. Unit: The unit "" from the network database is mapped to the AUTOSAR unit NoUnit"
    range phys 0..255 "The range of CAN input signal Accuracy_GPS_Pos_ECEF_Y, frame RT_SB_GPS_Pos_ECEF_1, 9176098 (0x8c0422). Range (world values): 0.0 ... 255.0 []"
  app type cif_0x8c0422_Accuracy_GPS_Pos_ECEF_Z_t:  # The type of CAN input signal Accuracy_GPS_Pos_ECEF_Z, frame RT_SB_GPS_Pos_ECEF_1, 9176098 (0x8c0422). Dimensionless. Lower values imply but do not guarantee better accuracy than higher values. Implementation type is uint8
    category=VALUE
    compu {phys=raw} "The scaling of CAN input signal Accuracy_GPS_Pos_ECEF_Z, frame RT_SB_GPS_Pos_ECEF_1, 9176098 (0x8c0422). Scaling: WorldValue = BinaryValue []. Unit: The unit "" from the network database is mapped to the AUTOSAR unit NoUnit"
    range phys 0..255 "The range of CAN input signal Accuracy_GPS_Pos_ECEF_Z, frame RT_SB_GPS_Pos_ECEF_1, 9176098 (0x8c0422). Range (world values): 0.0 ... 255.0 []"
  app type cif_0x8c0422_GPS_Pos_ECEF_X_t:  # The type of CAN input signal GPS_Pos_ECEF_X, frame RT_SB_GPS_Pos_ECEF_1, 9176098 (0x8c0422). ECEF X position. The ECEF X axis originates from the Earth centre, and the positive X axis intersects the Earth surface at zero degrees latittude and zero degrees longitude (the intersection of the equator and the prime meridian). Implementation type is int32
    category=VALUE
    compu {phys=raw*0.01} "The scaling of CAN input signal GPS_Pos_ECEF_X, frame RT_SB_GPS_Pos_ECEF_1, 9176098 (0x8c0422). Scaling: WorldValue = 0.01*BinaryValue + 0.0 [m]. Unit: The unit m from the network database is mapped to the AUTOSAR unit NoUnit"
    range phys -10000000..10000000 "The range of CAN input signal GPS_Pos_ECEF_X, frame RT_SB_GPS_Pos_ECEF_1, 9176098 (0x8c0422). Range (world values): -1.0E7 ... 1.0E7 [m]"
  app type cif_0x8c0322_GPS_Pos_LLH_Longitude_t:  # The type of CAN input signal GPS_Pos_LLH_Longitude, frame RT_SB_GPS_Pos_LLH_2, 9175842 (0x8c0322). Implementation type is int32
    category=VALUE
    compu {phys=raw*1e-07} "The scaling of CAN input signal GPS_Pos_LLH_Longitude, frame RT_SB_GPS_Pos_LLH_2, 9175842 (0x8c0322). Scaling: WorldValue = 1.0E-7*BinaryValue + 0.0 [degrees]. Unit: The unit degrees from the network database is mapped to the AUTOSAR unit NoUnit"
    range phys -180..180 "The range of CAN input signal GPS_Pos_LLH_Longitude, frame RT_SB_GPS_Pos_LLH_2, 9175842 (0x8c0322). Range (world values): -180.0 ... 180.0 [degrees]"
  app type cif_0x8c0322_GPS_Pos_LLH_Altitude_t:  # The type of CAN input signal GPS_Pos_LLH_Altitude, frame RT_SB_GPS_Pos_LLH_2, 9175842 (0x8c0322). Implementation type is int32
    category=VALUE
    compu {phys=raw*0.001} "The scaling of CAN input signal GPS_Pos_LLH_Altitude, frame RT_SB_GPS_Pos_LLH_2, 9175842 (0x8c0322). Scaling: WorldValue = 0.001*BinaryValue + 0.0 [m]. Unit: The unit m from the network database is mapped to the AUTOSAR unit NoUnit"
    range phys -1000..100000 "The range of CAN input signal GPS_Pos_LLH_Altitude, frame RT_SB_GPS_Pos_LLH_2, 9175842 (0x8c0322). Range (world values): -1000.0 ... 100000.0 [m]"
  app type cif_0x8c0222_Validity_GPS_Pos_LLH_Latitude_t:  # The type of CAN input signal Validity_GPS_Pos_LLH_Latitude, frame RT_SB_GPS_Pos_LLH_1, 9175586 (0x8c0222). Valid when bit is set, invalid when bit is clear. Implementation type is boolean
    category=VALUE
    compu {phys=raw} "The scaling of CAN input signal Validity_GPS_Pos_LLH_Latitude, frame RT_SB_GPS_Pos_LLH_1, 9175586 (0x8c0222). Scaling: WorldValue = BinaryValue []. Unit: The unit "" from the network database is mapped to the AUTOSAR unit NoUnit"
    range phys 0..1 "The range of CAN input signal Validity_GPS_Pos_LLH_Latitude, frame RT_SB_GPS_Pos_LLH_1, 9175586 (0x8c0222). Range (world values): 0.0 ... 1.0 []"
  app type cif_0x8c0222_Validity_GPS_Pos_LLH_Longitude_t:  # The type of CAN input signal Validity_GPS_Pos_LLH_Longitude, frame RT_SB_GPS_Pos_LLH_1, 9175586 (0x8c0222). Valid when bit is set, invalid when bit is clear. Implementation type is boolean
    category=VALUE
    compu {phys=raw} "The scaling of CAN input signal Validity_GPS_Pos_LLH_Longitude, frame RT_SB_GPS_Pos_LLH_1, 9175586 (0x8c0222). Scaling: WorldValue = BinaryValue []. Unit: The unit "" from the network database is mapped to the AUTOSAR unit NoUnit"
    range phys 0..1 "The range of CAN input signal Validity_GPS_Pos_LLH_Longitude, frame RT_SB_GPS_Pos_LLH_1, 9175586 (0x8c0222). Range (world values): 0.0 ... 1.0 []"
  app type cif_0x8c0222_Validity_GPS_Pos_LLH_Altitude_t:  # The type of CAN input signal Validity_GPS_Pos_LLH_Altitude, frame RT_SB_GPS_Pos_LLH_1, 9175586 (0x8c0222). Valid when bit is set, invalid when bit is clear. Implementation type is boolean
    category=VALUE
    compu {phys=raw} "The scaling of CAN input signal Validity_GPS_Pos_LLH_Altitude, frame RT_SB_GPS_Pos_LLH_1, 9175586 (0x8c0222). Scaling: WorldValue = BinaryValue []. Unit: The unit "" from the network database is mapped to the AUTOSAR unit NoUnit"
    range phys 0..1 "The range of CAN input signal Validity_GPS_Pos_LLH_Altitude, frame RT_SB_GPS_Pos_LLH_1, 9175586 (0x8c0222). Range (world values): 0.0 ... 1.0 []"
  app type cif_0x8c0222_Accuracy_GPS_Pos_LLH_Latitude_t:  # The type of CAN input signal Accuracy_GPS_Pos_LLH_Latitude, frame RT_SB_GPS_Pos_LLH_1, 9175586 (0x8c0222). This accuracy value applies to both 2D and 3D GPS speed. Implementation type is uint8
    category=VALUE
    compu {phys=raw} "The scaling of CAN input signal Accuracy_GPS_Pos_LLH_Latitude, frame RT_SB_GPS_Pos_LLH_1, 9175586 (0x8c0222). Scaling: WorldValue = BinaryValue []. Unit: The unit "" from the network database is mapped to the AUTOSAR unit NoUnit"
    range phys 0..255 "The range of CAN input signal Accuracy_GPS_Pos_LLH_Latitude, frame RT_SB_GPS_Pos_LLH_1, 9175586 (0x8c0222). Range (world values): 0.0 ... 255.0 []"
  app type cif_0x8c0222_Accuracy_GPS_Pos_LLH_Longitude_t:  # The type of CAN input signal Accuracy_GPS_Pos_LLH_Longitude, frame RT_SB_GPS_Pos_LLH_1, 9175586 (0x8c0222). This accuracy value applies to both 2D and 3D GPS speed. Implementation type is uint8
    category=VALUE
    compu {phys=raw} "The scaling of CAN input signal Accuracy_GPS_Pos_LLH_Longitude, frame RT_SB_GPS_Pos_LLH_1, 9175586 (0x8c0222). Scaling: WorldValue = BinaryValue []. Unit: The unit "" from the network database is mapped to the AUTOSAR unit NoUnit"
    range phys 0..255 "The range of CAN input signal Accuracy_GPS_Pos_LLH_Longitude, frame RT_SB_GPS_Pos_LLH_1, 9175586 (0x8c0222). Range (world values): 0.0 ... 255.0 []"
  app type cif_0x8c0222_Accuracy_GPS_Pos_LLH_Altitude_t:  # The type of CAN input signal Accuracy_GPS_Pos_LLH_Altitude, frame RT_SB_GPS_Pos_LLH_1, 9175586 (0x8c0222). This accuracy value applies to both 2D and 3D GPS speed. Implementation type is uint8
    category=VALUE
    compu {phys=raw} "The scaling of CAN input signal Accuracy_GPS_Pos_LLH_Altitude, frame RT_SB_GPS_Pos_LLH_1, 9175586 (0x8c0222). Scaling: WorldValue = BinaryValue []. Unit: The unit "" from the network database is mapped to the AUTOSAR unit NoUnit"
    range phys 0..255 "The range of CAN input signal Accuracy_GPS_Pos_LLH_Altitude, frame RT_SB_GPS_Pos_LLH_1, 9175586 (0x8c0222). Range (world values): 0.0 ... 255.0 []"
  app type cif_0x8c0222_GPS_Pos_LLH_Latitude_t:  # The type of CAN input signal GPS_Pos_LLH_Latitude, frame RT_SB_GPS_Pos_LLH_1, 9175586 (0x8c0222). Implementation type is int32
    category=VALUE
    compu {phys=raw*1e-07} "The scaling of CAN input signal GPS_Pos_LLH_Latitude, frame RT_SB_GPS_Pos_LLH_1, 9175586 (0x8c0222). Scaling: WorldValue = 1.0E-7*BinaryValue + 0.0 [degrees]. Unit: The unit degrees from the network database is mapped to the AUTOSAR unit NoUnit"
    range phys -90..90 "The range of CAN input signal GPS_Pos_LLH_Latitude, frame RT_SB_GPS_Pos_LLH_1, 9175586 (0x8c0222). Range (world values): -90.0 ... 90.0 [degrees]"
  app type cif_0x8c1522_Validity_GPS_Heading_t:  # The type of CAN input signal Validity_GPS_Heading, frame RT_SB_GPS_Heading_Gradient, 9180450 (0x8c1522). Valid when bit is set, invalid when bit is clear. Implementation type is boolean
    category=VALUE
    compu {phys=raw} "The scaling of CAN input signal Validity_GPS_Heading, frame RT_SB_GPS_Heading_Gradient, 9180450 (0x8c1522). Scaling: WorldValue = BinaryValue []. Unit: The unit "" from the network database is mapped to the AUTOSAR unit NoUnit"
    range phys 0..1 "The range of CAN input signal Validity_GPS_Heading, frame RT_SB_GPS_Heading_Gradient, 9180450 (0x8c1522). Range (world values): 0.0 ... 1.0 []"
  app type cif_0x8c1522_Validity_GPS_Gradient_t:  # The type of CAN input signal Validity_GPS_Gradient, frame RT_SB_GPS_Heading_Gradient, 9180450 (0x8c1522). Valid when bit is set, invalid when bit is clear. Implementation type is boolean
    category=VALUE
    compu {phys=raw} "The scaling of CAN input signal Validity_GPS_Gradient, frame RT_SB_GPS_Heading_Gradient, 9180450 (0x8c1522). Scaling: WorldValue = BinaryValue []. Unit: The unit "" from the network database is mapped to the AUTOSAR unit NoUnit"
    range phys 0..1 "The range of CAN input signal Validity_GPS_Gradient, frame RT_SB_GPS_Heading_Gradient, 9180450 (0x8c1522). Range (world values): 0.0 ... 1.0 []"
  app type cif_0x8c1522_Accuracy_GPS_Heading_t:  # The type of CAN input signal Accuracy_GPS_Heading, frame RT_SB_GPS_Heading_Gradient, 9180450 (0x8c1522). Dimensionless. Lower values imply but do not guarantee better accuracy than higher values. Implementation type is uint8
    category=VALUE
    compu {phys=raw} "The scaling of CAN input signal Accuracy_GPS_Heading, frame RT_SB_GPS_Heading_Gradient, 9180450 (0x8c1522). Scaling: WorldValue = BinaryValue []. Unit: The unit "" from the network database is mapped to the AUTOSAR unit NoUnit"
    range phys 0..255 "The range of CAN input signal Accuracy_GPS_Heading, frame RT_SB_GPS_Heading_Gradient, 9180450 (0x8c1522). Range (world values): 0.0 ... 255.0 []"
  app type cif_0x8c1522_GPS_Heading_t:  # The type of CAN input signal GPS_Heading, frame RT_SB_GPS_Heading_Gradient, 9180450 (0x8c1522). This is GPS heading, the direction that the vehicle is travelling in the local horizontal plane. Implementation type is int16
    category=VALUE
    compu {phys=raw*0.01} "The scaling of CAN input signal GPS_Heading, frame RT_SB_GPS_Heading_Gradient, 9180450 (0x8c1522). Scaling: WorldValue = 0.01*BinaryValue + 0.0 [degrees]. Unit: The unit degrees from the network database is mapped to the AUTOSAR unit NoUnit"
    range phys -180..180 "The range of CAN input signal GPS_Heading, frame RT_SB_GPS_Heading_Gradient, 9180450 (0x8c1522). Range (world values): -180.0 ... 180.0 [degrees]"
  app type cif_0x8c1522_Accuracy_GPS_Gradient_t:  # The type of CAN input signal Accuracy_GPS_Gradient, frame RT_SB_GPS_Heading_Gradient, 9180450 (0x8c1522). Dimensionless. Lower values imply but do not guarantee better accuracy than higher values. Implementation type is uint8
    category=VALUE
    compu {phys=raw} "The scaling of CAN input signal Accuracy_GPS_Gradient, frame RT_SB_GPS_Heading_Gradient, 9180450 (0x8c1522). Scaling: WorldValue = BinaryValue []. Unit: The unit "" from the network database is mapped to the AUTOSAR unit NoUnit"
    range phys 0..255 "The range of CAN input signal Accuracy_GPS_Gradient, frame RT_SB_GPS_Heading_Gradient, 9180450 (0x8c1522). Range (world values): 0.0 ... 255.0 []"
  app type cif_0x8c1522_GPS_Gradient_t:  # The type of CAN input signal GPS_Gradient, frame RT_SB_GPS_Heading_Gradient, 9180450 (0x8c1522). This is GPS gradient, i.e. the vertical direction that the vehicle is travelling, NOT pointing (pitch). Implementation type is int16
    category=VALUE
    compu {phys=raw*0.01} "The scaling of CAN input signal GPS_Gradient, frame RT_SB_GPS_Heading_Gradient, 9180450 (0x8c1522). Scaling: WorldValue = 0.01*BinaryValue + 0.0 [degrees]. Unit: The unit degrees from the network database is mapped to the AUTOSAR unit NoUnit"
    range phys -90..90 "The range of CAN input signal GPS_Gradient, frame RT_SB_GPS_Heading_Gradient, 9180450 (0x8c1522). Range (world values): -90.0 ... 90.0 [degrees]"
  app type cif_0x8c1422_Validity_GPS_Vel_ECEF_Y_t:  # The type of CAN input signal Validity_GPS_Vel_ECEF_Y, frame RT_SB_GPS_Vel_ECEF_2, 9180194 (0x8c1422). Valid when bit is set, invalid when bit is clear. Implementation type is boolean
    category=VALUE
    compu {phys=raw} "The scaling of CAN input signal Validity_GPS_Vel_ECEF_Y, frame RT_SB_GPS_Vel_ECEF_2, 9180194 (0x8c1422). Scaling: WorldValue = BinaryValue []. Unit: The unit "" from the network database is mapped to the AUTOSAR unit NoUnit"
    range phys 0..1 "The range of CAN input signal Validity_GPS_Vel_ECEF_Y, frame RT_SB_GPS_Vel_ECEF_2, 9180194 (0x8c1422). Range (world values): 0.0 ... 1.0 []"
  app type cif_0x8c1422_Validity_GPS_Vel_ECEF_Z_t:  # The type of CAN input signal Validity_GPS_Vel_ECEF_Z, frame RT_SB_GPS_Vel_ECEF_2, 9180194 (0x8c1422). Valid when bit is set, invalid when bit is clear. Implementation type is boolean
    category=VALUE
    compu {phys=raw} "The scaling of CAN input signal Validity_GPS_Vel_ECEF_Z, frame RT_SB_GPS_Vel_ECEF_2, 9180194 (0x8c1422). Scaling: WorldValue = BinaryValue []. Unit: The unit "" from the network database is mapped to the AUTOSAR unit NoUnit"
    range phys 0..1 "The range of CAN input signal Validity_GPS_Vel_ECEF_Z, frame RT_SB_GPS_Vel_ECEF_2, 9180194 (0x8c1422). Range (world values): 0.0 ... 1.0 []"
  app type cif_0x8c1422_GPS_Vel_ECEF_Y_t:  # The type of CAN input signal GPS_Vel_ECEF_Y, frame RT_SB_GPS_Vel_ECEF_2, 9180194 (0x8c1422). ECEF Y velocity. The ECEF Y axis originates from the Earth centre, and the positive Y axis intersects the Earth surface at zero degrees latittude and 90 degrees longitude. Implementation type is int32
    category=VALUE
    compu {phys=raw*0.0001} "The scaling of CAN input signal GPS_Vel_ECEF_Y, frame RT_SB_GPS_Vel_ECEF_2, 9180194 (0x8c1422). Scaling: WorldValue = 1.0E-4*BinaryValue + 0.0 [m/s]. Unit: The unit m/s from the network database is mapped to the AUTOSAR unit NoUnit"
    range phys -838..838 "The range of CAN input signal GPS_Vel_ECEF_Y, frame RT_SB_GPS_Vel_ECEF_2, 9180194 (0x8c1422). Range (world values): -838.0 ... 838.0 [m/s]"
  app type cif_0x8c1422_GPS_Vel_ECEF_Z_t:  # The type of CAN input signal GPS_Vel_ECEF_Z, frame RT_SB_GPS_Vel_ECEF_2, 9180194 (0x8c1422). ECEF Z velocity. The ECEF Z axis originates from the Earth centre, and the positive Z axis intersects the Earth surface at the North Pole. Implementation type is int32
    category=VALUE
    compu {phys=raw*0.0001} "The scaling of CAN input signal GPS_Vel_ECEF_Z, frame RT_SB_GPS_Vel_ECEF_2, 9180194 (0x8c1422). Scaling: WorldValue = 1.0E-4*BinaryValue + 0.0 [m/s]. Unit: The unit m/s from the network database is mapped to the AUTOSAR unit NoUnit"
    range phys -838..838 "The range of CAN input signal GPS_Vel_ECEF_Z, frame RT_SB_GPS_Vel_ECEF_2, 9180194 (0x8c1422). Range (world values): -838.0 ... 838.0 [m/s]"
  app type cif_0x8c1322_Validity_GPS_Vel_ECEF_X_t:  # The type of CAN input signal Validity_GPS_Vel_ECEF_X, frame RT_SB_GPS_Vel_ECEF_1, 9179938 (0x8c1322). Valid when bit is set, invalid when bit is clear. Implementation type is boolean
    category=VALUE
    compu {phys=raw} "The scaling of CAN input signal Validity_GPS_Vel_ECEF_X, frame RT_SB_GPS_Vel_ECEF_1, 9179938 (0x8c1322). Scaling: WorldValue = BinaryValue []. Unit: The unit "" from the network database is mapped to the AUTOSAR unit NoUnit"
    range phys 0..1 "The range of CAN input signal Validity_GPS_Vel_ECEF_X, frame RT_SB_GPS_Vel_ECEF_1, 9179938 (0x8c1322). Range (world values): 0.0 ... 1.0 []"
  app type cif_0x8c1322_Accuracy_GPS_Vel_ECEF_X_t:  # The type of CAN input signal Accuracy_GPS_Vel_ECEF_X, frame RT_SB_GPS_Vel_ECEF_1, 9179938 (0x8c1322). Implementation type is uint8
    category=VALUE
    compu {phys=raw} "The scaling of CAN input signal Accuracy_GPS_Vel_ECEF_X, frame RT_SB_GPS_Vel_ECEF_1, 9179938 (0x8c1322). Scaling: WorldValue = BinaryValue []. Unit: The unit "" from the network database is mapped to the AUTOSAR unit NoUnit"
    range phys 0..255 "The range of CAN input signal Accuracy_GPS_Vel_ECEF_X, frame RT_SB_GPS_Vel_ECEF_1, 9179938 (0x8c1322). Range (world values): 0.0 ... 255.0 []"
  app type cif_0x8c1322_Accuracy_GPS_Vel_ECEF_Y_t:  # The type of CAN input signal Accuracy_GPS_Vel_ECEF_Y, frame RT_SB_GPS_Vel_ECEF_1, 9179938 (0x8c1322). Implementation type is uint8
    category=VALUE
    compu {phys=raw} "The scaling of CAN input signal Accuracy_GPS_Vel_ECEF_Y, frame RT_SB_GPS_Vel_ECEF_1, 9179938 (0x8c1322). Scaling: WorldValue = BinaryValue []. Unit: The unit "" from the network database is mapped to the AUTOSAR unit NoUnit"
    range phys 0..255 "The range of CAN input signal Accuracy_GPS_Vel_ECEF_Y, frame RT_SB_GPS_Vel_ECEF_1, 9179938 (0x8c1322). Range (world values): 0.0 ... 255.0 []"
  app type cif_0x8c1322_Accuracy_GPS_Vel_ECEF_Z_t:  # The type of CAN input signal Accuracy_GPS_Vel_ECEF_Z, frame RT_SB_GPS_Vel_ECEF_1, 9179938 (0x8c1322). Implementation type is uint8
    category=VALUE
    compu {phys=raw} "The scaling of CAN input signal Accuracy_GPS_Vel_ECEF_Z, frame RT_SB_GPS_Vel_ECEF_1, 9179938 (0x8c1322). Scaling: WorldValue = BinaryValue []. Unit: The unit "" from the network database is mapped to the AUTOSAR unit NoUnit"
    range phys 0..255 "The range of CAN input signal Accuracy_GPS_Vel_ECEF_Z, frame RT_SB_GPS_Vel_ECEF_1, 9179938 (0x8c1322). Range (world values): 0.0 ... 255.0 []"
  app type cif_0x8c1322_GPS_Vel_ECEF_X_t:  # The type of CAN input signal GPS_Vel_ECEF_X, frame RT_SB_GPS_Vel_ECEF_1, 9179938 (0x8c1322). ECEF X velocity. The ECEF X axis originates from the Earth centre, and the positive X axis intersects the Earth surface at zero degrees latittude and zero degrees longitude (the intersection of the equator and the prime meridian). Implementation type is int32
    category=VALUE
    compu {phys=raw*0.0001} "The scaling of CAN input signal GPS_Vel_ECEF_X, frame RT_SB_GPS_Vel_ECEF_1, 9179938 (0x8c1322). Scaling: WorldValue = 1.0E-4*BinaryValue + 0.0 [m/s]. Unit: The unit m/s from the network database is mapped to the AUTOSAR unit NoUnit"
    range phys -838..838 "The range of CAN input signal GPS_Vel_ECEF_X, frame RT_SB_GPS_Vel_ECEF_1, 9179938 (0x8c1322). Range (world values): -838.0 ... 838.0 [m/s]"
  app type cif_0x000_Validity_GPS_Vel_NED_D_t: category=VALUE, compu {phys=raw} "The scaling of CAN input signal Validity_GPS_Vel_NED_D, frame RT_SB_GPS_Vel_NED_2, 0 (0x000). Scaling: WorldValue = BinaryValue []. Unit: The unit "" from the network database is mapped to the AUTOSAR unit NoUnit", range phys 0..1 "The range of CAN input signal Validity_GPS_Vel_NED_D, frame RT_SB_GPS_Vel_NED_2, 0 (0x000). Range (world values): 0.0 ... 1.0 []"  # The type of CAN input signal Validity_GPS_Vel_NED_D, frame RT_SB_GPS_Vel_NED_2, 0 (0x000). Valid when bit is set, invalid when bit is clear. Implementation type is boolean
  app type cif_0x000_Accuracy_GPS_Vel_D_t: category=VALUE, compu {phys=raw} "The scaling of CAN input signal Accuracy_GPS_Vel_D, frame RT_SB_GPS_Vel_NED_2, 0 (0x000). Scaling: WorldValue = BinaryValue []. Unit: The unit "" from the network database is mapped to the AUTOSAR unit NoUnit", range phys 0..255 "The range of CAN input signal Accuracy_GPS_Vel_D, frame RT_SB_GPS_Vel_NED_2, 0 (0x000). Range (world values): 0.0 ... 255.0 []"  # The type of CAN input signal Accuracy_GPS_Vel_D, frame RT_SB_GPS_Vel_NED_2, 0 (0x000). Implementation type is uint8
  app type cif_0x000_GPS_Vel_NED_D_t:  # The type of CAN input signal GPS_Vel_NED_D, frame RT_SB_GPS_Vel_NED_2, 0 (0x000). VELNED D velocity. This is the velocity vector directly downwards towards the Earth centre at the current local Earth surface position. Implementation type is int32
    category=VALUE
    compu {phys=raw*0.0001} "The scaling of CAN input signal GPS_Vel_NED_D, frame RT_SB_GPS_Vel_NED_2, 0 (0x000). Scaling: WorldValue = 1.0E-4*BinaryValue + 0.0 [m/s]. Unit: The unit m/s from the network database is mapped to the AUTOSAR unit NoUnit"
    range phys -838..838 "The range of CAN input signal GPS_Vel_NED_D, frame RT_SB_GPS_Vel_NED_2, 0 (0x000). Range (world values): -838.0 ... 838.0 [m/s]"
  app type cif_0x1fffffff_Validity_GPS_Vel_NED_N_t:  # The type of CAN input signal Validity_GPS_Vel_NED_N, frame RT_SB_GPS_Vel_NED_1, 536870911 (0x1fffffff). Valid when bit is set, invalid when bit is clear. Implementation type is boolean
    category=VALUE
    compu {phys=raw} "The scaling of CAN input signal Validity_GPS_Vel_NED_N, frame RT_SB_GPS_Vel_NED_1, 536870911 (0x1fffffff). Scaling: WorldValue = BinaryValue []. Unit: The unit "" from the network database is mapped to the AUTOSAR unit NoUnit"
    range phys 0..1 "The range of CAN input signal Validity_GPS_Vel_NED_N, frame RT_SB_GPS_Vel_NED_1, 536870911 (0x1fffffff). Range (world values): 0.0 ... 1.0 []"
  app type cif_0x1fffffff_Validity_GPS_Vel_NED_E_t:  # The type of CAN input signal Validity_GPS_Vel_NED_E, frame RT_SB_GPS_Vel_NED_1, 536870911 (0x1fffffff). Valid when bit is set, invalid when bit is clear. Implementation type is boolean
    category=VALUE
    compu {phys=raw} "The scaling of CAN input signal Validity_GPS_Vel_NED_E, frame RT_SB_GPS_Vel_NED_1, 536870911 (0x1fffffff). Scaling: WorldValue = BinaryValue []. Unit: The unit "" from the network database is mapped to the AUTOSAR unit NoUnit"
    range phys 0..1 "The range of CAN input signal Validity_GPS_Vel_NED_E, frame RT_SB_GPS_Vel_NED_1, 536870911 (0x1fffffff). Range (world values): 0.0 ... 1.0 []"
  app type cif_0x1fffffff_Accuracy_GPS_Vel_NE_t:  # The type of CAN input signal Accuracy_GPS_Vel_NE, frame RT_SB_GPS_Vel_NED_1, 536870911 (0x1fffffff). Implementation type is uint8
    category=VALUE
    compu {phys=raw} "The scaling of CAN input signal Accuracy_GPS_Vel_NE, frame RT_SB_GPS_Vel_NED_1, 536870911 (0x1fffffff). Scaling: WorldValue = BinaryValue []. Unit: The unit "" from the network database is mapped to the AUTOSAR unit NoUnit"
    range phys 0..255 "The range of CAN input signal Accuracy_GPS_Vel_NE, frame RT_SB_GPS_Vel_NED_1, 536870911 (0x1fffffff). Range (world values): 0.0 ... 255.0 []"
  app type cif_0x1fffffff_GPS_Vel_NED_N_t:  # The type of CAN input signal GPS_Vel_NED_N, frame RT_SB_GPS_Vel_NED_1, 536870911 (0x1fffffff). VELNED N velocity. This is the velocity vector directly North at the current local Earth surface position. Implementation type is int32
    category=VALUE
    compu {phys=raw*0.0001} "The scaling of CAN input signal GPS_Vel_NED_N, frame RT_SB_GPS_Vel_NED_1, 536870911 (0x1fffffff). Scaling: WorldValue = 1.0E-4*BinaryValue + 0.0 [m/s]. Unit: The unit m/s from the network database is mapped to the AUTOSAR unit NoUnit"
    range phys -838..838 "The range of CAN input signal GPS_Vel_NED_N, frame RT_SB_GPS_Vel_NED_1, 536870911 (0x1fffffff). Range (world values): -838.0 ... 838.0 [m/s]"
  app type cif_0x1fffffff_GPS_Vel_NED_E_t:  # The type of CAN input signal GPS_Vel_NED_E, frame RT_SB_GPS_Vel_NED_1, 536870911 (0x1fffffff). VELNED E velocity. This is the velocity vector directly East at the current local Earth surface position. Implementation type is int32
    category=VALUE
    compu {phys=raw*0.0001} "The scaling of CAN input signal GPS_Vel_NED_E, frame RT_SB_GPS_Vel_NED_1, 536870911 (0x1fffffff). Scaling: WorldValue = 1.0E-4*BinaryValue + 0.0 [m/s]. Unit: The unit m/s from the network database is mapped to the AUTOSAR unit NoUnit"
    range phys -838..838 "The range of CAN input signal GPS_Vel_NED_E, frame RT_SB_GPS_Vel_NED_1, 536870911 (0x1fffffff). Range (world values): -838.0 ... 838.0 [m/s]"
  app type cif_0x71a_Validity_GPS_Speed_2D_t: category=VALUE, compu {phys=raw} "The scaling of CAN input signal Validity_GPS_Speed_2D, frame RT_SB_GPS_Speed, 1818 (0x71a). Scaling: WorldValue = BinaryValue []. Unit: The unit "" from the network database is mapped to the AUTOSAR unit NoUnit", range phys 0..1 "The range of CAN input signal Validity_GPS_Speed_2D, frame RT_SB_GPS_Speed, 1818 (0x71a). Range (world values): 0.0 ... 1.0 []"  # The type of CAN input signal Validity_GPS_Speed_2D, frame RT_SB_GPS_Speed, 1818 (0x71a). Valid when bit is set, invalid when bit is clear. Implementation type is boolean
  app type cif_0x71a_Validity_GPS_Speed_3D_t: category=VALUE, compu {phys=raw} "The scaling of CAN input signal Validity_GPS_Speed_3D, frame RT_SB_GPS_Speed, 1818 (0x71a). Scaling: WorldValue = BinaryValue []. Unit: The unit "" from the network database is mapped to the AUTOSAR unit NoUnit", range phys 0..1 "The range of CAN input signal Validity_GPS_Speed_3D, frame RT_SB_GPS_Speed, 1818 (0x71a). Range (world values): 0.0 ... 1.0 []"  # The type of CAN input signal Validity_GPS_Speed_3D, frame RT_SB_GPS_Speed, 1818 (0x71a). Valid when bit is set, invalid when bit is clear. Implementation type is boolean
  app type cif_0x71a_Accuracy_GPS_Speed_t: category=VALUE, compu {phys=raw} "The scaling of CAN input signal Accuracy_GPS_Speed, frame RT_SB_GPS_Speed, 1818 (0x71a). Scaling: WorldValue = BinaryValue []. Unit: The unit "" from the network database is mapped to the AUTOSAR unit NoUnit", range phys 0..255 "The range of CAN input signal Accuracy_GPS_Speed, frame RT_SB_GPS_Speed, 1818 (0x71a). Range (world values): 0.0 ... 255.0 []"  # The type of CAN input signal Accuracy_GPS_Speed, frame RT_SB_GPS_Speed, 1818 (0x71a). This accuracy value applies to both 2D and 3D GPS speed. Implementation type is uint8
  app type cif_0x71a_GPS_Speed_2D_t:  # The type of CAN input signal GPS_Speed_2D, frame RT_SB_GPS_Speed, 1818 (0x71a). This is GPS scalar 2D speed - scalar speed with no local Z axis component included. Implementation type is uint32
    category=VALUE
    compu {phys=raw*0.0001} "The scaling of CAN input signal GPS_Speed_2D, frame RT_SB_GPS_Speed, 1818 (0x71a). Scaling: WorldValue = 1.0E-4*BinaryValue + 0.0 [m/s]. Unit: The unit m/s from the network database is mapped to the AUTOSAR unit NoUnit"
    range phys 0..1675 "The range of CAN input signal GPS_Speed_2D, frame RT_SB_GPS_Speed, 1818 (0x71a). Range (world values): 0.0 ... 1675.0 [m/s]"
  app type cif_0x71a_GPS_Speed_3D_t:  # The type of CAN input signal GPS_Speed_3D, frame RT_SB_GPS_Speed, 1818 (0x71a). This is GPS scalar 3D speed - scalar speed with the local Z axis component included. Implementation type is uint32
    category=VALUE
    compu {phys=raw*0.0001} "The scaling of CAN input signal GPS_Speed_3D, frame RT_SB_GPS_Speed, 1818 (0x71a). Scaling: WorldValue = 1.0E-4*BinaryValue + 0.0 [m/s]. Unit: The unit m/s from the network database is mapped to the AUTOSAR unit NoUnit"
    range phys 0..1675 "The range of CAN input signal GPS_Speed_3D, frame RT_SB_GPS_Speed, 1818 (0x71a). Range (world values): 0.0 ... 1675.0 [m/s]"
  app type cif_0x7ff_Validity_GPS_Time_t: category=VALUE, compu {phys=raw} "The scaling of CAN input signal Validity_GPS_Time, frame RT_SB_GPS_Time, 2047 (0x7ff). Scaling: WorldValue = BinaryValue []. Unit: The unit "" from the network database is mapped to the AUTOSAR unit NoUnit", range phys 0..1 "The range of CAN input signal Validity_GPS_Time, frame RT_SB_GPS_Time, 2047 (0x7ff). Range (world values): 0.0 ... 1.0 []"  # The type of CAN input signal Validity_GPS_Time, frame RT_SB_GPS_Time, 2047 (0x7ff). Valid when bit is set, invalid when bit is clear. Implementation type is boolean
  app type cif_0x7ff_Validity_GPS_Week_t: category=VALUE, compu {phys=raw} "The scaling of CAN input signal Validity_GPS_Week, frame RT_SB_GPS_Time, 2047 (0x7ff). Scaling: WorldValue = BinaryValue []. Unit: The unit "" from the network database is mapped to the AUTOSAR unit NoUnit", range phys 0..1 "The range of CAN input signal Validity_GPS_Week, frame RT_SB_GPS_Time, 2047 (0x7ff). Range (world values): 0.0 ... 1.0 []"  # The type of CAN input signal Validity_GPS_Week, frame RT_SB_GPS_Time, 2047 (0x7ff). Valid when bit is set, invalid when bit is clear. Implementation type is boolean
  app type cif_0x7ff_Accuracy_GPS_Time_t: category=VALUE, compu {phys=raw} "The scaling of CAN input signal Accuracy_GPS_Time, frame RT_SB_GPS_Time, 2047 (0x7ff). Scaling: WorldValue = BinaryValue []. Unit: The unit "" from the network database is mapped to the AUTOSAR unit NoUnit", range phys 0..255 "The range of CAN input signal Accuracy_GPS_Time, frame RT_SB_GPS_Time, 2047 (0x7ff). Range (world values): 0.0 ... 255.0 []"  # The type of CAN input signal Accuracy_GPS_Time, frame RT_SB_GPS_Time, 2047 (0x7ff). Implementation type is uint8
  app type cif_0x7ff_GPS_Time_t: category=VALUE, compu {phys=raw*0.001; unit s} "The scaling of CAN input signal GPS_Time, frame RT_SB_GPS_Time, 2047 (0x7ff). Scaling: WorldValue = 0.001*BinaryValue + 0.0 [s]. Unit: The unit s from the network database is mapped to the AUTOSAR unit Sec", range phys 0..604800 "The range of CAN input signal GPS_Time, frame RT_SB_GPS_Time, 2047 (0x7ff). Range (world values): 0.0 ... 604800.0 [s]"  # The type of CAN input signal GPS_Time, frame RT_SB_GPS_Time, 2047 (0x7ff). GPS time is the time in seconds since midnight GMT on Saturday night. Implementation type is uint32
  app type cif_0x7ff_GPS_Week_t: category=VALUE, compu {phys=raw} "The scaling of CAN input signal GPS_Week, frame RT_SB_GPS_Time, 2047 (0x7ff). Scaling: WorldValue = BinaryValue []. Unit: The unit "" from the network database is mapped to the AUTOSAR unit NoUnit", range phys 0..65535 "The range of CAN input signal GPS_Week, frame RT_SB_GPS_Time, 2047 (0x7ff). Range (world values): 0.0 ... 65535.0 []"  # The type of CAN input signal GPS_Week, frame RT_SB_GPS_Time, 2047 (0x7ff). Implementation type is uint16
  app type cif_0x122_Validity_Accel_Longitudinal_t: category=VALUE, compu {phys=raw} "The scaling of CAN input signal Validity_Accel_Longitudinal, frame RT_SB_Accel, 290 (0x122). Scaling: WorldValue = BinaryValue []. Unit: The unit "" from the network database is mapped to the AUTOSAR unit NoUnit", range phys 0..1 "The range of CAN input signal Validity_Accel_Longitudinal, frame RT_SB_Accel, 290 (0x122). Range (world values): 0.0 ... 1.0 []"  # The type of CAN input signal Validity_Accel_Longitudinal, frame RT_SB_Accel, 290 (0x122). Valid when bit is set, invalid when bit is clear. Implementation type is boolean
  app type cif_0x122_Validity_Accel_Lateral_t: category=VALUE, compu {phys=raw} "The scaling of CAN input signal Validity_Accel_Lateral, frame RT_SB_Accel, 290 (0x122). Scaling: WorldValue = BinaryValue []. Unit: The unit "" from the network database is mapped to the AUTOSAR unit NoUnit", range phys 0..1 "The range of CAN input signal Validity_Accel_Lateral, frame RT_SB_Accel, 290 (0x122). Range (world values): 0.0 ... 1.0 []"  # The type of CAN input signal Validity_Accel_Lateral, frame RT_SB_Accel, 290 (0x122). Valid when bit is set, invalid when bit is clear. Implementation type is boolean
  app type cif_0x122_Validity_Accel_Vertical_t: category=VALUE, compu {phys=raw} "The scaling of CAN input signal Validity_Accel_Vertical, frame RT_SB_Accel, 290 (0x122). Scaling: WorldValue = BinaryValue []. Unit: The unit "" from the network database is mapped to the AUTOSAR unit NoUnit", range phys 0..1 "The range of CAN input signal Validity_Accel_Vertical, frame RT_SB_Accel, 290 (0x122). Range (world values): 0.0 ... 1.0 []"  # The type of CAN input signal Validity_Accel_Vertical, frame RT_SB_Accel, 290 (0x122). Valid when bit is set, invalid when bit is clear. Implementation type is boolean
  app type cif_0x122_Accuracy_Accel_t: category=VALUE, compu {phys=raw} "The scaling of CAN input signal Accuracy_Accel, frame RT_SB_Accel, 290 (0x122). Scaling: WorldValue = BinaryValue []. Unit: The unit "" from the network database is mapped to the AUTOSAR unit NoUnit", range phys 0..255 "The range of CAN input signal Accuracy_Accel, frame RT_SB_Accel, 290 (0x122). Range (world values): 0.0 ... 255.0 []"  # The type of CAN input signal Accuracy_Accel, frame RT_SB_Accel, 290 (0x122). Dimensionless. Lower values imply but do not guarantee better accuracy than higher values. Implementation type is uint8
  app type cif_0x122_Accel_Longitudinal_t: category=VALUE, compu {phys=raw*0.001} "The scaling of CAN input signal Accel_Longitudinal, frame RT_SB_Accel, 290 (0x122). Scaling: WorldValue = 0.001*BinaryValue + 0.0 [g]. Unit: The unit g from the network database is mapped to the AUTOSAR unit NoUnit", range phys -65..65 "The range of CAN input signal Accel_Longitudinal, frame RT_SB_Accel, 290 (0x122). Range (world values): -65.0 ... 65.0 [g]"  # The type of CAN input signal Accel_Longitudinal, frame RT_SB_Accel, 290 (0x122). Longitudinal acceleration. This is positive when the vehicle accelerates in a forwards direction. Implementation type is int16
  app type cif_0x122_Accel_Lateral_t: category=VALUE, compu {phys=raw*0.001} "The scaling of CAN input signal Accel_Lateral, frame RT_SB_Accel, 290 (0x122). Scaling: WorldValue = 0.001*BinaryValue + 0.0 [g]. Unit: The unit g from the network database is mapped to the AUTOSAR unit NoUnit", range phys -65..65 "The range of CAN input signal Accel_Lateral, frame RT_SB_Accel, 290 (0x122). Range (world values): -65.0 ... 65.0 [g]"  # The type of CAN input signal Accel_Lateral, frame RT_SB_Accel, 290 (0x122). Lateral acceleration. This is positive when the vehicle accelerates towards the right, e.g. when cornering around a right-hand bend. Implementation type is int16
  app type cif_0x122_Accel_Vertical_t: category=VALUE, compu {phys=raw*0.001} "The scaling of CAN input signal Accel_Vertical, frame RT_SB_Accel, 290 (0x122). Scaling: WorldValue = 0.001*BinaryValue + 0.0 [g]. Unit: The unit g from the network database is mapped to the AUTOSAR unit NoUnit", range phys -65..65 "The range of CAN input signal Accel_Vertical, frame RT_SB_Accel, 290 (0x122). Range (world values): -65.0 ... 65.0 [g]"  # The type of CAN input signal Accel_Vertical, frame RT_SB_Accel, 290 (0x122). Vertical acceleration. This is positive when the vehicle accelerates in an upwards direction, e.g. when travelling through a dip. Implementation type is int16
  app type cif_0x800122_Validity_Gyro_Rate_Yaw_t:  # The type of CAN input signal Validity_Gyro_Rate_Yaw, frame RT_SB_Gyro_Rates, 8388898 (0x800122). Valid when bit is set, invalid when bit is clear. Implementation type is boolean
    category=VALUE
    compu {phys=raw} "The scaling of CAN input signal Validity_Gyro_Rate_Yaw, frame RT_SB_Gyro_Rates, 8388898 (0x800122). Scaling: WorldValue = BinaryValue []. Unit: The unit "" from the network database is mapped to the AUTOSAR unit NoUnit"
    range phys 0..1 "The range of CAN input signal Validity_Gyro_Rate_Yaw, frame RT_SB_Gyro_Rates, 8388898 (0x800122). Range (world values): 0.0 ... 1.0 []"
  app type cif_0x800122_Validity_Gyro_Rate_Pitch_t:  # The type of CAN input signal Validity_Gyro_Rate_Pitch, frame RT_SB_Gyro_Rates, 8388898 (0x800122). Valid when bit is set, invalid when bit is clear. Implementation type is boolean
    category=VALUE
    compu {phys=raw} "The scaling of CAN input signal Validity_Gyro_Rate_Pitch, frame RT_SB_Gyro_Rates, 8388898 (0x800122). Scaling: WorldValue = BinaryValue []. Unit: The unit "" from the network database is mapped to the AUTOSAR unit NoUnit"
    range phys 0..1 "The range of CAN input signal Validity_Gyro_Rate_Pitch, frame RT_SB_Gyro_Rates, 8388898 (0x800122). Range (world values): 0.0 ... 1.0 []"
  app type cif_0x800122_Validity_Gyro_Rate_Roll_t:  # The type of CAN input signal Validity_Gyro_Rate_Roll, frame RT_SB_Gyro_Rates, 8388898 (0x800122). Valid when bit is set, invalid when bit is clear. Implementation type is boolean
    category=VALUE
    compu {phys=raw} "The scaling of CAN input signal Validity_Gyro_Rate_Roll, frame RT_SB_Gyro_Rates, 8388898 (0x800122). Scaling: WorldValue = BinaryValue []. Unit: The unit "" from the network database is mapped to the AUTOSAR unit NoUnit"
    range phys 0..1 "The range of CAN input signal Validity_Gyro_Rate_Roll, frame RT_SB_Gyro_Rates, 8388898 (0x800122). Range (world values): 0.0 ... 1.0 []"
  app type cif_0x800122_Accuracy_Gyro_Rates_t: category=VALUE, compu {phys=raw} "The scaling of CAN input signal Accuracy_Gyro_Rates, frame RT_SB_Gyro_Rates, 8388898 (0x800122). Scaling: WorldValue = BinaryValue []. Unit: The unit "" from the network database is mapped to the AUTOSAR unit NoUnit", range phys 0 "The range of CAN input signal Accuracy_Gyro_Rates, frame RT_SB_Gyro_Rates, 8388898 (0x800122). Range (world values): 0.0 ... 0.0 []"  # The type of CAN input signal Accuracy_Gyro_Rates, frame RT_SB_Gyro_Rates, 8388898 (0x800122). Dimensionless. Lower values imply but do not guarantee better accuracy than higher values. Implementation type is uint8
  app type cif_0x800122_Gyro_Rate_Yaw_t:  # The type of CAN input signal Gyro_Rate_Yaw, frame RT_SB_Gyro_Rates, 8388898 (0x800122). Yaw rate is positive for clockwise rotation when looking down on the vehicle from above. Implementation type is int16
    category=VALUE
    compu {phys=raw*0.01} "The scaling of CAN input signal Gyro_Rate_Yaw, frame RT_SB_Gyro_Rates, 8388898 (0x800122). Scaling: WorldValue = 0.01*BinaryValue + 0.0 [degrees/s]. Unit: The unit degrees/s from the network database is mapped to the AUTOSAR unit NoUnit"
    range phys -327..327 "The range of CAN input signal Gyro_Rate_Yaw, frame RT_SB_Gyro_Rates, 8388898 (0x800122). Range (world values): -327.0 ... 327.0 [degrees/s]"
  app type cif_0x800122_Gyro_Rate_Pitch_t:  # The type of CAN input signal Gyro_Rate_Pitch, frame RT_SB_Gyro_Rates, 8388898 (0x800122). Pitch rate is positive for clockwise rotation when looking at the left hand side of the vehicle from the left of the vehicle. Implementation type is int16
    category=VALUE
    compu {phys=raw*0.01} "The scaling of CAN input signal Gyro_Rate_Pitch, frame RT_SB_Gyro_Rates, 8388898 (0x800122). Scaling: WorldValue = 0.01*BinaryValue + 0.0 [degrees/s]. Unit: The unit degrees/s from the network database is mapped to the AUTOSAR unit NoUnit"
    range phys -327..327 "The range of CAN input signal Gyro_Rate_Pitch, frame RT_SB_Gyro_Rates, 8388898 (0x800122). Range (world values): -327.0 ... 327.0 [degrees/s]"
  app type cif_0x800122_Gyro_Rate_Roll_t:  # The type of CAN input signal Gyro_Rate_Roll, frame RT_SB_Gyro_Rates, 8388898 (0x800122). Roll rate is positive for clockwise rotation when looking at the rear of the vehicle from behind the vehicle. Implementation type is int16
    category=VALUE
    compu {phys=raw*0.01} "The scaling of CAN input signal Gyro_Rate_Roll, frame RT_SB_Gyro_Rates, 8388898 (0x800122). Scaling: WorldValue = 0.01*BinaryValue + 0.0 [degrees/s]. Unit: The unit degrees/s from the network database is mapped to the AUTOSAR unit NoUnit"
    range phys -327..327 "The range of CAN input signal Gyro_Rate_Roll, frame RT_SB_Gyro_Rates, 8388898 (0x800122). Range (world values): -327.0 ... 327.0 [degrees/s]"
