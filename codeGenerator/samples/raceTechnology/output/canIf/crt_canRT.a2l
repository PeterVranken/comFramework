/begin PROJECT MERGED_PROJECT "CAN interface of cluster raceCar"
/begin HEADER "This is an A2L fragment which has to be merged into the main project" VERSION "22.11.2024 20:51:21" /end HEADER
/begin MODULE MERGED_MODULE "CAN interface of cluster raceCar"
/* Measurement point for signal Byte4_Bits67 of frame RT_SB_INS_Vel_Body_Axes (215, 0x0D7) */
/begin MEASUREMENT crt_PT_0d7_Byte4_Bits67 "signal Byte4_Bits67 of frame RT_SB_INS_Vel_Body_Axes (215, 0x0D7)" UBYTE CONV_crt_PT_0d7_Byte4_Bits67 0 0 1 3 ECU_ADDRESS 0x0000 /end MEASUREMENT
/begin COMPU_METHOD CONV_crt_PT_0d7_Byte4_Bits67 "Identity, real-world value is same as binary value" IDENTICAL "%4" "Mpx selection" /end COMPU_METHOD
/* Measurement point for signal Accuracy_INS_Vel_Body_org of frame RT_SB_INS_Vel_Body_Axes (215, 0x0D7) */
/begin MEASUREMENT crt_PT_0d7_Accuracy_INS_Vel_Body_org_m1 "signal Accuracy_INS_Vel_Body_org of frame RT_SB_INS_Vel_Body_Axes (215, 0x0D7)" UBYTE CONV_crt_PT_0d7_Accuracy_INS_Vel_Body_org_m1 0 0 0 255 ECU_ADDRESS 0x0000 /end MEASUREMENT
/begin COMPU_METHOD CONV_crt_PT_0d7_Accuracy_INS_Vel_Body_org_m1 "Identity, real-world value is same as binary value" IDENTICAL "%4" "" /end COMPU_METHOD
/* Measurement point for signal INS_Vel_Forwards_2D_org of frame RT_SB_INS_Vel_Body_Axes (215, 0x0D7) */
/begin MEASUREMENT crt_PT_0d7_INS_Vel_Forwards_2D_org_m1 "signal INS_Vel_Forwards_2D_org of frame RT_SB_INS_Vel_Body_Axes (215, 0x0D7)" SLONG CONV_crt_PT_0d7_INS_Vel_Forwards_2D_org_m1 0 0 -838.0 838.0 ECU_ADDRESS 0x0000 /end MEASUREMENT
/begin COMPU_METHOD CONV_crt_PT_0d7_INS_Vel_Forwards_2D_org_m1 "Linear scaling, used for variable crt_PT_0d7_INS_Vel_Forwards_2D_org_m1, signal INS_Vel_Forwards_2D_org" RAT_FUNC "%12" "m/s" COEFFS 0 -1 0.0 0 0 -1.0E-4 /end COMPU_METHOD
/* Measurement point for signal Accuracy_INS_Vel_Body_no2 of frame RT_SB_INS_Vel_Body_Axes (215, 0x0D7) */
/begin MEASUREMENT crt_PT_0d7_Accuracy_INS_Vel_Body_no2_m2 "signal Accuracy_INS_Vel_Body_no2 of frame RT_SB_INS_Vel_Body_Axes (215, 0x0D7)" UBYTE CONV_crt_PT_0d7_Accuracy_INS_Vel_Body_no2_m2 0 0 0 255 ECU_ADDRESS 0x0000 /end MEASUREMENT
/begin COMPU_METHOD CONV_crt_PT_0d7_Accuracy_INS_Vel_Body_no2_m2 "Identity, real-world value is same as binary value" IDENTICAL "%4" "" /end COMPU_METHOD
/* Measurement point for signal INS_Vel_Forwards_2D_no2 of frame RT_SB_INS_Vel_Body_Axes (215, 0x0D7) */
/begin MEASUREMENT crt_PT_0d7_INS_Vel_Forwards_2D_no2_m2 "signal INS_Vel_Forwards_2D_no2 of frame RT_SB_INS_Vel_Body_Axes (215, 0x0D7)" SLONG CONV_crt_PT_0d7_INS_Vel_Forwards_2D_no2_m2 0 0 -104.0 104.0 ECU_ADDRESS 0x0000 /end MEASUREMENT
/begin COMPU_METHOD CONV_crt_PT_0d7_INS_Vel_Forwards_2D_no2_m2 "Linear scaling, used for variable crt_PT_0d7_INS_Vel_Forwards_2D_no2_m2, signal INS_Vel_Forwards_2D_no2" RAT_FUNC "%12" "m/s" COEFFS 0 -1 0.0 0 0 -1.0E-4 /end COMPU_METHOD
/* Measurement point for signal Accuracy_INS_Vel_Body_no3 of frame RT_SB_INS_Vel_Body_Axes (215, 0x0D7) */
/begin MEASUREMENT crt_PT_0d7_Accuracy_INS_Vel_Body_no3_m3 "signal Accuracy_INS_Vel_Body_no3 of frame RT_SB_INS_Vel_Body_Axes (215, 0x0D7)" UWORD CONV_crt_PT_0d7_Accuracy_INS_Vel_Body_no3_m3 0 0 0.0 32.768 ECU_ADDRESS 0x0000 /end MEASUREMENT
/begin COMPU_METHOD CONV_crt_PT_0d7_Accuracy_INS_Vel_Body_no3_m3 "Linear scaling, used for variable crt_PT_0d7_Accuracy_INS_Vel_Body_no3_m3, signal Accuracy_INS_Vel_Body_no3" RAT_FUNC "%6" "" COEFFS 0 -1 0.0 0 0 -0.001 /end COMPU_METHOD
/* Measurement point for signal INS_Vel_Forwards_2D_no3 of frame RT_SB_INS_Vel_Body_Axes (215, 0x0D7) */
/begin MEASUREMENT crt_PT_0d7_INS_Vel_Forwards_2D_no3_m3 "signal INS_Vel_Forwards_2D_no3 of frame RT_SB_INS_Vel_Body_Axes (215, 0x0D7)" SWORD CONV_crt_PT_0d7_INS_Vel_Forwards_2D_no3_m3 0 0 -81.92 81.91 ECU_ADDRESS 0x0000 /end MEASUREMENT
/begin COMPU_METHOD CONV_crt_PT_0d7_INS_Vel_Forwards_2D_no3_m3 "Linear scaling, used for variable crt_PT_0d7_INS_Vel_Forwards_2D_no3_m3, signal INS_Vel_Forwards_2D_no3" RAT_FUNC "%6" "m/s" COEFFS 0 -1 0.0 0 0 -0.01 /end COMPU_METHOD
/* Measurement point for signal Validity_Accel_Longitudinal of frame RT_DL1MK3_Accel (8388644x, 0x800024x) */
/begin MEASUREMENT crt_PT_800024_Validity_Accel_Longitudinal "signal Validity_Accel_Longitudinal of frame RT_DL1MK3_Accel (8388644x, 0x800024x). Valid when bit is set, invalid when bit is clear." UBYTE CONV_crt_PT_800024_Validity_Accel_Longitudinal 0 0 0 1 ECU_ADDRESS 0x0000 /end MEASUREMENT
/begin COMPU_METHOD CONV_crt_PT_800024_Validity_Accel_Longitudinal "Identity, real-world value is same as binary value" IDENTICAL "%1" "" /end COMPU_METHOD
/* Measurement point for signal Validity_Accel_Lateral of frame RT_DL1MK3_Accel (8388644x, 0x800024x) */
/begin MEASUREMENT crt_PT_800024_Validity_Accel_Lateral "signal Validity_Accel_Lateral of frame RT_DL1MK3_Accel (8388644x, 0x800024x). Valid when bit is set, invalid when bit is clear." UBYTE CONV_crt_PT_800024_Validity_Accel_Lateral 0 0 0 1 ECU_ADDRESS 0x0000 /end MEASUREMENT
/begin COMPU_METHOD CONV_crt_PT_800024_Validity_Accel_Lateral "Identity, real-world value is same as binary value" IDENTICAL "%1" "" /end COMPU_METHOD
/* Measurement point for signal Validity_Accel_Vertical of frame RT_DL1MK3_Accel (8388644x, 0x800024x) */
/begin MEASUREMENT crt_PT_800024_Validity_Accel_Vertical "signal Validity_Accel_Vertical of frame RT_DL1MK3_Accel (8388644x, 0x800024x). Valid when bit is set, invalid when bit is clear." UBYTE CONV_crt_PT_800024_Validity_Accel_Vertical 0 0 0 1 ECU_ADDRESS 0x0000 /end MEASUREMENT
/begin COMPU_METHOD CONV_crt_PT_800024_Validity_Accel_Vertical "Identity, real-world value is same as binary value" IDENTICAL "%1" "" /end COMPU_METHOD
/* Measurement point for signal SQC of frame RT_DL1MK3_Accel (8388644x, 0x800024x) */
/begin MEASUREMENT crt_PT_800024_SQC "signal SQC of frame RT_DL1MK3_Accel (8388644x, 0x800024x). Sequence counter" UBYTE CONV_crt_PT_800024_SQC 0 0 0 14 ECU_ADDRESS 0x0000 /end MEASUREMENT
/begin COMPU_METHOD CONV_crt_PT_800024_SQC "Identity, real-world value is same as binary value" IDENTICAL "%4" "" /end COMPU_METHOD
/* Measurement point for signal Accuracy_Accel of frame RT_DL1MK3_Accel (8388644x, 0x800024x) */
/begin MEASUREMENT crt_PT_800024_Accuracy_Accel "signal Accuracy_Accel of frame RT_DL1MK3_Accel (8388644x, 0x800024x). Dimensionless.  Lower values imply but do not guarantee better accuracy than higher values." UBYTE CONV_crt_PT_800024_Accuracy_Accel 0 0 0 255 ECU_ADDRESS 0x0000 /end MEASUREMENT
/begin COMPU_METHOD CONV_crt_PT_800024_Accuracy_Accel "Identity, real-world value is same as binary value" IDENTICAL "%4" "" /end COMPU_METHOD
/* Measurement point for signal Accel_Longitudinal of frame RT_DL1MK3_Accel (8388644x, 0x800024x) */
/begin MEASUREMENT crt_PT_800024_Accel_Longitudinal "signal Accel_Longitudinal of frame RT_DL1MK3_Accel (8388644x, 0x800024x). Longitudinal acceleration.  This is positive when the vehicle accelerates in a forwards direction." SWORD CONV_crt_PT_800024_Accel_Longitudinal 0 0 -65.0 65.0 ECU_ADDRESS 0x0000 /end MEASUREMENT
/begin COMPU_METHOD CONV_crt_PT_800024_Accel_Longitudinal "Linear scaling, used for variable crt_PT_800024_Accel_Longitudinal, signal Accel_Longitudinal" RAT_FUNC "%6" "g" COEFFS 0 -1 0.0 0 0 -0.001 /end COMPU_METHOD
/* Measurement point for signal Accel_Lateral of frame RT_DL1MK3_Accel (8388644x, 0x800024x) */
/begin MEASUREMENT crt_PT_800024_Accel_Lateral "signal Accel_Lateral of frame RT_DL1MK3_Accel (8388644x, 0x800024x). Lateral acceleration.  This is positive when the vehicle accelerates towards the right, e.g. when cornering around a right-hand bend." SWORD CONV_crt_PT_800024_Accel_Lateral 0 0 -65.0 65.0 ECU_ADDRESS 0x0000 /end MEASUREMENT
/begin COMPU_METHOD CONV_crt_PT_800024_Accel_Lateral "Linear scaling, used for variable crt_PT_800024_Accel_Lateral, signal Accel_Lateral" RAT_FUNC "%6" "g" COEFFS 0 -1 0.0 0 0 -0.001 /end COMPU_METHOD
/* Measurement point for signal Accel_Vertical of frame RT_DL1MK3_Accel (8388644x, 0x800024x) */
/begin MEASUREMENT crt_PT_800024_Accel_Vertical "signal Accel_Vertical of frame RT_DL1MK3_Accel (8388644x, 0x800024x). Vertical acceleration.  This is positive when the vehicle accelerates in an upwards direction, e.g. when travelling through a dip." SWORD CONV_crt_PT_800024_Accel_Vertical 0 0 -65.0 65.0 ECU_ADDRESS 0x0000 /end MEASUREMENT
/begin COMPU_METHOD CONV_crt_PT_800024_Accel_Vertical "Linear scaling, used for variable crt_PT_800024_Accel_Vertical, signal Accel_Vertical" RAT_FUNC "%6" "g" COEFFS 0 -1 0.0 0 0 -0.001 /end COMPU_METHOD
/* Measurement point for signal Virtual_4_Vel_NED_D of frame RT_SB_INS_Vpt_4_Vel_NED_2 (9384482x, 0x8F3222x) */
/begin MEASUREMENT crt_PT_8f3222_Virtual_4_Vel_NED_D "signal Virtual_4_Vel_NED_D of frame RT_SB_INS_Vpt_4_Vel_NED_2 (9384482x, 0x8F3222x). VELNED D velocity.  This is the velocity vector directly downwards towards the Earth centre at the current local Earth surface position." SLONG CONV_crt_PT_8f3222_Virtual_4_Vel_NED_D 0 0 -838.0 838.0 ECU_ADDRESS 0x0000 /end MEASUREMENT
/begin COMPU_METHOD CONV_crt_PT_8f3222_Virtual_4_Vel_NED_D "Linear scaling, used for variable crt_PT_8f3222_Virtual_4_Vel_NED_D, signal Virtual_4_Vel_NED_D" RAT_FUNC "%12" "m/s" COEFFS 0 -1 0.0 0 0 -1.0E-4 /end COMPU_METHOD
/* Measurement point for signal Virtual_4_Heading of frame RT_SB_INS_Vpt_4_Vel_NED_2 (9384482x, 0x8F3222x) */
/begin MEASUREMENT crt_PT_8f3222_Virtual_4_Heading "signal Virtual_4_Heading of frame RT_SB_INS_Vpt_4_Vel_NED_2 (9384482x, 0x8F3222x). This is GPS heading, the direction that the vehicle is travelling in the local horizontal plane." SWORD CONV_crt_PT_8f3222_Virtual_4_Heading 0 0 -180.0 180.0 ECU_ADDRESS 0x0000 /end MEASUREMENT
/begin COMPU_METHOD CONV_crt_PT_8f3222_Virtual_4_Heading "Linear scaling, used for variable crt_PT_8f3222_Virtual_4_Heading, signal Virtual_4_Heading" RAT_FUNC "%6" "degrees" COEFFS 0 -1 0.0 0 0 -0.01 /end COMPU_METHOD
/* Measurement point for signal Virtual_4_Slip of frame RT_SB_INS_Vpt_4_Vel_NED_2 (9384482x, 0x8F3222x) */
/begin MEASUREMENT crt_PT_8f3222_Virtual_4_Slip "signal Virtual_4_Slip of frame RT_SB_INS_Vpt_4_Vel_NED_2 (9384482x, 0x8F3222x). Slip is defined as the difference between yaw and heading." SWORD CONV_crt_PT_8f3222_Virtual_4_Slip 0 0 -180.0 180.0 ECU_ADDRESS 0x0000 /end MEASUREMENT
/begin COMPU_METHOD CONV_crt_PT_8f3222_Virtual_4_Slip "Linear scaling, used for variable crt_PT_8f3222_Virtual_4_Slip, signal Virtual_4_Slip" RAT_FUNC "%6" "degrees" COEFFS 0 -1 0.0 0 0 -0.01 /end COMPU_METHOD
/* Measurement point for signal Virtual_4_Vel_NED_N of frame RT_SB_INS_Vpt_4_Vel_NED_1 (9384226x, 0x8F3122x) */
/begin MEASUREMENT crt_PT_8f3122_Virtual_4_Vel_NED_N "signal Virtual_4_Vel_NED_N of frame RT_SB_INS_Vpt_4_Vel_NED_1 (9384226x, 0x8F3122x). VELNED N velocity.  This is the velocity vector directly North at the current local Earth surface position." SLONG CONV_crt_PT_8f3122_Virtual_4_Vel_NED_N 0 0 -838.0 838.0 ECU_ADDRESS 0x0000 /end MEASUREMENT
/begin COMPU_METHOD CONV_crt_PT_8f3122_Virtual_4_Vel_NED_N "Linear scaling, used for variable crt_PT_8f3122_Virtual_4_Vel_NED_N, signal Virtual_4_Vel_NED_N" RAT_FUNC "%12" "m/s" COEFFS 0 -1 0.0 0 0 -1.0E-4 /end COMPU_METHOD
/* Measurement point for signal Virtual_4_Vel_NED_E of frame RT_SB_INS_Vpt_4_Vel_NED_1 (9384226x, 0x8F3122x) */
/begin MEASUREMENT crt_PT_8f3122_Virtual_4_Vel_NED_E "signal Virtual_4_Vel_NED_E of frame RT_SB_INS_Vpt_4_Vel_NED_1 (9384226x, 0x8F3122x). VELNED E velocity.  This is the velocity vector directly East at the current local Earth surface position." SLONG CONV_crt_PT_8f3122_Virtual_4_Vel_NED_E 0 0 -838.0 838.0 ECU_ADDRESS 0x0000 /end MEASUREMENT
/begin COMPU_METHOD CONV_crt_PT_8f3122_Virtual_4_Vel_NED_E "Linear scaling, used for variable crt_PT_8f3122_Virtual_4_Vel_NED_E, signal Virtual_4_Vel_NED_E" RAT_FUNC "%12" "m/s" COEFFS 0 -1 0.0 0 0 -1.0E-4 /end COMPU_METHOD
/* Measurement point for signal Virtual_4_Offset_X of frame RT_SB_INS_Vpt_4_Offset (9383970x, 0x8F3022x) */
/begin MEASUREMENT crt_PT_8f3022_Virtual_4_Offset_X "signal Virtual_4_Offset_X of frame RT_SB_INS_Vpt_4_Offset (9383970x, 0x8F3022x). X offset of the virtual point in the vehicle body frame." SWORD CONV_crt_PT_8f3022_Virtual_4_Offset_X 0 0 -32.768 32.767 ECU_ADDRESS 0x0000 /end MEASUREMENT
/begin COMPU_METHOD CONV_crt_PT_8f3022_Virtual_4_Offset_X "Linear scaling, used for variable crt_PT_8f3022_Virtual_4_Offset_X, signal Virtual_4_Offset_X" RAT_FUNC "%6" "m" COEFFS 0 -1 0.0 0 0 -0.001 /end COMPU_METHOD
/* Measurement point for signal Virtual_4_Offset_Y of frame RT_SB_INS_Vpt_4_Offset (9383970x, 0x8F3022x) */
/begin MEASUREMENT crt_PT_8f3022_Virtual_4_Offset_Y "signal Virtual_4_Offset_Y of frame RT_SB_INS_Vpt_4_Offset (9383970x, 0x8F3022x). Y offset of the virtual point in the vehicle body frame." SWORD CONV_crt_PT_8f3022_Virtual_4_Offset_Y 0 0 -32.768 32.767 ECU_ADDRESS 0x0000 /end MEASUREMENT
/begin COMPU_METHOD CONV_crt_PT_8f3022_Virtual_4_Offset_Y "Linear scaling, used for variable crt_PT_8f3022_Virtual_4_Offset_Y, signal Virtual_4_Offset_Y" RAT_FUNC "%6" "m" COEFFS 0 -1 0.0 0 0 -0.001 /end COMPU_METHOD
/* Measurement point for signal Virtual_4_Offset_Z of frame RT_SB_INS_Vpt_4_Offset (9383970x, 0x8F3022x) */
/begin MEASUREMENT crt_PT_8f3022_Virtual_4_Offset_Z "signal Virtual_4_Offset_Z of frame RT_SB_INS_Vpt_4_Offset (9383970x, 0x8F3022x). Z offset (+ve downwards) of the virtual point in the vehicle body frame." SWORD CONV_crt_PT_8f3022_Virtual_4_Offset_Z 0 0 -32.768 32.767 ECU_ADDRESS 0x0000 /end MEASUREMENT
/begin COMPU_METHOD CONV_crt_PT_8f3022_Virtual_4_Offset_Z "Linear scaling, used for variable crt_PT_8f3022_Virtual_4_Offset_Z, signal Virtual_4_Offset_Z" RAT_FUNC "%6" "m" COEFFS 0 -1 0.0 0 0 -0.001 /end COMPU_METHOD
/* Measurement point for signal Virtual_3_Vel_NED_D of frame RT_SB_INS_Vpt_3_Vel_NED_2 (9380386x, 0x8F2222x) */
/begin MEASUREMENT crt_PT_8f2222_Virtual_3_Vel_NED_D "signal Virtual_3_Vel_NED_D of frame RT_SB_INS_Vpt_3_Vel_NED_2 (9380386x, 0x8F2222x). VELNED D velocity.  This is the velocity vector directly downwards towards the Earth centre at the current local Earth surface position." SLONG CONV_crt_PT_8f2222_Virtual_3_Vel_NED_D 0 0 -838.0 838.0 ECU_ADDRESS 0x0000 /end MEASUREMENT
/begin COMPU_METHOD CONV_crt_PT_8f2222_Virtual_3_Vel_NED_D "Linear scaling, used for variable crt_PT_8f2222_Virtual_3_Vel_NED_D, signal Virtual_3_Vel_NED_D" RAT_FUNC "%12" "m/s" COEFFS 0 -1 0.0 0 0 -1.0E-4 /end COMPU_METHOD
/* Measurement point for signal Virtual_3_Heading of frame RT_SB_INS_Vpt_3_Vel_NED_2 (9380386x, 0x8F2222x) */
/begin MEASUREMENT crt_PT_8f2222_Virtual_3_Heading "signal Virtual_3_Heading of frame RT_SB_INS_Vpt_3_Vel_NED_2 (9380386x, 0x8F2222x). This is GPS heading, the direction that the vehicle is travelling in the local horizontal plane." SWORD CONV_crt_PT_8f2222_Virtual_3_Heading 0 0 -180.0 180.0 ECU_ADDRESS 0x0000 /end MEASUREMENT
/begin COMPU_METHOD CONV_crt_PT_8f2222_Virtual_3_Heading "Linear scaling, used for variable crt_PT_8f2222_Virtual_3_Heading, signal Virtual_3_Heading" RAT_FUNC "%6" "degrees" COEFFS 0 -1 0.0 0 0 -0.01 /end COMPU_METHOD
/* Measurement point for signal Virtual_3_Slip of frame RT_SB_INS_Vpt_3_Vel_NED_2 (9380386x, 0x8F2222x) */
/begin MEASUREMENT crt_PT_8f2222_Virtual_3_Slip "signal Virtual_3_Slip of frame RT_SB_INS_Vpt_3_Vel_NED_2 (9380386x, 0x8F2222x). Slip is defined as the difference between yaw and heading." SWORD CONV_crt_PT_8f2222_Virtual_3_Slip 0 0 -180.0 180.0 ECU_ADDRESS 0x0000 /end MEASUREMENT
/begin COMPU_METHOD CONV_crt_PT_8f2222_Virtual_3_Slip "Linear scaling, used for variable crt_PT_8f2222_Virtual_3_Slip, signal Virtual_3_Slip" RAT_FUNC "%6" "degrees" COEFFS 0 -1 0.0 0 0 -0.01 /end COMPU_METHOD
/* Measurement point for signal Virtual_3_Vel_NED_N of frame RT_SB_INS_Vpt_3_Vel_NED_1 (9380130x, 0x8F2122x) */
/begin MEASUREMENT crt_PT_8f2122_Virtual_3_Vel_NED_N "signal Virtual_3_Vel_NED_N of frame RT_SB_INS_Vpt_3_Vel_NED_1 (9380130x, 0x8F2122x). VELNED N velocity.  This is the velocity vector directly North at the current local Earth surface position." SLONG CONV_crt_PT_8f2122_Virtual_3_Vel_NED_N 0 0 -838.0 838.0 ECU_ADDRESS 0x0000 /end MEASUREMENT
/begin COMPU_METHOD CONV_crt_PT_8f2122_Virtual_3_Vel_NED_N "Linear scaling, used for variable crt_PT_8f2122_Virtual_3_Vel_NED_N, signal Virtual_3_Vel_NED_N" RAT_FUNC "%12" "m/s" COEFFS 0 -1 0.0 0 0 -1.0E-4 /end COMPU_METHOD
/* Measurement point for signal Virtual_3_Vel_NED_E of frame RT_SB_INS_Vpt_3_Vel_NED_1 (9380130x, 0x8F2122x) */
/begin MEASUREMENT crt_PT_8f2122_Virtual_3_Vel_NED_E "signal Virtual_3_Vel_NED_E of frame RT_SB_INS_Vpt_3_Vel_NED_1 (9380130x, 0x8F2122x). VELNED E velocity.  This is the velocity vector directly East at the current local Earth surface position." SLONG CONV_crt_PT_8f2122_Virtual_3_Vel_NED_E 0 0 -838.0 838.0 ECU_ADDRESS 0x0000 /end MEASUREMENT
/begin COMPU_METHOD CONV_crt_PT_8f2122_Virtual_3_Vel_NED_E "Linear scaling, used for variable crt_PT_8f2122_Virtual_3_Vel_NED_E, signal Virtual_3_Vel_NED_E" RAT_FUNC "%12" "m/s" COEFFS 0 -1 0.0 0 0 -1.0E-4 /end COMPU_METHOD
/* Measurement point for signal Virtual_3_Offset_X of frame RT_SB_INS_Vpt_3_Offset (9379874x, 0x8F2022x) */
/begin MEASUREMENT crt_PT_8f2022_Virtual_3_Offset_X "signal Virtual_3_Offset_X of frame RT_SB_INS_Vpt_3_Offset (9379874x, 0x8F2022x). X offset of the virtual point in the vehicle body frame." SWORD CONV_crt_PT_8f2022_Virtual_3_Offset_X 0 0 -32.768 32.767 ECU_ADDRESS 0x0000 /end MEASUREMENT
/begin COMPU_METHOD CONV_crt_PT_8f2022_Virtual_3_Offset_X "Linear scaling, used for variable crt_PT_8f2022_Virtual_3_Offset_X, signal Virtual_3_Offset_X" RAT_FUNC "%6" "m" COEFFS 0 -1 0.0 0 0 -0.001 /end COMPU_METHOD
/* Measurement point for signal Virtual_3_Offset_Y of frame RT_SB_INS_Vpt_3_Offset (9379874x, 0x8F2022x) */
/begin MEASUREMENT crt_PT_8f2022_Virtual_3_Offset_Y "signal Virtual_3_Offset_Y of frame RT_SB_INS_Vpt_3_Offset (9379874x, 0x8F2022x). Y offset of the virtual point in the vehicle body frame." SWORD CONV_crt_PT_8f2022_Virtual_3_Offset_Y 0 0 -32.768 32.767 ECU_ADDRESS 0x0000 /end MEASUREMENT
/begin COMPU_METHOD CONV_crt_PT_8f2022_Virtual_3_Offset_Y "Linear scaling, used for variable crt_PT_8f2022_Virtual_3_Offset_Y, signal Virtual_3_Offset_Y" RAT_FUNC "%6" "m" COEFFS 0 -1 0.0 0 0 -0.001 /end COMPU_METHOD
/* Measurement point for signal Virtual_3_Offset_Z of frame RT_SB_INS_Vpt_3_Offset (9379874x, 0x8F2022x) */
/begin MEASUREMENT crt_PT_8f2022_Virtual_3_Offset_Z "signal Virtual_3_Offset_Z of frame RT_SB_INS_Vpt_3_Offset (9379874x, 0x8F2022x). Z offset (+ve downwards) of the virtual point in the vehicle body frame." SWORD CONV_crt_PT_8f2022_Virtual_3_Offset_Z 0 0 -32.768 32.767 ECU_ADDRESS 0x0000 /end MEASUREMENT
/begin COMPU_METHOD CONV_crt_PT_8f2022_Virtual_3_Offset_Z "Linear scaling, used for variable crt_PT_8f2022_Virtual_3_Offset_Z, signal Virtual_3_Offset_Z" RAT_FUNC "%6" "m" COEFFS 0 -1 0.0 0 0 -0.001 /end COMPU_METHOD
/* Measurement point for signal Virtual_2_Vel_NED_D of frame RT_SB_INS_Vpt_2_Vel_NED_2 (9376290x, 0x8F1222x) */
/begin MEASUREMENT crt_PT_8f1222_Virtual_2_Vel_NED_D "signal Virtual_2_Vel_NED_D of frame RT_SB_INS_Vpt_2_Vel_NED_2 (9376290x, 0x8F1222x). VELNED D velocity.  This is the velocity vector directly downwards towards the Earth centre at the current local Earth surface position." SLONG CONV_crt_PT_8f1222_Virtual_2_Vel_NED_D 0 0 -838.0 838.0 ECU_ADDRESS 0x0000 /end MEASUREMENT
/begin COMPU_METHOD CONV_crt_PT_8f1222_Virtual_2_Vel_NED_D "Linear scaling, used for variable crt_PT_8f1222_Virtual_2_Vel_NED_D, signal Virtual_2_Vel_NED_D" RAT_FUNC "%12" "m/s" COEFFS 0 -1 0.0 0 0 -1.0E-4 /end COMPU_METHOD
/* Measurement point for signal Virtual_2_Heading of frame RT_SB_INS_Vpt_2_Vel_NED_2 (9376290x, 0x8F1222x) */
/begin MEASUREMENT crt_PT_8f1222_Virtual_2_Heading "signal Virtual_2_Heading of frame RT_SB_INS_Vpt_2_Vel_NED_2 (9376290x, 0x8F1222x). This is GPS heading, the direction that the vehicle is travelling in the local horizontal plane." SWORD CONV_crt_PT_8f1222_Virtual_2_Heading 0 0 -180.0 180.0 ECU_ADDRESS 0x0000 /end MEASUREMENT
/begin COMPU_METHOD CONV_crt_PT_8f1222_Virtual_2_Heading "Linear scaling, used for variable crt_PT_8f1222_Virtual_2_Heading, signal Virtual_2_Heading" RAT_FUNC "%6" "degrees" COEFFS 0 -1 0.0 0 0 -0.01 /end COMPU_METHOD
/* Measurement point for signal Virtual_2_Slip of frame RT_SB_INS_Vpt_2_Vel_NED_2 (9376290x, 0x8F1222x) */
/begin MEASUREMENT crt_PT_8f1222_Virtual_2_Slip "signal Virtual_2_Slip of frame RT_SB_INS_Vpt_2_Vel_NED_2 (9376290x, 0x8F1222x). Slip is defined as the difference between yaw and heading." SWORD CONV_crt_PT_8f1222_Virtual_2_Slip 0 0 -180.0 180.0 ECU_ADDRESS 0x0000 /end MEASUREMENT
/begin COMPU_METHOD CONV_crt_PT_8f1222_Virtual_2_Slip "Linear scaling, used for variable crt_PT_8f1222_Virtual_2_Slip, signal Virtual_2_Slip" RAT_FUNC "%6" "degrees" COEFFS 0 -1 0.0 0 0 -0.01 /end COMPU_METHOD
/* Measurement point for signal Virtual_2_Vel_NED_N of frame RT_SB_INS_Vpt_2_Vel_NED_1 (9376034x, 0x8F1122x) */
/begin MEASUREMENT crt_PT_8f1122_Virtual_2_Vel_NED_N "signal Virtual_2_Vel_NED_N of frame RT_SB_INS_Vpt_2_Vel_NED_1 (9376034x, 0x8F1122x). VELNED N velocity.  This is the velocity vector directly North at the current local Earth surface position." SLONG CONV_crt_PT_8f1122_Virtual_2_Vel_NED_N 0 0 -838.0 838.0 ECU_ADDRESS 0x0000 /end MEASUREMENT
/begin COMPU_METHOD CONV_crt_PT_8f1122_Virtual_2_Vel_NED_N "Linear scaling, used for variable crt_PT_8f1122_Virtual_2_Vel_NED_N, signal Virtual_2_Vel_NED_N" RAT_FUNC "%12" "m/s" COEFFS 0 -1 0.0 0 0 -1.0E-4 /end COMPU_METHOD
/* Measurement point for signal Virtual_2_Vel_NED_E of frame RT_SB_INS_Vpt_2_Vel_NED_1 (9376034x, 0x8F1122x) */
/begin MEASUREMENT crt_PT_8f1122_Virtual_2_Vel_NED_E "signal Virtual_2_Vel_NED_E of frame RT_SB_INS_Vpt_2_Vel_NED_1 (9376034x, 0x8F1122x). VELNED E velocity.  This is the velocity vector directly East at the current local Earth surface position." SLONG CONV_crt_PT_8f1122_Virtual_2_Vel_NED_E 0 0 -838.0 838.0 ECU_ADDRESS 0x0000 /end MEASUREMENT
/begin COMPU_METHOD CONV_crt_PT_8f1122_Virtual_2_Vel_NED_E "Linear scaling, used for variable crt_PT_8f1122_Virtual_2_Vel_NED_E, signal Virtual_2_Vel_NED_E" RAT_FUNC "%12" "m/s" COEFFS 0 -1 0.0 0 0 -1.0E-4 /end COMPU_METHOD
/* Measurement point for signal Virtual_2_Offset_X of frame RT_SB_INS_Vpt_2_Offset (9375778x, 0x8F1022x) */
/begin MEASUREMENT crt_PT_8f1022_Virtual_2_Offset_X "signal Virtual_2_Offset_X of frame RT_SB_INS_Vpt_2_Offset (9375778x, 0x8F1022x). X offset of the virtual point in the vehicle body frame." SWORD CONV_crt_PT_8f1022_Virtual_2_Offset_X 0 0 -32.768 32.767 ECU_ADDRESS 0x0000 /end MEASUREMENT
/begin COMPU_METHOD CONV_crt_PT_8f1022_Virtual_2_Offset_X "Linear scaling, used for variable crt_PT_8f1022_Virtual_2_Offset_X, signal Virtual_2_Offset_X" RAT_FUNC "%6" "m" COEFFS 0 -1 0.0 0 0 -0.001 /end COMPU_METHOD
/* Measurement point for signal Virtual_2_Offset_Y of frame RT_SB_INS_Vpt_2_Offset (9375778x, 0x8F1022x) */
/begin MEASUREMENT crt_PT_8f1022_Virtual_2_Offset_Y "signal Virtual_2_Offset_Y of frame RT_SB_INS_Vpt_2_Offset (9375778x, 0x8F1022x). Y offset of the virtual point in the vehicle body frame." SWORD CONV_crt_PT_8f1022_Virtual_2_Offset_Y 0 0 -32.768 32.767 ECU_ADDRESS 0x0000 /end MEASUREMENT
/begin COMPU_METHOD CONV_crt_PT_8f1022_Virtual_2_Offset_Y "Linear scaling, used for variable crt_PT_8f1022_Virtual_2_Offset_Y, signal Virtual_2_Offset_Y" RAT_FUNC "%6" "m" COEFFS 0 -1 0.0 0 0 -0.001 /end COMPU_METHOD
/* Measurement point for signal Virtual_2_Offset_Z of frame RT_SB_INS_Vpt_2_Offset (9375778x, 0x8F1022x) */
/begin MEASUREMENT crt_PT_8f1022_Virtual_2_Offset_Z "signal Virtual_2_Offset_Z of frame RT_SB_INS_Vpt_2_Offset (9375778x, 0x8F1022x). Z offset (+ve downwards) of the virtual point in the vehicle body frame." SWORD CONV_crt_PT_8f1022_Virtual_2_Offset_Z 0 0 -32.768 32.767 ECU_ADDRESS 0x0000 /end MEASUREMENT
/begin COMPU_METHOD CONV_crt_PT_8f1022_Virtual_2_Offset_Z "Linear scaling, used for variable crt_PT_8f1022_Virtual_2_Offset_Z, signal Virtual_2_Offset_Z" RAT_FUNC "%6" "m" COEFFS 0 -1 0.0 0 0 -0.001 /end COMPU_METHOD
/* Measurement point for signal Virtual_1_Vel_NED_D of frame RT_SB_INS_Vpt_1_Vel_NED_2 (9372194x, 0x8F0222x) */
/begin MEASUREMENT crt_PT_8f0222_Virtual_1_Vel_NED_D "signal Virtual_1_Vel_NED_D of frame RT_SB_INS_Vpt_1_Vel_NED_2 (9372194x, 0x8F0222x). VELNED D velocity.  This is the velocity vector directly downwards towards the Earth centre at the current local Earth surface position." SLONG CONV_crt_PT_8f0222_Virtual_1_Vel_NED_D 0 0 -838.0 838.0 ECU_ADDRESS 0x0000 /end MEASUREMENT
/begin COMPU_METHOD CONV_crt_PT_8f0222_Virtual_1_Vel_NED_D "Linear scaling, used for variable crt_PT_8f0222_Virtual_1_Vel_NED_D, signal Virtual_1_Vel_NED_D" RAT_FUNC "%12" "m/s" COEFFS 0 -1 0.0 0 0 -1.0E-4 /end COMPU_METHOD
/* Measurement point for signal Virtual_1_Heading of frame RT_SB_INS_Vpt_1_Vel_NED_2 (9372194x, 0x8F0222x) */
/begin MEASUREMENT crt_PT_8f0222_Virtual_1_Heading "signal Virtual_1_Heading of frame RT_SB_INS_Vpt_1_Vel_NED_2 (9372194x, 0x8F0222x). This is GPS heading, the direction that the vehicle is travelling in the local horizontal plane." SWORD CONV_crt_PT_8f0222_Virtual_1_Heading 0 0 -180.0 180.0 ECU_ADDRESS 0x0000 /end MEASUREMENT
/begin COMPU_METHOD CONV_crt_PT_8f0222_Virtual_1_Heading "Linear scaling, used for variable crt_PT_8f0222_Virtual_1_Heading, signal Virtual_1_Heading" RAT_FUNC "%6" "degrees" COEFFS 0 -1 0.0 0 0 -0.01 /end COMPU_METHOD
/* Measurement point for signal Virtual_1_Slip of frame RT_SB_INS_Vpt_1_Vel_NED_2 (9372194x, 0x8F0222x) */
/begin MEASUREMENT crt_PT_8f0222_Virtual_1_Slip "signal Virtual_1_Slip of frame RT_SB_INS_Vpt_1_Vel_NED_2 (9372194x, 0x8F0222x). Slip is defined as the difference between yaw and heading." SWORD CONV_crt_PT_8f0222_Virtual_1_Slip 0 0 -180.0 180.0 ECU_ADDRESS 0x0000 /end MEASUREMENT
/begin COMPU_METHOD CONV_crt_PT_8f0222_Virtual_1_Slip "Linear scaling, used for variable crt_PT_8f0222_Virtual_1_Slip, signal Virtual_1_Slip" RAT_FUNC "%6" "degrees" COEFFS 0 -1 0.0 0 0 -0.01 /end COMPU_METHOD
/* Measurement point for signal Virtual_1_Vel_NED_N of frame RT_SB_INS_Vpt_1_Vel_NED_1 (9371938x, 0x8F0122x) */
/begin MEASUREMENT crt_PT_8f0122_Virtual_1_Vel_NED_N "signal Virtual_1_Vel_NED_N of frame RT_SB_INS_Vpt_1_Vel_NED_1 (9371938x, 0x8F0122x). VELNED N velocity.  This is the velocity vector directly North at the current local Earth surface position." SLONG CONV_crt_PT_8f0122_Virtual_1_Vel_NED_N 0 0 -838.0 838.0 ECU_ADDRESS 0x0000 /end MEASUREMENT
/begin COMPU_METHOD CONV_crt_PT_8f0122_Virtual_1_Vel_NED_N "Linear scaling, used for variable crt_PT_8f0122_Virtual_1_Vel_NED_N, signal Virtual_1_Vel_NED_N" RAT_FUNC "%12" "m/s" COEFFS 0 -1 0.0 0 0 -1.0E-4 /end COMPU_METHOD
/* Measurement point for signal Virtual_1_Vel_NED_E of frame RT_SB_INS_Vpt_1_Vel_NED_1 (9371938x, 0x8F0122x) */
/begin MEASUREMENT crt_PT_8f0122_Virtual_1_Vel_NED_E "signal Virtual_1_Vel_NED_E of frame RT_SB_INS_Vpt_1_Vel_NED_1 (9371938x, 0x8F0122x). VELNED E velocity.  This is the velocity vector directly East at the current local Earth surface position." SLONG CONV_crt_PT_8f0122_Virtual_1_Vel_NED_E 0 0 -838.0 838.0 ECU_ADDRESS 0x0000 /end MEASUREMENT
/begin COMPU_METHOD CONV_crt_PT_8f0122_Virtual_1_Vel_NED_E "Linear scaling, used for variable crt_PT_8f0122_Virtual_1_Vel_NED_E, signal Virtual_1_Vel_NED_E" RAT_FUNC "%12" "m/s" COEFFS 0 -1 0.0 0 0 -1.0E-4 /end COMPU_METHOD
/* Measurement point for signal Virtual_1_Offset_X of frame RT_SB_INS_Vpt_1_Offset (9371682x, 0x8F0022x) */
/begin MEASUREMENT crt_PT_8f0022_Virtual_1_Offset_X "signal Virtual_1_Offset_X of frame RT_SB_INS_Vpt_1_Offset (9371682x, 0x8F0022x). X offset of the virtual point in the vehicle body frame." SWORD CONV_crt_PT_8f0022_Virtual_1_Offset_X 0 0 -32.768 32.767 ECU_ADDRESS 0x0000 /end MEASUREMENT
/begin COMPU_METHOD CONV_crt_PT_8f0022_Virtual_1_Offset_X "Linear scaling, used for variable crt_PT_8f0022_Virtual_1_Offset_X, signal Virtual_1_Offset_X" RAT_FUNC "%6" "m" COEFFS 0 -1 0.0 0 0 -0.001 /end COMPU_METHOD
/* Measurement point for signal Virtual_1_Offset_Y of frame RT_SB_INS_Vpt_1_Offset (9371682x, 0x8F0022x) */
/begin MEASUREMENT crt_PT_8f0022_Virtual_1_Offset_Y "signal Virtual_1_Offset_Y of frame RT_SB_INS_Vpt_1_Offset (9371682x, 0x8F0022x). Y offset of the virtual point in the vehicle body frame." SWORD CONV_crt_PT_8f0022_Virtual_1_Offset_Y 0 0 -32.768 32.767 ECU_ADDRESS 0x0000 /end MEASUREMENT
/begin COMPU_METHOD CONV_crt_PT_8f0022_Virtual_1_Offset_Y "Linear scaling, used for variable crt_PT_8f0022_Virtual_1_Offset_Y, signal Virtual_1_Offset_Y" RAT_FUNC "%6" "m" COEFFS 0 -1 0.0 0 0 -0.001 /end COMPU_METHOD
/* Measurement point for signal Virtual_1_Offset_Z of frame RT_SB_INS_Vpt_1_Offset (9371682x, 0x8F0022x) */
/begin MEASUREMENT crt_PT_8f0022_Virtual_1_Offset_Z "signal Virtual_1_Offset_Z of frame RT_SB_INS_Vpt_1_Offset (9371682x, 0x8F0022x). Z offset (+ve downwards) of the virtual point in the vehicle body frame." SWORD CONV_crt_PT_8f0022_Virtual_1_Offset_Z 0 0 -32.768 32.767 ECU_ADDRESS 0x0000 /end MEASUREMENT
/begin COMPU_METHOD CONV_crt_PT_8f0022_Virtual_1_Offset_Z "Linear scaling, used for variable crt_PT_8f0022_Virtual_1_Offset_Z, signal Virtual_1_Offset_Z" RAT_FUNC "%6" "m" COEFFS 0 -1 0.0 0 0 -0.001 /end COMPU_METHOD
/* Measurement point for signal Validity_INS_Slip of frame RT_SB_INS_Slip (9311778x, 0x8E1622x) */
/begin MEASUREMENT crt_PT_8e1622_Validity_INS_Slip "signal Validity_INS_Slip of frame RT_SB_INS_Slip (9311778x, 0x8E1622x)" UBYTE CONV_crt_PT_8e1622_Validity_INS_Slip 0 0 0 1 ECU_ADDRESS 0x0000 /end MEASUREMENT
/begin COMPU_METHOD CONV_crt_PT_8e1622_Validity_INS_Slip "Identity, real-world value is same as binary value" IDENTICAL "%1" "" /end COMPU_METHOD
/* Measurement point for signal Validity_INS_Squat of frame RT_SB_INS_Slip (9311778x, 0x8E1622x) */
/begin MEASUREMENT crt_PT_8e1622_Validity_INS_Squat "signal Validity_INS_Squat of frame RT_SB_INS_Slip (9311778x, 0x8E1622x)" UBYTE CONV_crt_PT_8e1622_Validity_INS_Squat 0 0 0 1 ECU_ADDRESS 0x0000 /end MEASUREMENT
/begin COMPU_METHOD CONV_crt_PT_8e1622_Validity_INS_Squat "Identity, real-world value is same as binary value" IDENTICAL "%1" "" /end COMPU_METHOD
/* Measurement point for signal Accuracy_INS_Slip of frame RT_SB_INS_Slip (9311778x, 0x8E1622x) */
/begin MEASUREMENT crt_PT_8e1622_Accuracy_INS_Slip "signal Accuracy_INS_Slip of frame RT_SB_INS_Slip (9311778x, 0x8E1622x). Dimensionless.  Lower values imply but do not guarantee better accuracy than higher values." UBYTE CONV_crt_PT_8e1622_Accuracy_INS_Slip 0 0 0 255 ECU_ADDRESS 0x0000 /end MEASUREMENT
/begin COMPU_METHOD CONV_crt_PT_8e1622_Accuracy_INS_Slip "Identity, real-world value is same as binary value" IDENTICAL "%4" "" /end COMPU_METHOD
/* Measurement point for signal INS_Slip of frame RT_SB_INS_Slip (9311778x, 0x8E1622x) */
/begin MEASUREMENT crt_PT_8e1622_INS_Slip "signal INS_Slip of frame RT_SB_INS_Slip (9311778x, 0x8E1622x). Slip is defined as the difference between yaw and heading" SWORD CONV_crt_PT_8e1622_INS_Slip 0 0 -360.0 360.0 ECU_ADDRESS 0x0000 /end MEASUREMENT
/begin COMPU_METHOD CONV_crt_PT_8e1622_INS_Slip "Linear scaling, used for variable crt_PT_8e1622_INS_Slip, signal INS_Slip" RAT_FUNC "%6" "degrees" COEFFS 0 -1 0.0 0 0 -0.01 /end COMPU_METHOD
/* Measurement point for signal Accuracy_INS_Squat of frame RT_SB_INS_Slip (9311778x, 0x8E1622x) */
/begin MEASUREMENT crt_PT_8e1622_Accuracy_INS_Squat "signal Accuracy_INS_Squat of frame RT_SB_INS_Slip (9311778x, 0x8E1622x). Dimensionless.  Lower values imply but do not guarantee better accuracy than higher values." UBYTE CONV_crt_PT_8e1622_Accuracy_INS_Squat 0 0 0 255 ECU_ADDRESS 0x0000 /end MEASUREMENT
/begin COMPU_METHOD CONV_crt_PT_8e1622_Accuracy_INS_Squat "Identity, real-world value is same as binary value" IDENTICAL "%4" "" /end COMPU_METHOD
/* Measurement point for signal INS_Squat of frame RT_SB_INS_Slip (9311778x, 0x8E1622x) */
/begin MEASUREMENT crt_PT_8e1622_INS_Squat "signal INS_Squat of frame RT_SB_INS_Slip (9311778x, 0x8E1622x). Squat is defined as the difference between pitch and gradient" SWORD CONV_crt_PT_8e1622_INS_Squat 0 0 -360.0 360.0 ECU_ADDRESS 0x0000 /end MEASUREMENT
/begin COMPU_METHOD CONV_crt_PT_8e1622_INS_Squat "Linear scaling, used for variable crt_PT_8e1622_INS_Squat, signal INS_Squat" RAT_FUNC "%6" "degrees" COEFFS 0 -1 0.0 0 0 -0.01 /end COMPU_METHOD
/* Measurement point for signal Validity_INS_Vel_ECEF_Y of frame RT_SB_INS_Vel_ECEF_2 (9311010x, 0x8E1322x) */
/begin MEASUREMENT crt_PT_8e1322_Validity_INS_Vel_ECEF_Y "signal Validity_INS_Vel_ECEF_Y of frame RT_SB_INS_Vel_ECEF_2 (9311010x, 0x8E1322x). Valid when bit is set, invalid when bit is clear." UBYTE CONV_crt_PT_8e1322_Validity_INS_Vel_ECEF_Y 0 0 0 1 ECU_ADDRESS 0x0000 /end MEASUREMENT
/begin COMPU_METHOD CONV_crt_PT_8e1322_Validity_INS_Vel_ECEF_Y "Identity, real-world value is same as binary value" IDENTICAL "%1" "" /end COMPU_METHOD
/* Measurement point for signal Validity_INS_Vel_ECEF_Z of frame RT_SB_INS_Vel_ECEF_2 (9311010x, 0x8E1322x) */
/begin MEASUREMENT crt_PT_8e1322_Validity_INS_Vel_ECEF_Z "signal Validity_INS_Vel_ECEF_Z of frame RT_SB_INS_Vel_ECEF_2 (9311010x, 0x8E1322x). Valid when bit is set, invalid when bit is clear." UBYTE CONV_crt_PT_8e1322_Validity_INS_Vel_ECEF_Z 0 0 0 1 ECU_ADDRESS 0x0000 /end MEASUREMENT
/begin COMPU_METHOD CONV_crt_PT_8e1322_Validity_INS_Vel_ECEF_Z "Identity, real-world value is same as binary value" IDENTICAL "%1" "" /end COMPU_METHOD
/* Measurement point for signal INS_Vel_ECEF_Y of frame RT_SB_INS_Vel_ECEF_2 (9311010x, 0x8E1322x) */
/begin MEASUREMENT crt_PT_8e1322_INS_Vel_ECEF_Y "signal INS_Vel_ECEF_Y of frame RT_SB_INS_Vel_ECEF_2 (9311010x, 0x8E1322x). ECEF Y velocity.  The ECEF Y axis originates from the Earth centre, and the positive Y axis intersects the Earth surface at zero degrees latittude and 90 degrees longitude." SLONG CONV_crt_PT_8e1322_INS_Vel_ECEF_Y 0 0 -838.0 838.0 ECU_ADDRESS 0x0000 /end MEASUREMENT
/begin COMPU_METHOD CONV_crt_PT_8e1322_INS_Vel_ECEF_Y "Linear scaling, used for variable crt_PT_8e1322_INS_Vel_ECEF_Y, signal INS_Vel_ECEF_Y" RAT_FUNC "%12" "m/s" COEFFS 0 -1 0.0 0 0 -1.0E-4 /end COMPU_METHOD
/* Measurement point for signal INS_Vel_ECEF_Z of frame RT_SB_INS_Vel_ECEF_2 (9311010x, 0x8E1322x) */
/begin MEASUREMENT crt_PT_8e1322_INS_Vel_ECEF_Z "signal INS_Vel_ECEF_Z of frame RT_SB_INS_Vel_ECEF_2 (9311010x, 0x8E1322x). ECEF Z velocity.  The ECEF Z axis originates from the Earth centre, and the positive Z axis intersects the Earth surface at the North Pole." SLONG CONV_crt_PT_8e1322_INS_Vel_ECEF_Z 0 0 -838.0 838.0 ECU_ADDRESS 0x0000 /end MEASUREMENT
/begin COMPU_METHOD CONV_crt_PT_8e1322_INS_Vel_ECEF_Z "Linear scaling, used for variable crt_PT_8e1322_INS_Vel_ECEF_Z, signal INS_Vel_ECEF_Z" RAT_FUNC "%12" "m/s" COEFFS 0 -1 0.0 0 0 -1.0E-4 /end COMPU_METHOD
/* Measurement point for signal Validity_INS_Vel_ECEF_X of frame RT_SB_INS_Vel_ECEF_1 (9310754x, 0x8E1222x) */
/begin MEASUREMENT crt_PT_8e1222_Validity_INS_Vel_ECEF_X "signal Validity_INS_Vel_ECEF_X of frame RT_SB_INS_Vel_ECEF_1 (9310754x, 0x8E1222x). Valid when bit is set, invalid when bit is clear." UBYTE CONV_crt_PT_8e1222_Validity_INS_Vel_ECEF_X 0 0 0 1 ECU_ADDRESS 0x0000 /end MEASUREMENT
/begin COMPU_METHOD CONV_crt_PT_8e1222_Validity_INS_Vel_ECEF_X "Identity, real-world value is same as binary value" IDENTICAL "%1" "" /end COMPU_METHOD
/* Measurement point for signal Accuracy_INS_Vel_ECEF_X of frame RT_SB_INS_Vel_ECEF_1 (9310754x, 0x8E1222x) */
/begin MEASUREMENT crt_PT_8e1222_Accuracy_INS_Vel_ECEF_X "signal Accuracy_INS_Vel_ECEF_X of frame RT_SB_INS_Vel_ECEF_1 (9310754x, 0x8E1222x)" UBYTE CONV_crt_PT_8e1222_Accuracy_INS_Vel_ECEF_X 0 0 0 255 ECU_ADDRESS 0x0000 /end MEASUREMENT
/begin COMPU_METHOD CONV_crt_PT_8e1222_Accuracy_INS_Vel_ECEF_X "Identity, real-world value is same as binary value" IDENTICAL "%4" "" /end COMPU_METHOD
/* Measurement point for signal Accuracy_INS_Vel_ECEF_Y of frame RT_SB_INS_Vel_ECEF_1 (9310754x, 0x8E1222x) */
/begin MEASUREMENT crt_PT_8e1222_Accuracy_INS_Vel_ECEF_Y "signal Accuracy_INS_Vel_ECEF_Y of frame RT_SB_INS_Vel_ECEF_1 (9310754x, 0x8E1222x)" UBYTE CONV_crt_PT_8e1222_Accuracy_INS_Vel_ECEF_Y 0 0 0 255 ECU_ADDRESS 0x0000 /end MEASUREMENT
/begin COMPU_METHOD CONV_crt_PT_8e1222_Accuracy_INS_Vel_ECEF_Y "Identity, real-world value is same as binary value" IDENTICAL "%4" "" /end COMPU_METHOD
/* Measurement point for signal Accuracy_INS_Vel_ECEF_Z of frame RT_SB_INS_Vel_ECEF_1 (9310754x, 0x8E1222x) */
/begin MEASUREMENT crt_PT_8e1222_Accuracy_INS_Vel_ECEF_Z "signal Accuracy_INS_Vel_ECEF_Z of frame RT_SB_INS_Vel_ECEF_1 (9310754x, 0x8E1222x)" UBYTE CONV_crt_PT_8e1222_Accuracy_INS_Vel_ECEF_Z 0 0 0 255 ECU_ADDRESS 0x0000 /end MEASUREMENT
/begin COMPU_METHOD CONV_crt_PT_8e1222_Accuracy_INS_Vel_ECEF_Z "Identity, real-world value is same as binary value" IDENTICAL "%4" "" /end COMPU_METHOD
/* Measurement point for signal INS_Vel_ECEF_X of frame RT_SB_INS_Vel_ECEF_1 (9310754x, 0x8E1222x) */
/begin MEASUREMENT crt_PT_8e1222_INS_Vel_ECEF_X "signal INS_Vel_ECEF_X of frame RT_SB_INS_Vel_ECEF_1 (9310754x, 0x8E1222x). ECEF X velocity.  The ECEF X axis originates from the Earth centre, and the positive X axis intersects the Earth surface at zero degrees latittude and zero degrees longitude (the intersection of the equator and the prime meridian)." SLONG CONV_crt_PT_8e1222_INS_Vel_ECEF_X 0 0 -838.0 838.0 ECU_ADDRESS 0x0000 /end MEASUREMENT
/begin COMPU_METHOD CONV_crt_PT_8e1222_INS_Vel_ECEF_X "Linear scaling, used for variable crt_PT_8e1222_INS_Vel_ECEF_X, signal INS_Vel_ECEF_X" RAT_FUNC "%12" "m/s" COEFFS 0 -1 0.0 0 0 -1.0E-4 /end COMPU_METHOD
/* Measurement point for signal Validity_INS_Vel_NED_D of frame RT_SB_INS_Vel_NED_2 (9310498x, 0x8E1122x) */
/begin MEASUREMENT crt_PT_8e1122_Validity_INS_Vel_NED_D "signal Validity_INS_Vel_NED_D of frame RT_SB_INS_Vel_NED_2 (9310498x, 0x8E1122x). Valid when bit is set, invalid when bit is clear." UBYTE CONV_crt_PT_8e1122_Validity_INS_Vel_NED_D 0 0 0 1 ECU_ADDRESS 0x0000 /end MEASUREMENT
/begin COMPU_METHOD CONV_crt_PT_8e1122_Validity_INS_Vel_NED_D "Identity, real-world value is same as binary value" IDENTICAL "%1" "" /end COMPU_METHOD
/* Measurement point for signal Accuracy_INS_Vel_D of frame RT_SB_INS_Vel_NED_2 (9310498x, 0x8E1122x) */
/begin MEASUREMENT crt_PT_8e1122_Accuracy_INS_Vel_D "signal Accuracy_INS_Vel_D of frame RT_SB_INS_Vel_NED_2 (9310498x, 0x8E1122x)" UBYTE CONV_crt_PT_8e1122_Accuracy_INS_Vel_D 0 0 0 255 ECU_ADDRESS 0x0000 /end MEASUREMENT
/begin COMPU_METHOD CONV_crt_PT_8e1122_Accuracy_INS_Vel_D "Identity, real-world value is same as binary value" IDENTICAL "%4" "" /end COMPU_METHOD
/* Measurement point for signal INS_Vel_NED_D of frame RT_SB_INS_Vel_NED_2 (9310498x, 0x8E1122x) */
/begin MEASUREMENT crt_PT_8e1122_INS_Vel_NED_D "signal INS_Vel_NED_D of frame RT_SB_INS_Vel_NED_2 (9310498x, 0x8E1122x). VELNED D velocity.  This is the velocity vector directly downwards towards the Earth centre at the current local Earth surface position." SLONG CONV_crt_PT_8e1122_INS_Vel_NED_D 0 0 -838.0 838.0 ECU_ADDRESS 0x0000 /end MEASUREMENT
/begin COMPU_METHOD CONV_crt_PT_8e1122_INS_Vel_NED_D "Linear scaling, used for variable crt_PT_8e1122_INS_Vel_NED_D, signal INS_Vel_NED_D" RAT_FUNC "%12" "m/s" COEFFS 0 -1 0.0 0 0 -1.0E-4 /end COMPU_METHOD
/* Measurement point for signal Validity_INS_Vel_NED_N of frame RT_SB_INS_Vel_NED_1 (9310242x, 0x8E1022x) */
/begin MEASUREMENT crt_PT_8e1022_Validity_INS_Vel_NED_N "signal Validity_INS_Vel_NED_N of frame RT_SB_INS_Vel_NED_1 (9310242x, 0x8E1022x). Valid when bit is set, invalid when bit is clear." UBYTE CONV_crt_PT_8e1022_Validity_INS_Vel_NED_N 0 0 0 1 ECU_ADDRESS 0x0000 /end MEASUREMENT
/begin COMPU_METHOD CONV_crt_PT_8e1022_Validity_INS_Vel_NED_N "Identity, real-world value is same as binary value" IDENTICAL "%1" "" /end COMPU_METHOD
/* Measurement point for signal Validity_INS_Vel_NED_E of frame RT_SB_INS_Vel_NED_1 (9310242x, 0x8E1022x) */
/begin MEASUREMENT crt_PT_8e1022_Validity_INS_Vel_NED_E "signal Validity_INS_Vel_NED_E of frame RT_SB_INS_Vel_NED_1 (9310242x, 0x8E1022x). Valid when bit is set, invalid when bit is clear." UBYTE CONV_crt_PT_8e1022_Validity_INS_Vel_NED_E 0 0 0 1 ECU_ADDRESS 0x0000 /end MEASUREMENT
/begin COMPU_METHOD CONV_crt_PT_8e1022_Validity_INS_Vel_NED_E "Identity, real-world value is same as binary value" IDENTICAL "%1" "" /end COMPU_METHOD
/* Measurement point for signal Accuracy_INS_Vel_NE of frame RT_SB_INS_Vel_NED_1 (9310242x, 0x8E1022x) */
/begin MEASUREMENT crt_PT_8e1022_Accuracy_INS_Vel_NE "signal Accuracy_INS_Vel_NE of frame RT_SB_INS_Vel_NED_1 (9310242x, 0x8E1022x)" UBYTE CONV_crt_PT_8e1022_Accuracy_INS_Vel_NE 0 0 0 255 ECU_ADDRESS 0x0000 /end MEASUREMENT
/begin COMPU_METHOD CONV_crt_PT_8e1022_Accuracy_INS_Vel_NE "Identity, real-world value is same as binary value" IDENTICAL "%4" "" /end COMPU_METHOD
/* Measurement point for signal INS_Vel_NED_N of frame RT_SB_INS_Vel_NED_1 (9310242x, 0x8E1022x) */
/begin MEASUREMENT crt_PT_8e1022_INS_Vel_NED_N "signal INS_Vel_NED_N of frame RT_SB_INS_Vel_NED_1 (9310242x, 0x8E1022x). VELNED N velocity.  This is the velocity vector directly North at the current local Earth surface position." SLONG CONV_crt_PT_8e1022_INS_Vel_NED_N 0 0 -838.0 838.0 ECU_ADDRESS 0x0000 /end MEASUREMENT
/begin COMPU_METHOD CONV_crt_PT_8e1022_INS_Vel_NED_N "Linear scaling, used for variable crt_PT_8e1022_INS_Vel_NED_N, signal INS_Vel_NED_N" RAT_FUNC "%12" "m/s" COEFFS 0 -1 0.0 0 0 -1.0E-4 /end COMPU_METHOD
/* Measurement point for signal INS_Vel_NED_E of frame RT_SB_INS_Vel_NED_1 (9310242x, 0x8E1022x) */
/begin MEASUREMENT crt_PT_8e1022_INS_Vel_NED_E "signal INS_Vel_NED_E of frame RT_SB_INS_Vel_NED_1 (9310242x, 0x8E1022x). VELNED E velocity.  This is the velocity vector directly East at the current local Earth surface position." SLONG CONV_crt_PT_8e1022_INS_Vel_NED_E 0 0 -838.0 838.0 ECU_ADDRESS 0x0000 /end MEASUREMENT
/begin COMPU_METHOD CONV_crt_PT_8e1022_INS_Vel_NED_E "Linear scaling, used for variable crt_PT_8e1022_INS_Vel_NED_E, signal INS_Vel_NED_E" RAT_FUNC "%12" "m/s" COEFFS 0 -1 0.0 0 0 -1.0E-4 /end COMPU_METHOD
/* Measurement point for signal INS_Pos_ECEF_Y of frame RT_SB_INS_Pos_ECEF_2 (9307426x, 0x8E0522x) */
/begin MEASUREMENT crt_PT_8e0522_INS_Pos_ECEF_Y "signal INS_Pos_ECEF_Y of frame RT_SB_INS_Pos_ECEF_2 (9307426x, 0x8E0522x). ECEF Y position.  The ECEF Y axis originates from the Earth centre, and the positive Y axis intersects the Earth surface at zero degrees latittude and 90 degrees longitude." SLONG CONV_crt_PT_8e0522_INS_Pos_ECEF_Y 0 0 -1.0E7 1.0E7 ECU_ADDRESS 0x0000 /end MEASUREMENT
/begin COMPU_METHOD CONV_crt_PT_8e0522_INS_Pos_ECEF_Y "Linear scaling, used for variable crt_PT_8e0522_INS_Pos_ECEF_Y, signal INS_Pos_ECEF_Y" RAT_FUNC "%12" "m" COEFFS 0 -1 0.0 0 0 -0.01 /end COMPU_METHOD
/* Measurement point for signal INS_Pos_ECEF_Z of frame RT_SB_INS_Pos_ECEF_2 (9307426x, 0x8E0522x) */
/begin MEASUREMENT crt_PT_8e0522_INS_Pos_ECEF_Z "signal INS_Pos_ECEF_Z of frame RT_SB_INS_Pos_ECEF_2 (9307426x, 0x8E0522x). ECEF Z position.  The ECEF Z axis originates from the Earth centre, and the positive Z axis intersects the Earth surface at the North Pole." SLONG CONV_crt_PT_8e0522_INS_Pos_ECEF_Z 0 0 -1.0E7 1.0E7 ECU_ADDRESS 0x0000 /end MEASUREMENT
/begin COMPU_METHOD CONV_crt_PT_8e0522_INS_Pos_ECEF_Z "Linear scaling, used for variable crt_PT_8e0522_INS_Pos_ECEF_Z, signal INS_Pos_ECEF_Z" RAT_FUNC "%12" "m" COEFFS 0 -1 0.0 0 0 -0.01 /end COMPU_METHOD
/* Measurement point for signal Validity_INS_Pos_ECEF_X of frame RT_SB_INS_Pos_ECEF_1 (9307170x, 0x8E0422x) */
/begin MEASUREMENT crt_PT_8e0422_Validity_INS_Pos_ECEF_X "signal Validity_INS_Pos_ECEF_X of frame RT_SB_INS_Pos_ECEF_1 (9307170x, 0x8E0422x). Valid when bit is set, invalid when bit is clear." UBYTE CONV_crt_PT_8e0422_Validity_INS_Pos_ECEF_X 0 0 0 1 ECU_ADDRESS 0x0000 /end MEASUREMENT
/begin COMPU_METHOD CONV_crt_PT_8e0422_Validity_INS_Pos_ECEF_X "Identity, real-world value is same as binary value" IDENTICAL "%1" "" /end COMPU_METHOD
/* Measurement point for signal Validity_INS_Pos_ECEF_Y of frame RT_SB_INS_Pos_ECEF_1 (9307170x, 0x8E0422x) */
/begin MEASUREMENT crt_PT_8e0422_Validity_INS_Pos_ECEF_Y "signal Validity_INS_Pos_ECEF_Y of frame RT_SB_INS_Pos_ECEF_1 (9307170x, 0x8E0422x). Valid when bit is set, invalid when bit is clear." UBYTE CONV_crt_PT_8e0422_Validity_INS_Pos_ECEF_Y 0 0 0 1 ECU_ADDRESS 0x0000 /end MEASUREMENT
/begin COMPU_METHOD CONV_crt_PT_8e0422_Validity_INS_Pos_ECEF_Y "Identity, real-world value is same as binary value" IDENTICAL "%1" "" /end COMPU_METHOD
/* Measurement point for signal Validity_INS_Pos_ECEF_Z of frame RT_SB_INS_Pos_ECEF_1 (9307170x, 0x8E0422x) */
/begin MEASUREMENT crt_PT_8e0422_Validity_INS_Pos_ECEF_Z "signal Validity_INS_Pos_ECEF_Z of frame RT_SB_INS_Pos_ECEF_1 (9307170x, 0x8E0422x). Valid when bit is set, invalid when bit is clear." UBYTE CONV_crt_PT_8e0422_Validity_INS_Pos_ECEF_Z 0 0 0 1 ECU_ADDRESS 0x0000 /end MEASUREMENT
/begin COMPU_METHOD CONV_crt_PT_8e0422_Validity_INS_Pos_ECEF_Z "Identity, real-world value is same as binary value" IDENTICAL "%1" "" /end COMPU_METHOD
/* Measurement point for signal Accuracy_INS_Pos_ECEF_X of frame RT_SB_INS_Pos_ECEF_1 (9307170x, 0x8E0422x) */
/begin MEASUREMENT crt_PT_8e0422_Accuracy_INS_Pos_ECEF_X "signal Accuracy_INS_Pos_ECEF_X of frame RT_SB_INS_Pos_ECEF_1 (9307170x, 0x8E0422x). Dimensionless.  Lower values imply but do not guarantee better accuracy than higher values." UBYTE CONV_crt_PT_8e0422_Accuracy_INS_Pos_ECEF_X 0 0 0 255 ECU_ADDRESS 0x0000 /end MEASUREMENT
/begin COMPU_METHOD CONV_crt_PT_8e0422_Accuracy_INS_Pos_ECEF_X "Identity, real-world value is same as binary value" IDENTICAL "%4" "" /end COMPU_METHOD
/* Measurement point for signal Accuracy_INS_Pos_ECEF_Y of frame RT_SB_INS_Pos_ECEF_1 (9307170x, 0x8E0422x) */
/begin MEASUREMENT crt_PT_8e0422_Accuracy_INS_Pos_ECEF_Y "signal Accuracy_INS_Pos_ECEF_Y of frame RT_SB_INS_Pos_ECEF_1 (9307170x, 0x8E0422x). Dimensionless.  Lower values imply but do not guarantee better accuracy than higher values." UBYTE CONV_crt_PT_8e0422_Accuracy_INS_Pos_ECEF_Y 0 0 0 255 ECU_ADDRESS 0x0000 /end MEASUREMENT
/begin COMPU_METHOD CONV_crt_PT_8e0422_Accuracy_INS_Pos_ECEF_Y "Identity, real-world value is same as binary value" IDENTICAL "%4" "" /end COMPU_METHOD
/* Measurement point for signal Accuracy_INS_Pos_ECEF_Z of frame RT_SB_INS_Pos_ECEF_1 (9307170x, 0x8E0422x) */
/begin MEASUREMENT crt_PT_8e0422_Accuracy_INS_Pos_ECEF_Z "signal Accuracy_INS_Pos_ECEF_Z of frame RT_SB_INS_Pos_ECEF_1 (9307170x, 0x8E0422x). Dimensionless.  Lower values imply but do not guarantee better accuracy than higher values." UBYTE CONV_crt_PT_8e0422_Accuracy_INS_Pos_ECEF_Z 0 0 0 255 ECU_ADDRESS 0x0000 /end MEASUREMENT
/begin COMPU_METHOD CONV_crt_PT_8e0422_Accuracy_INS_Pos_ECEF_Z "Identity, real-world value is same as binary value" IDENTICAL "%4" "" /end COMPU_METHOD
/* Measurement point for signal INS_Pos_ECEF_X of frame RT_SB_INS_Pos_ECEF_1 (9307170x, 0x8E0422x) */
/begin MEASUREMENT crt_PT_8e0422_INS_Pos_ECEF_X "signal INS_Pos_ECEF_X of frame RT_SB_INS_Pos_ECEF_1 (9307170x, 0x8E0422x). ECEF X position.  The ECEF X axis originates from the Earth centre, and the positive X axis intersects the Earth surface at zero degrees latittude and zero degrees longitude (the intersection of the equator and the prime meridian)." SLONG CONV_crt_PT_8e0422_INS_Pos_ECEF_X 0 0 -1.0E7 1.0E7 ECU_ADDRESS 0x0000 /end MEASUREMENT
/begin COMPU_METHOD CONV_crt_PT_8e0422_INS_Pos_ECEF_X "Linear scaling, used for variable crt_PT_8e0422_INS_Pos_ECEF_X, signal INS_Pos_ECEF_X" RAT_FUNC "%12" "m" COEFFS 0 -1 0.0 0 0 -0.01 /end COMPU_METHOD
/* Measurement point for signal INS_Pos_LLH_Longitude of frame RT_SB_INS_Pos_LLH_2 (9306914x, 0x8E0322x) */
/begin MEASUREMENT crt_PT_8e0322_INS_Pos_LLH_Longitude "signal INS_Pos_LLH_Longitude of frame RT_SB_INS_Pos_LLH_2 (9306914x, 0x8E0322x)" SLONG CONV_crt_PT_8e0322_INS_Pos_LLH_Longitude 0 0 -180.0 180.0 ECU_ADDRESS 0x0000 /end MEASUREMENT
/begin COMPU_METHOD CONV_crt_PT_8e0322_INS_Pos_LLH_Longitude "Linear scaling, used for variable crt_PT_8e0322_INS_Pos_LLH_Longitude, signal INS_Pos_LLH_Longitude" RAT_FUNC "%12" "degrees" COEFFS 0 -1 0.0 0 0 -1.0E-7 /end COMPU_METHOD
/* Measurement point for signal INS_Pos_LLH_Altitude of frame RT_SB_INS_Pos_LLH_2 (9306914x, 0x8E0322x) */
/begin MEASUREMENT crt_PT_8e0322_INS_Pos_LLH_Altitude "signal INS_Pos_LLH_Altitude of frame RT_SB_INS_Pos_LLH_2 (9306914x, 0x8E0322x)" SLONG CONV_crt_PT_8e0322_INS_Pos_LLH_Altitude 0 0 -1000.0 100000.0 ECU_ADDRESS 0x0000 /end MEASUREMENT
/begin COMPU_METHOD CONV_crt_PT_8e0322_INS_Pos_LLH_Altitude "Linear scaling, used for variable crt_PT_8e0322_INS_Pos_LLH_Altitude, signal INS_Pos_LLH_Altitude" RAT_FUNC "%12" "m" COEFFS 0 -1 0.0 0 0 -0.001 /end COMPU_METHOD
/* Measurement point for signal Validity_INS_Pos_LLH_Latitude of frame RT_SB_INS_Pos_LLH_1 (9306658x, 0x8E0222x) */
/begin MEASUREMENT crt_PT_8e0222_Validity_INS_Pos_LLH_Latitude "signal Validity_INS_Pos_LLH_Latitude of frame RT_SB_INS_Pos_LLH_1 (9306658x, 0x8E0222x). Valid when bit is set, invalid when bit is clear." UBYTE CONV_crt_PT_8e0222_Validity_INS_Pos_LLH_Latitude 0 0 0 1 ECU_ADDRESS 0x0000 /end MEASUREMENT
/begin COMPU_METHOD CONV_crt_PT_8e0222_Validity_INS_Pos_LLH_Latitude "Identity, real-world value is same as binary value" IDENTICAL "%1" "" /end COMPU_METHOD
/* Measurement point for signal Validity_INS_Pos_LLH_Longitude of frame RT_SB_INS_Pos_LLH_1 (9306658x, 0x8E0222x) */
/begin MEASUREMENT crt_PT_8e0222_Validity_INS_Pos_LLH_Longitude "signal Validity_INS_Pos_LLH_Longitude of frame RT_SB_INS_Pos_LLH_1 (9306658x, 0x8E0222x). Valid when bit is set, invalid when bit is clear." UBYTE CONV_crt_PT_8e0222_Validity_INS_Pos_LLH_Longitude 0 0 0 1 ECU_ADDRESS 0x0000 /end MEASUREMENT
/begin COMPU_METHOD CONV_crt_PT_8e0222_Validity_INS_Pos_LLH_Longitude "Identity, real-world value is same as binary value" IDENTICAL "%1" "" /end COMPU_METHOD
/* Measurement point for signal Validity_INS_Pos_LLH_Altitude of frame RT_SB_INS_Pos_LLH_1 (9306658x, 0x8E0222x) */
/begin MEASUREMENT crt_PT_8e0222_Validity_INS_Pos_LLH_Altitude "signal Validity_INS_Pos_LLH_Altitude of frame RT_SB_INS_Pos_LLH_1 (9306658x, 0x8E0222x). Valid when bit is set, invalid when bit is clear." UBYTE CONV_crt_PT_8e0222_Validity_INS_Pos_LLH_Altitude 0 0 0 1 ECU_ADDRESS 0x0000 /end MEASUREMENT
/begin COMPU_METHOD CONV_crt_PT_8e0222_Validity_INS_Pos_LLH_Altitude "Identity, real-world value is same as binary value" IDENTICAL "%1" "" /end COMPU_METHOD
/* Measurement point for signal Accuracy_INS_Pos_LLH_Latitude of frame RT_SB_INS_Pos_LLH_1 (9306658x, 0x8E0222x) */
/begin MEASUREMENT crt_PT_8e0222_Accuracy_INS_Pos_LLH_Latitude "signal Accuracy_INS_Pos_LLH_Latitude of frame RT_SB_INS_Pos_LLH_1 (9306658x, 0x8E0222x). This accuracy value applies to both 2D and 3D GPS speed." UBYTE CONV_crt_PT_8e0222_Accuracy_INS_Pos_LLH_Latitude 0 0 0 255 ECU_ADDRESS 0x0000 /end MEASUREMENT
/begin COMPU_METHOD CONV_crt_PT_8e0222_Accuracy_INS_Pos_LLH_Latitude "Identity, real-world value is same as binary value" IDENTICAL "%4" "" /end COMPU_METHOD
/* Measurement point for signal Accuracy_INS_Pos_LLH_Longitude of frame RT_SB_INS_Pos_LLH_1 (9306658x, 0x8E0222x) */
/begin MEASUREMENT crt_PT_8e0222_Accuracy_INS_Pos_LLH_Longitude "signal Accuracy_INS_Pos_LLH_Longitude of frame RT_SB_INS_Pos_LLH_1 (9306658x, 0x8E0222x). This accuracy value applies to both 2D and 3D GPS speed." UBYTE CONV_crt_PT_8e0222_Accuracy_INS_Pos_LLH_Longitude 0 0 0 255 ECU_ADDRESS 0x0000 /end MEASUREMENT
/begin COMPU_METHOD CONV_crt_PT_8e0222_Accuracy_INS_Pos_LLH_Longitude "Identity, real-world value is same as binary value" IDENTICAL "%4" "" /end COMPU_METHOD
/* Measurement point for signal Accuracy_INS_Pos_LLH_Altitude of frame RT_SB_INS_Pos_LLH_1 (9306658x, 0x8E0222x) */
/begin MEASUREMENT crt_PT_8e0222_Accuracy_INS_Pos_LLH_Altitude "signal Accuracy_INS_Pos_LLH_Altitude of frame RT_SB_INS_Pos_LLH_1 (9306658x, 0x8E0222x). This accuracy value applies to both 2D and 3D GPS speed." UBYTE CONV_crt_PT_8e0222_Accuracy_INS_Pos_LLH_Altitude 0 0 0 255 ECU_ADDRESS 0x0000 /end MEASUREMENT
/begin COMPU_METHOD CONV_crt_PT_8e0222_Accuracy_INS_Pos_LLH_Altitude "Identity, real-world value is same as binary value" IDENTICAL "%4" "" /end COMPU_METHOD
/* Measurement point for signal INS_Pos_LLH_Latitude of frame RT_SB_INS_Pos_LLH_1 (9306658x, 0x8E0222x) */
/begin MEASUREMENT crt_PT_8e0222_INS_Pos_LLH_Latitude "signal INS_Pos_LLH_Latitude of frame RT_SB_INS_Pos_LLH_1 (9306658x, 0x8E0222x)" SLONG CONV_crt_PT_8e0222_INS_Pos_LLH_Latitude 0 0 -90.0 90.0 ECU_ADDRESS 0x0000 /end MEASUREMENT
/begin COMPU_METHOD CONV_crt_PT_8e0222_INS_Pos_LLH_Latitude "Linear scaling, used for variable crt_PT_8e0222_INS_Pos_LLH_Latitude, signal INS_Pos_LLH_Latitude" RAT_FUNC "%12" "degrees" COEFFS 0 -1 0.0 0 0 -1.0E-7 /end COMPU_METHOD
/* Measurement point for signal Validity_INS_Heading of frame RT_SB_INS_Heading_Gradient_2 (9311522x, 0x8E1522x) */
/begin MEASUREMENT crt_PT_8e1522_Validity_INS_Heading "signal Validity_INS_Heading of frame RT_SB_INS_Heading_Gradient_2 (9311522x, 0x8E1522x). Valid when bit is set, invalid when bit is clear." UBYTE CONV_crt_PT_8e1522_Validity_INS_Heading 0 0 0 1 ECU_ADDRESS 0x0000 /end MEASUREMENT
/begin COMPU_METHOD CONV_crt_PT_8e1522_Validity_INS_Heading "Identity, real-world value is same as binary value" IDENTICAL "%1" "" /end COMPU_METHOD
/* Measurement point for signal Validity_INS_Gradient of frame RT_SB_INS_Heading_Gradient_2 (9311522x, 0x8E1522x) */
/begin MEASUREMENT crt_PT_8e1522_Validity_INS_Gradient "signal Validity_INS_Gradient of frame RT_SB_INS_Heading_Gradient_2 (9311522x, 0x8E1522x). Valid when bit is set, invalid when bit is clear." UBYTE CONV_crt_PT_8e1522_Validity_INS_Gradient 0 0 0 1 ECU_ADDRESS 0x0000 /end MEASUREMENT
/begin COMPU_METHOD CONV_crt_PT_8e1522_Validity_INS_Gradient "Identity, real-world value is same as binary value" IDENTICAL "%1" "" /end COMPU_METHOD
/* Measurement point for signal Accuracy_INS_Heading of frame RT_SB_INS_Heading_Gradient_2 (9311522x, 0x8E1522x) */
/begin MEASUREMENT crt_PT_8e1522_Accuracy_INS_Heading "signal Accuracy_INS_Heading of frame RT_SB_INS_Heading_Gradient_2 (9311522x, 0x8E1522x). Dimensionless.  Lower values imply but do not guarantee better accuracy than higher values." UBYTE CONV_crt_PT_8e1522_Accuracy_INS_Heading 0 0 0 255 ECU_ADDRESS 0x0000 /end MEASUREMENT
/begin COMPU_METHOD CONV_crt_PT_8e1522_Accuracy_INS_Heading "Identity, real-world value is same as binary value" IDENTICAL "%4" "" /end COMPU_METHOD
/* Measurement point for signal INS_Heading_2 of frame RT_SB_INS_Heading_Gradient_2 (9311522x, 0x8E1522x) */
/begin MEASUREMENT crt_PT_8e1522_INS_Heading_2 "signal INS_Heading_2 of frame RT_SB_INS_Heading_Gradient_2 (9311522x, 0x8E1522x). This is GPS heading in the range 0 - 360., the direction that the vehicle is travelling in the local horizontal plane." UWORD CONV_crt_PT_8e1522_INS_Heading_2 0 0 0.0 360.0 ECU_ADDRESS 0x0000 /end MEASUREMENT
/begin COMPU_METHOD CONV_crt_PT_8e1522_INS_Heading_2 "Linear scaling, used for variable crt_PT_8e1522_INS_Heading_2, signal INS_Heading_2" RAT_FUNC "%6" "degrees" COEFFS 0 -1 0.0 0 0 -0.01 /end COMPU_METHOD
/* Measurement point for signal Accuracy_INS_Gradient of frame RT_SB_INS_Heading_Gradient_2 (9311522x, 0x8E1522x) */
/begin MEASUREMENT crt_PT_8e1522_Accuracy_INS_Gradient "signal Accuracy_INS_Gradient of frame RT_SB_INS_Heading_Gradient_2 (9311522x, 0x8E1522x). Dimensionless.  Lower values imply but do not guarantee better accuracy than higher values." UBYTE CONV_crt_PT_8e1522_Accuracy_INS_Gradient 0 0 0 255 ECU_ADDRESS 0x0000 /end MEASUREMENT
/begin COMPU_METHOD CONV_crt_PT_8e1522_Accuracy_INS_Gradient "Identity, real-world value is same as binary value" IDENTICAL "%4" "" /end COMPU_METHOD
/* Measurement point for signal INS_Gradient of frame RT_SB_INS_Heading_Gradient_2 (9311522x, 0x8E1522x) */
/begin MEASUREMENT crt_PT_8e1522_INS_Gradient "signal INS_Gradient of frame RT_SB_INS_Heading_Gradient_2 (9311522x, 0x8E1522x). This is GPS gradient, i.e. the vertical direction that the vehicle is travelling, NOT pointing (pitch)." SWORD CONV_crt_PT_8e1522_INS_Gradient 0 0 -90.0 90.0 ECU_ADDRESS 0x0000 /end MEASUREMENT
/begin COMPU_METHOD CONV_crt_PT_8e1522_INS_Gradient "Linear scaling, used for variable crt_PT_8e1522_INS_Gradient, signal INS_Gradient" RAT_FUNC "%6" "degrees" COEFFS 0 -1 0.0 0 0 -0.01 /end COMPU_METHOD
/* Measurement point for signal Validity_INS_Heading of frame RT_SB_INS_Heading_Gradient (9311266x, 0x8E1422x) */
/begin MEASUREMENT crt_PT_8e1422_Validity_INS_Heading "signal Validity_INS_Heading of frame RT_SB_INS_Heading_Gradient (9311266x, 0x8E1422x). Valid when bit is set, invalid when bit is clear." UBYTE CONV_crt_PT_8e1422_Validity_INS_Heading 0 0 0 1 ECU_ADDRESS 0x0000 /end MEASUREMENT
/begin COMPU_METHOD CONV_crt_PT_8e1422_Validity_INS_Heading "Identity, real-world value is same as binary value" IDENTICAL "%1" "" /end COMPU_METHOD
/* Measurement point for signal Validity_INS_Gradient of frame RT_SB_INS_Heading_Gradient (9311266x, 0x8E1422x) */
/begin MEASUREMENT crt_PT_8e1422_Validity_INS_Gradient "signal Validity_INS_Gradient of frame RT_SB_INS_Heading_Gradient (9311266x, 0x8E1422x). Valid when bit is set, invalid when bit is clear." UBYTE CONV_crt_PT_8e1422_Validity_INS_Gradient 0 0 0 1 ECU_ADDRESS 0x0000 /end MEASUREMENT
/begin COMPU_METHOD CONV_crt_PT_8e1422_Validity_INS_Gradient "Identity, real-world value is same as binary value" IDENTICAL "%1" "" /end COMPU_METHOD
/* Measurement point for signal Accuracy_INS_Heading of frame RT_SB_INS_Heading_Gradient (9311266x, 0x8E1422x) */
/begin MEASUREMENT crt_PT_8e1422_Accuracy_INS_Heading "signal Accuracy_INS_Heading of frame RT_SB_INS_Heading_Gradient (9311266x, 0x8E1422x). Dimensionless.  Lower values imply but do not guarantee better accuracy than higher values." UBYTE CONV_crt_PT_8e1422_Accuracy_INS_Heading 0 0 0 255 ECU_ADDRESS 0x0000 /end MEASUREMENT
/begin COMPU_METHOD CONV_crt_PT_8e1422_Accuracy_INS_Heading "Identity, real-world value is same as binary value" IDENTICAL "%4" "" /end COMPU_METHOD
/* Measurement point for signal INS_Heading of frame RT_SB_INS_Heading_Gradient (9311266x, 0x8E1422x) */
/begin MEASUREMENT crt_PT_8e1422_INS_Heading "signal INS_Heading of frame RT_SB_INS_Heading_Gradient (9311266x, 0x8E1422x). This is GPS heading, the direction that the vehicle is travelling in the local horizontal plane." SWORD CONV_crt_PT_8e1422_INS_Heading 0 0 -180.0 180.0 ECU_ADDRESS 0x0000 /end MEASUREMENT
/begin COMPU_METHOD CONV_crt_PT_8e1422_INS_Heading "Linear scaling, used for variable crt_PT_8e1422_INS_Heading, signal INS_Heading" RAT_FUNC "%6" "degrees" COEFFS 0 -1 0.0 0 0 -0.01 /end COMPU_METHOD
/* Measurement point for signal Accuracy_INS_Gradient of frame RT_SB_INS_Heading_Gradient (9311266x, 0x8E1422x) */
/begin MEASUREMENT crt_PT_8e1422_Accuracy_INS_Gradient "signal Accuracy_INS_Gradient of frame RT_SB_INS_Heading_Gradient (9311266x, 0x8E1422x). Dimensionless.  Lower values imply but do not guarantee better accuracy than higher values." UBYTE CONV_crt_PT_8e1422_Accuracy_INS_Gradient 0 0 0 255 ECU_ADDRESS 0x0000 /end MEASUREMENT
/begin COMPU_METHOD CONV_crt_PT_8e1422_Accuracy_INS_Gradient "Identity, real-world value is same as binary value" IDENTICAL "%4" "" /end COMPU_METHOD
/* Measurement point for signal INS_Gradient of frame RT_SB_INS_Heading_Gradient (9311266x, 0x8E1422x) */
/begin MEASUREMENT crt_PT_8e1422_INS_Gradient "signal INS_Gradient of frame RT_SB_INS_Heading_Gradient (9311266x, 0x8E1422x). This is GPS gradient, i.e. the vertical direction that the vehicle is travelling, NOT pointing (pitch)." SWORD CONV_crt_PT_8e1422_INS_Gradient 0 0 -90.0 90.0 ECU_ADDRESS 0x0000 /end MEASUREMENT
/begin COMPU_METHOD CONV_crt_PT_8e1422_INS_Gradient "Linear scaling, used for variable crt_PT_8e1422_INS_Gradient, signal INS_Gradient" RAT_FUNC "%6" "degrees" COEFFS 0 -1 0.0 0 0 -0.01 /end COMPU_METHOD
/* Measurement point for signal INS_Status of frame RT_SB_INS_Status (9306146x, 0x8E0022x) */
/begin MEASUREMENT crt_PT_8e0022_INS_Status "signal INS_Status of frame RT_SB_INS_Status (9306146x, 0x8E0022x)" UBYTE CONV_crt_PT_8e0022_INS_Status 0 0 0 255 ECU_ADDRESS 0x0000 /end MEASUREMENT
/begin COMPU_METHOD CONV_crt_PT_8e0022_INS_Status "Identity, real-world value is same as binary value" IDENTICAL "%4" "" /end COMPU_METHOD
/* Measurement point for signal Validity_Yaw of frame RT_SB_INS_Attitude (9306402x, 0x8E0122x) */
/begin MEASUREMENT crt_PT_8e0122_Validity_Yaw "signal Validity_Yaw of frame RT_SB_INS_Attitude (9306402x, 0x8E0122x)" UBYTE CONV_crt_PT_8e0122_Validity_Yaw 0 0 0 1 ECU_ADDRESS 0x0000 /end MEASUREMENT
/begin COMPU_METHOD CONV_crt_PT_8e0122_Validity_Yaw "Identity, real-world value is same as binary value" IDENTICAL "%1" "" /end COMPU_METHOD
/* Measurement point for signal Validity_Pitch of frame RT_SB_INS_Attitude (9306402x, 0x8E0122x) */
/begin MEASUREMENT crt_PT_8e0122_Validity_Pitch "signal Validity_Pitch of frame RT_SB_INS_Attitude (9306402x, 0x8E0122x)" UBYTE CONV_crt_PT_8e0122_Validity_Pitch 0 0 0 1 ECU_ADDRESS 0x0000 /end MEASUREMENT
/begin COMPU_METHOD CONV_crt_PT_8e0122_Validity_Pitch "Identity, real-world value is same as binary value" IDENTICAL "%1" "" /end COMPU_METHOD
/* Measurement point for signal Validity_Roll of frame RT_SB_INS_Attitude (9306402x, 0x8E0122x) */
/begin MEASUREMENT crt_PT_8e0122_Validity_Roll "signal Validity_Roll of frame RT_SB_INS_Attitude (9306402x, 0x8E0122x)" UBYTE CONV_crt_PT_8e0122_Validity_Roll 0 0 0 1 ECU_ADDRESS 0x0000 /end MEASUREMENT
/begin COMPU_METHOD CONV_crt_PT_8e0122_Validity_Roll "Identity, real-world value is same as binary value" IDENTICAL "%1" "" /end COMPU_METHOD
/* Measurement point for signal Accuracy_Attitude of frame RT_SB_INS_Attitude (9306402x, 0x8E0122x) */
/begin MEASUREMENT crt_PT_8e0122_Accuracy_Attitude "signal Accuracy_Attitude of frame RT_SB_INS_Attitude (9306402x, 0x8E0122x)" UBYTE CONV_crt_PT_8e0122_Accuracy_Attitude 0 0 0 255 ECU_ADDRESS 0x0000 /end MEASUREMENT
/begin COMPU_METHOD CONV_crt_PT_8e0122_Accuracy_Attitude "Identity, real-world value is same as binary value" IDENTICAL "%4" "" /end COMPU_METHOD
/* Measurement point for signal Attitude_Yaw of frame RT_SB_INS_Attitude (9306402x, 0x8E0122x) */
/begin MEASUREMENT crt_PT_8e0122_Attitude_Yaw "signal Attitude_Yaw of frame RT_SB_INS_Attitude (9306402x, 0x8E0122x)" SWORD CONV_crt_PT_8e0122_Attitude_Yaw 0 0 -360.0 360.0 ECU_ADDRESS 0x0000 /end MEASUREMENT
/begin COMPU_METHOD CONV_crt_PT_8e0122_Attitude_Yaw "Linear scaling, used for variable crt_PT_8e0122_Attitude_Yaw, signal Attitude_Yaw" RAT_FUNC "%6" "degrees" COEFFS 0 -1 0.0 0 0 -0.01 /end COMPU_METHOD
/* Measurement point for signal Attitude_Pitch of frame RT_SB_INS_Attitude (9306402x, 0x8E0122x) */
/begin MEASUREMENT crt_PT_8e0122_Attitude_Pitch "signal Attitude_Pitch of frame RT_SB_INS_Attitude (9306402x, 0x8E0122x)" SWORD CONV_crt_PT_8e0122_Attitude_Pitch 0 0 -360.0 360.0 ECU_ADDRESS 0x0000 /end MEASUREMENT
/begin COMPU_METHOD CONV_crt_PT_8e0122_Attitude_Pitch "Linear scaling, used for variable crt_PT_8e0122_Attitude_Pitch, signal Attitude_Pitch" RAT_FUNC "%6" "degrees" COEFFS 0 -1 0.0 0 0 -0.01 /end COMPU_METHOD
/* Measurement point for signal Attitude_Roll of frame RT_SB_INS_Attitude (9306402x, 0x8E0122x) */
/begin MEASUREMENT crt_PT_8e0122_Attitude_Roll "signal Attitude_Roll of frame RT_SB_INS_Attitude (9306402x, 0x8E0122x)" SWORD CONV_crt_PT_8e0122_Attitude_Roll 0 0 -360.0 360.0 ECU_ADDRESS 0x0000 /end MEASUREMENT
/begin COMPU_METHOD CONV_crt_PT_8e0122_Attitude_Roll "Linear scaling, used for variable crt_PT_8e0122_Attitude_Roll, signal Attitude_Roll" RAT_FUNC "%6" "degrees" COEFFS 0 -1 0.0 0 0 -0.01 /end COMPU_METHOD
/* Measurement point for signal Validity_Status_Timestamp of frame RT_SB_Output_Status (9240866x, 0x8D0122x) */
/begin MEASUREMENT crt_PT_8d0122_Validity_Status_Timestamp "signal Validity_Status_Timestamp of frame RT_SB_Output_Status (9240866x, 0x8D0122x). Valid when bit is set, invalid when bit is clear." UBYTE CONV_crt_PT_8d0122_Validity_Status_Timestamp 0 0 0 1 ECU_ADDRESS 0x0000 /end MEASUREMENT
/begin COMPU_METHOD CONV_crt_PT_8d0122_Validity_Status_Timestamp "Identity, real-world value is same as binary value" IDENTICAL "%1" "" /end COMPU_METHOD
/* Measurement point for signal Status_Analogue_1 of frame RT_SB_Output_Status (9240866x, 0x8D0122x) */
/begin MEASUREMENT crt_PT_8d0122_Status_Analogue_1 "signal Status_Analogue_1 of frame RT_SB_Output_Status (9240866x, 0x8D0122x). Analogue output status for channel 1." UBYTE CONV_crt_PT_8d0122_Status_Analogue_1 0 0 0 1 ECU_ADDRESS 0x0000 /end MEASUREMENT
/begin COMPU_METHOD CONV_crt_PT_8d0122_Status_Analogue_1 "Identity, real-world value is same as binary value" IDENTICAL "%1" "" /end COMPU_METHOD
/* Measurement point for signal Status_Analogue_2 of frame RT_SB_Output_Status (9240866x, 0x8D0122x) */
/begin MEASUREMENT crt_PT_8d0122_Status_Analogue_2 "signal Status_Analogue_2 of frame RT_SB_Output_Status (9240866x, 0x8D0122x). Analogue output status for channel 1." UBYTE CONV_crt_PT_8d0122_Status_Analogue_2 0 0 0 1 ECU_ADDRESS 0x0000 /end MEASUREMENT
/begin COMPU_METHOD CONV_crt_PT_8d0122_Status_Analogue_2 "Identity, real-world value is same as binary value" IDENTICAL "%1" "" /end COMPU_METHOD
/* Measurement point for signal Status_Analogue_3 of frame RT_SB_Output_Status (9240866x, 0x8D0122x) */
/begin MEASUREMENT crt_PT_8d0122_Status_Analogue_3 "signal Status_Analogue_3 of frame RT_SB_Output_Status (9240866x, 0x8D0122x). Analogue output status for channel 3." UBYTE CONV_crt_PT_8d0122_Status_Analogue_3 0 0 0 1 ECU_ADDRESS 0x0000 /end MEASUREMENT
/begin COMPU_METHOD CONV_crt_PT_8d0122_Status_Analogue_3 "Identity, real-world value is same as binary value" IDENTICAL "%1" "" /end COMPU_METHOD
/* Measurement point for signal Status_Analogue_4 of frame RT_SB_Output_Status (9240866x, 0x8D0122x) */
/begin MEASUREMENT crt_PT_8d0122_Status_Analogue_4 "signal Status_Analogue_4 of frame RT_SB_Output_Status (9240866x, 0x8D0122x). Analogue output status for channel 4." UBYTE CONV_crt_PT_8d0122_Status_Analogue_4 0 0 0 1 ECU_ADDRESS 0x0000 /end MEASUREMENT
/begin COMPU_METHOD CONV_crt_PT_8d0122_Status_Analogue_4 "Identity, real-world value is same as binary value" IDENTICAL "%1" "" /end COMPU_METHOD
/* Measurement point for signal Status_Pulse_Output of frame RT_SB_Output_Status (9240866x, 0x8D0122x) */
/begin MEASUREMENT crt_PT_8d0122_Status_Pulse_Output "signal Status_Pulse_Output of frame RT_SB_Output_Status (9240866x, 0x8D0122x). Pulse output activity status" UBYTE CONV_crt_PT_8d0122_Status_Pulse_Output 0 0 0 1 ECU_ADDRESS 0x0000 /end MEASUREMENT
/begin COMPU_METHOD CONV_crt_PT_8d0122_Status_Pulse_Output "Identity, real-world value is same as binary value" IDENTICAL "%1" "" /end COMPU_METHOD
/* Measurement point for signal Status_Serial_Output_1 of frame RT_SB_Output_Status (9240866x, 0x8D0122x) */
/begin MEASUREMENT crt_PT_8d0122_Status_Serial_Output_1 "signal Status_Serial_Output_1 of frame RT_SB_Output_Status (9240866x, 0x8D0122x). Status output of serial port 1" UBYTE CONV_crt_PT_8d0122_Status_Serial_Output_1 0 0 0 1 ECU_ADDRESS 0x0000 /end MEASUREMENT
/begin COMPU_METHOD CONV_crt_PT_8d0122_Status_Serial_Output_1 "Identity, real-world value is same as binary value" IDENTICAL "%1" "" /end COMPU_METHOD
/* Measurement point for signal Status_Serial_Output_2 of frame RT_SB_Output_Status (9240866x, 0x8D0122x) */
/begin MEASUREMENT crt_PT_8d0122_Status_Serial_Output_2 "signal Status_Serial_Output_2 of frame RT_SB_Output_Status (9240866x, 0x8D0122x). Status output of serial port 1" UBYTE CONV_crt_PT_8d0122_Status_Serial_Output_2 0 0 0 1 ECU_ADDRESS 0x0000 /end MEASUREMENT
/begin COMPU_METHOD CONV_crt_PT_8d0122_Status_Serial_Output_2 "Identity, real-world value is same as binary value" IDENTICAL "%1" "" /end COMPU_METHOD
/* Measurement point for signal Status_Trigger of frame RT_SB_Output_Status (9240866x, 0x8D0122x) */
/begin MEASUREMENT crt_PT_8d0122_Status_Trigger "signal Status_Trigger of frame RT_SB_Output_Status (9240866x, 0x8D0122x). Status of the trigger input" UBYTE CONV_crt_PT_8d0122_Status_Trigger 0 0 0 1 ECU_ADDRESS 0x0000 /end MEASUREMENT
/begin COMPU_METHOD CONV_crt_PT_8d0122_Status_Trigger "Identity, real-world value is same as binary value" IDENTICAL "%1" "" /end COMPU_METHOD
/* Measurement point for signal GPS_Time of frame RT_SB_Output_Status (9240866x, 0x8D0122x) */
/begin MEASUREMENT crt_PT_8d0122_GPS_Time "signal GPS_Time of frame RT_SB_Output_Status (9240866x, 0x8D0122x). GPS time is the time in seconds since midnight GMT on Saturday night." ULONG CONV_crt_PT_8d0122_GPS_Time 0 0 0.0 604800.0 ECU_ADDRESS 0x0000 /end MEASUREMENT
/begin COMPU_METHOD CONV_crt_PT_8d0122_GPS_Time "Linear scaling, used for variable crt_PT_8d0122_GPS_Time, signal GPS_Time" RAT_FUNC "%12" "s" COEFFS 0 -1 0.0 0 0 -0.001 /end COMPU_METHOD
/* Measurement point for signal Validity_GPS_Heading of frame RT_SB_GPS_Heading_Gradient_2 (9180706x, 0x8C1622x) */
/begin MEASUREMENT crt_PT_8c1622_Validity_GPS_Heading "signal Validity_GPS_Heading of frame RT_SB_GPS_Heading_Gradient_2 (9180706x, 0x8C1622x). Valid when bit is set, invalid when bit is clear." UBYTE CONV_crt_PT_8c1622_Validity_GPS_Heading 0 0 0 1 ECU_ADDRESS 0x0000 /end MEASUREMENT
/begin COMPU_METHOD CONV_crt_PT_8c1622_Validity_GPS_Heading "Identity, real-world value is same as binary value" IDENTICAL "%1" "" /end COMPU_METHOD
/* Measurement point for signal Validity_GPS_Gradient of frame RT_SB_GPS_Heading_Gradient_2 (9180706x, 0x8C1622x) */
/begin MEASUREMENT crt_PT_8c1622_Validity_GPS_Gradient "signal Validity_GPS_Gradient of frame RT_SB_GPS_Heading_Gradient_2 (9180706x, 0x8C1622x). Valid when bit is set, invalid when bit is clear." UBYTE CONV_crt_PT_8c1622_Validity_GPS_Gradient 0 0 0 1 ECU_ADDRESS 0x0000 /end MEASUREMENT
/begin COMPU_METHOD CONV_crt_PT_8c1622_Validity_GPS_Gradient "Identity, real-world value is same as binary value" IDENTICAL "%1" "" /end COMPU_METHOD
/* Measurement point for signal Accuracy_GPS_Heading of frame RT_SB_GPS_Heading_Gradient_2 (9180706x, 0x8C1622x) */
/begin MEASUREMENT crt_PT_8c1622_Accuracy_GPS_Heading "signal Accuracy_GPS_Heading of frame RT_SB_GPS_Heading_Gradient_2 (9180706x, 0x8C1622x). Dimensionless.  Lower values imply but do not guarantee better accuracy than higher values." UBYTE CONV_crt_PT_8c1622_Accuracy_GPS_Heading 0 0 0 255 ECU_ADDRESS 0x0000 /end MEASUREMENT
/begin COMPU_METHOD CONV_crt_PT_8c1622_Accuracy_GPS_Heading "Identity, real-world value is same as binary value" IDENTICAL "%4" "" /end COMPU_METHOD
/* Measurement point for signal GPS_Heading_2 of frame RT_SB_GPS_Heading_Gradient_2 (9180706x, 0x8C1622x) */
/begin MEASUREMENT crt_PT_8c1622_GPS_Heading_2 "signal GPS_Heading_2 of frame RT_SB_GPS_Heading_Gradient_2 (9180706x, 0x8C1622x). This is GPS heading in the range 0 - 360., the direction that the vehicle is travelling in the local horizontal plane." UWORD CONV_crt_PT_8c1622_GPS_Heading_2 0 0 0.0 360.0 ECU_ADDRESS 0x0000 /end MEASUREMENT
/begin COMPU_METHOD CONV_crt_PT_8c1622_GPS_Heading_2 "Linear scaling, used for variable crt_PT_8c1622_GPS_Heading_2, signal GPS_Heading_2" RAT_FUNC "%6" "degrees" COEFFS 0 -1 0.0 0 0 -0.01 /end COMPU_METHOD
/* Measurement point for signal Accuracy_GPS_Gradient of frame RT_SB_GPS_Heading_Gradient_2 (9180706x, 0x8C1622x) */
/begin MEASUREMENT crt_PT_8c1622_Accuracy_GPS_Gradient "signal Accuracy_GPS_Gradient of frame RT_SB_GPS_Heading_Gradient_2 (9180706x, 0x8C1622x). Dimensionless.  Lower values imply but do not guarantee better accuracy than higher values." UBYTE CONV_crt_PT_8c1622_Accuracy_GPS_Gradient 0 0 0 255 ECU_ADDRESS 0x0000 /end MEASUREMENT
/begin COMPU_METHOD CONV_crt_PT_8c1622_Accuracy_GPS_Gradient "Identity, real-world value is same as binary value" IDENTICAL "%4" "" /end COMPU_METHOD
/* Measurement point for signal GPS_Gradient of frame RT_SB_GPS_Heading_Gradient_2 (9180706x, 0x8C1622x) */
/begin MEASUREMENT crt_PT_8c1622_GPS_Gradient "signal GPS_Gradient of frame RT_SB_GPS_Heading_Gradient_2 (9180706x, 0x8C1622x). This is GPS gradient, i.e. the vertical direction that the vehicle is travelling, NOT pointing (pitch)." SWORD CONV_crt_PT_8c1622_GPS_Gradient 0 0 -90.0 90.0 ECU_ADDRESS 0x0000 /end MEASUREMENT
/begin COMPU_METHOD CONV_crt_PT_8c1622_GPS_Gradient "Linear scaling, used for variable crt_PT_8c1622_GPS_Gradient, signal GPS_Gradient" RAT_FUNC "%6" "degrees" COEFFS 0 -1 0.0 0 0 -0.01 /end COMPU_METHOD
/* Measurement point for signal Validity_Cumulative_Time of frame RT_SB_Cumulative_Distance_2 (8397090x, 0x802122x) */
/begin MEASUREMENT crt_PT_802122_Validity_Cumulative_Time "signal Validity_Cumulative_Time of frame RT_SB_Cumulative_Distance_2 (8397090x, 0x802122x). Valid when bit is set, invalid when bit is clear." UBYTE CONV_crt_PT_802122_Validity_Cumulative_Time 0 0 0 1 ECU_ADDRESS 0x0000 /end MEASUREMENT
/begin COMPU_METHOD CONV_crt_PT_802122_Validity_Cumulative_Time "Identity, real-world value is same as binary value" IDENTICAL "%1" "" /end COMPU_METHOD
/* Measurement point for signal Validity_Cumulative_Distance of frame RT_SB_Cumulative_Distance_2 (8397090x, 0x802122x) */
/begin MEASUREMENT crt_PT_802122_Validity_Cumulative_Distance "signal Validity_Cumulative_Distance of frame RT_SB_Cumulative_Distance_2 (8397090x, 0x802122x). Valid when bit is set, invalid when bit is clear." UBYTE CONV_crt_PT_802122_Validity_Cumulative_Distance 0 0 0 1 ECU_ADDRESS 0x0000 /end MEASUREMENT
/begin COMPU_METHOD CONV_crt_PT_802122_Validity_Cumulative_Distance "Identity, real-world value is same as binary value" IDENTICAL "%1" "" /end COMPU_METHOD
/* Measurement point for signal Cumulative_Time of frame RT_SB_Cumulative_Distance_2 (8397090x, 0x802122x) */
/begin MEASUREMENT crt_PT_802122_Cumulative_Time "signal Cumulative_Time of frame RT_SB_Cumulative_Distance_2 (8397090x, 0x802122x)" ULONG CONV_crt_PT_802122_Cumulative_Time 0 0 0.0 167772.0 ECU_ADDRESS 0x0000 /end MEASUREMENT
/begin COMPU_METHOD CONV_crt_PT_802122_Cumulative_Time "Linear scaling, used for variable crt_PT_802122_Cumulative_Time, signal Cumulative_Time" RAT_FUNC "%12" "s" COEFFS 0 -1 0.0 0 0 -0.01 /end COMPU_METHOD
/* Measurement point for signal Cumulative_Distance of frame RT_SB_Cumulative_Distance_2 (8397090x, 0x802122x) */
/begin MEASUREMENT crt_PT_802122_Cumulative_Distance "signal Cumulative_Distance of frame RT_SB_Cumulative_Distance_2 (8397090x, 0x802122x)" ULONG CONV_crt_PT_802122_Cumulative_Distance 0 0 0.0 4294970.0 ECU_ADDRESS 0x0000 /end MEASUREMENT
/begin COMPU_METHOD CONV_crt_PT_802122_Cumulative_Distance "Linear scaling, used for variable crt_PT_802122_Cumulative_Distance, signal Cumulative_Distance" RAT_FUNC "%12" "m" COEFFS 0 -1 0.0 0 0 -0.001 /end COMPU_METHOD
/* Measurement point for signal Validity_Cumulative_Time of frame RT_SB_Cumulative_Distance_1 (8396834x, 0x802022x) */
/begin MEASUREMENT crt_PT_802022_Validity_Cumulative_Time "signal Validity_Cumulative_Time of frame RT_SB_Cumulative_Distance_1 (8396834x, 0x802022x). Valid when bit is set, invalid when bit is clear." UBYTE CONV_crt_PT_802022_Validity_Cumulative_Time 0 0 0 1 ECU_ADDRESS 0x0000 /end MEASUREMENT
/begin COMPU_METHOD CONV_crt_PT_802022_Validity_Cumulative_Time "Identity, real-world value is same as binary value" IDENTICAL "%1" "" /end COMPU_METHOD
/* Measurement point for signal Validity_Cumulative_Distance of frame RT_SB_Cumulative_Distance_1 (8396834x, 0x802022x) */
/begin MEASUREMENT crt_PT_802022_Validity_Cumulative_Distance "signal Validity_Cumulative_Distance of frame RT_SB_Cumulative_Distance_1 (8396834x, 0x802022x). Valid when bit is set, invalid when bit is clear." UBYTE CONV_crt_PT_802022_Validity_Cumulative_Distance 0 0 0 1 ECU_ADDRESS 0x0000 /end MEASUREMENT
/begin COMPU_METHOD CONV_crt_PT_802022_Validity_Cumulative_Distance "Identity, real-world value is same as binary value" IDENTICAL "%1" "" /end COMPU_METHOD
/* Measurement point for signal Cumulative_Time of frame RT_SB_Cumulative_Distance_1 (8396834x, 0x802022x) */
/begin MEASUREMENT crt_PT_802022_Cumulative_Time "signal Cumulative_Time of frame RT_SB_Cumulative_Distance_1 (8396834x, 0x802022x)" ULONG CONV_crt_PT_802022_Cumulative_Time 0 0 0.0 167772.0 ECU_ADDRESS 0x0000 /end MEASUREMENT
/begin COMPU_METHOD CONV_crt_PT_802022_Cumulative_Time "Linear scaling, used for variable crt_PT_802022_Cumulative_Time, signal Cumulative_Time" RAT_FUNC "%12" "s" COEFFS 0 -1 0.0 0 0 -0.01 /end COMPU_METHOD
/* Measurement point for signal Cumulative_Distance of frame RT_SB_Cumulative_Distance_1 (8396834x, 0x802022x) */
/begin MEASUREMENT crt_PT_802022_Cumulative_Distance "signal Cumulative_Distance of frame RT_SB_Cumulative_Distance_1 (8396834x, 0x802022x)" ULONG CONV_crt_PT_802022_Cumulative_Distance 0 0 0.0 4294970.0 ECU_ADDRESS 0x0000 /end MEASUREMENT
/begin COMPU_METHOD CONV_crt_PT_802022_Cumulative_Distance "Linear scaling, used for variable crt_PT_802022_Cumulative_Distance, signal Cumulative_Distance" RAT_FUNC "%12" "m" COEFFS 0 -1 0.0 0 0 -0.001 /end COMPU_METHOD
/* Measurement point for signal Validity_Trigger_Timestamp of frame RT_SB_Trigger_Timestamp (9240610x, 0x8D0022x) */
/begin MEASUREMENT crt_PT_8d0022_Validity_Trigger_Timestamp "signal Validity_Trigger_Timestamp of frame RT_SB_Trigger_Timestamp (9240610x, 0x8D0022x). Valid when bit is set, invalid when bit is clear." UBYTE CONV_crt_PT_8d0022_Validity_Trigger_Timestamp 0 0 0 1 ECU_ADDRESS 0x0000 /end MEASUREMENT
/begin COMPU_METHOD CONV_crt_PT_8d0022_Validity_Trigger_Timestamp "Identity, real-world value is same as binary value" IDENTICAL "%1" "" /end COMPU_METHOD
/* Measurement point for signal Accuracy_Trigger_Timestamp of frame RT_SB_Trigger_Timestamp (9240610x, 0x8D0022x) */
/begin MEASUREMENT crt_PT_8d0022_Accuracy_Trigger_Timestamp "signal Accuracy_Trigger_Timestamp of frame RT_SB_Trigger_Timestamp (9240610x, 0x8D0022x). Dimensionless.  Lower values imply but do not guarantee better accuracy than higher values." UBYTE CONV_crt_PT_8d0022_Accuracy_Trigger_Timestamp 0 0 0 255 ECU_ADDRESS 0x0000 /end MEASUREMENT
/begin COMPU_METHOD CONV_crt_PT_8d0022_Accuracy_Trigger_Timestamp "Identity, real-world value is same as binary value" IDENTICAL "%4" "" /end COMPU_METHOD
/* Measurement point for signal Trigger_Number of frame RT_SB_Trigger_Timestamp (9240610x, 0x8D0022x) */
/begin MEASUREMENT crt_PT_8d0022_Trigger_Number "signal Trigger_Number of frame RT_SB_Trigger_Timestamp (9240610x, 0x8D0022x). This is the ID of the trigger that generated the event, as marked on the case of the logger" UBYTE CONV_crt_PT_8d0022_Trigger_Number 0 0 0.0 128.0 ECU_ADDRESS 0x0000 /end MEASUREMENT
/begin COMPU_METHOD CONV_crt_PT_8d0022_Trigger_Number "Linear scaling, used for variable crt_PT_8d0022_Trigger_Number, signal Trigger_Number" RAT_FUNC "%4" "" COEFFS 0 -1 1.0 0 0 -1.0 /end COMPU_METHOD
/* Measurement point for signal Trigger_Timestamp_Type of frame RT_SB_Trigger_Timestamp (9240610x, 0x8D0022x) */
/begin MEASUREMENT crt_PT_8d0022_Trigger_Timestamp_Type "signal Trigger_Timestamp_Type of frame RT_SB_Trigger_Timestamp (9240610x, 0x8D0022x)" UBYTE CONV_crt_PT_8d0022_Trigger_Timestamp_Type 0 0 0 1 ECU_ADDRESS 0x0000 /end MEASUREMENT
/begin COMPU_METHOD CONV_crt_PT_8d0022_Trigger_Timestamp_Type "Identity, real-world value is same as binary value" IDENTICAL "%1" "" /end COMPU_METHOD
/* Measurement point for signal GPS_High_Resolution_Time of frame RT_SB_Trigger_Timestamp (9240610x, 0x8D0022x) */
/begin MEASUREMENT crt_PT_8d0022_GPS_High_Resolution_Time "signal GPS_High_Resolution_Time of frame RT_SB_Trigger_Timestamp (9240610x, 0x8D0022x). GPS time of week to micro-second resolution." A_UINT64 CONV_crt_PT_8d0022_GPS_High_Resolution_Time 0 0 0.0 604800.0 ECU_ADDRESS 0x0000 /end MEASUREMENT
/begin COMPU_METHOD CONV_crt_PT_8d0022_GPS_High_Resolution_Time "Linear scaling, used for variable crt_PT_8d0022_GPS_High_Resolution_Time, signal GPS_High_Resolution_Time" RAT_FUNC "%24" "s" COEFFS 0 -1 0.0 0 0 -1.0E-6 /end COMPU_METHOD
/* Measurement point for signal Validity_Gyro_Rate_Yaw of frame RT_IMU06_Gyro_Rates (8388897x, 0x800121x) */
/begin MEASUREMENT crt_PT_800121_Validity_Gyro_Rate_Yaw "signal Validity_Gyro_Rate_Yaw of frame RT_IMU06_Gyro_Rates (8388897x, 0x800121x). Valid when bit is set, invalid when bit is clear." UBYTE CONV_crt_PT_800121_Validity_Gyro_Rate_Yaw 0 0 0 1 ECU_ADDRESS 0x0000 /end MEASUREMENT
/begin COMPU_METHOD CONV_crt_PT_800121_Validity_Gyro_Rate_Yaw "Identity, real-world value is same as binary value" IDENTICAL "%1" "" /end COMPU_METHOD
/* Measurement point for signal Validity_Gyro_Rate_Pitch of frame RT_IMU06_Gyro_Rates (8388897x, 0x800121x) */
/begin MEASUREMENT crt_PT_800121_Validity_Gyro_Rate_Pitch "signal Validity_Gyro_Rate_Pitch of frame RT_IMU06_Gyro_Rates (8388897x, 0x800121x). Valid when bit is set, invalid when bit is clear." UBYTE CONV_crt_PT_800121_Validity_Gyro_Rate_Pitch 0 0 0 1 ECU_ADDRESS 0x0000 /end MEASUREMENT
/begin COMPU_METHOD CONV_crt_PT_800121_Validity_Gyro_Rate_Pitch "Identity, real-world value is same as binary value" IDENTICAL "%1" "" /end COMPU_METHOD
/* Measurement point for signal Validity_Gyro_Rate_Roll of frame RT_IMU06_Gyro_Rates (8388897x, 0x800121x) */
/begin MEASUREMENT crt_PT_800121_Validity_Gyro_Rate_Roll "signal Validity_Gyro_Rate_Roll of frame RT_IMU06_Gyro_Rates (8388897x, 0x800121x). Valid when bit is set, invalid when bit is clear." UBYTE CONV_crt_PT_800121_Validity_Gyro_Rate_Roll 0 0 0 1 ECU_ADDRESS 0x0000 /end MEASUREMENT
/begin COMPU_METHOD CONV_crt_PT_800121_Validity_Gyro_Rate_Roll "Identity, real-world value is same as binary value" IDENTICAL "%1" "" /end COMPU_METHOD
/* Measurement point for signal Accuracy_Gyro_Rates of frame RT_IMU06_Gyro_Rates (8388897x, 0x800121x) */
/begin MEASUREMENT crt_PT_800121_Accuracy_Gyro_Rates "signal Accuracy_Gyro_Rates of frame RT_IMU06_Gyro_Rates (8388897x, 0x800121x). Dimensionless.  Lower values imply but do not guarantee better accuracy than higher values." UBYTE CONV_crt_PT_800121_Accuracy_Gyro_Rates 0 0 0 0 ECU_ADDRESS 0x0000 /end MEASUREMENT
/begin COMPU_METHOD CONV_crt_PT_800121_Accuracy_Gyro_Rates "Identity, real-world value is same as binary value" IDENTICAL "%4" "" /end COMPU_METHOD
/* Measurement point for signal Gyro_Rate_Yaw of frame RT_IMU06_Gyro_Rates (8388897x, 0x800121x) */
/begin MEASUREMENT crt_PT_800121_Gyro_Rate_Yaw "signal Gyro_Rate_Yaw of frame RT_IMU06_Gyro_Rates (8388897x, 0x800121x). Yaw rate is positive for clockwise rotation when looking down on the vehicle from above." SWORD CONV_crt_PT_800121_Gyro_Rate_Yaw 0 0 -327.0 327.0 ECU_ADDRESS 0x0000 /end MEASUREMENT
/begin COMPU_METHOD CONV_crt_PT_800121_Gyro_Rate_Yaw "Linear scaling, used for variable crt_PT_800121_Gyro_Rate_Yaw, signal Gyro_Rate_Yaw" RAT_FUNC "%6" "degrees/s" COEFFS 0 -1 0.0 0 0 -0.01 /end COMPU_METHOD
/* Measurement point for signal Gyro_Rate_Pitch of frame RT_IMU06_Gyro_Rates (8388897x, 0x800121x) */
/begin MEASUREMENT crt_PT_800121_Gyro_Rate_Pitch "signal Gyro_Rate_Pitch of frame RT_IMU06_Gyro_Rates (8388897x, 0x800121x). Pitch rate is positive for clockwise rotation when looking at the left hand side of the vehicle from the left of the vehicle." SWORD CONV_crt_PT_800121_Gyro_Rate_Pitch 0 0 -327.0 327.0 ECU_ADDRESS 0x0000 /end MEASUREMENT
/begin COMPU_METHOD CONV_crt_PT_800121_Gyro_Rate_Pitch "Linear scaling, used for variable crt_PT_800121_Gyro_Rate_Pitch, signal Gyro_Rate_Pitch" RAT_FUNC "%6" "degrees/s" COEFFS 0 -1 0.0 0 0 -0.01 /end COMPU_METHOD
/* Measurement point for signal Gyro_Rate_Roll of frame RT_IMU06_Gyro_Rates (8388897x, 0x800121x) */
/begin MEASUREMENT crt_PT_800121_Gyro_Rate_Roll "signal Gyro_Rate_Roll of frame RT_IMU06_Gyro_Rates (8388897x, 0x800121x). Roll rate is positive for clockwise rotation when looking at the rear of the vehicle from behind the vehicle." SWORD CONV_crt_PT_800121_Gyro_Rate_Roll 0 0 -327.0 327.0 ECU_ADDRESS 0x0000 /end MEASUREMENT
/begin COMPU_METHOD CONV_crt_PT_800121_Gyro_Rate_Roll "Linear scaling, used for variable crt_PT_800121_Gyro_Rate_Roll, signal Gyro_Rate_Roll" RAT_FUNC "%6" "degrees/s" COEFFS 0 -1 0.0 0 0 -0.01 /end COMPU_METHOD
/* Measurement point for signal Validity_Accel_Longitudinal of frame RT_IMU06_Accel (8388641x, 0x800021x) */
/begin MEASUREMENT crt_PT_800021_Validity_Accel_Longitudinal "signal Validity_Accel_Longitudinal of frame RT_IMU06_Accel (8388641x, 0x800021x). Valid when bit is set, invalid when bit is clear." UBYTE CONV_crt_PT_800021_Validity_Accel_Longitudinal 0 0 0 1 ECU_ADDRESS 0x0000 /end MEASUREMENT
/begin COMPU_METHOD CONV_crt_PT_800021_Validity_Accel_Longitudinal "Identity, real-world value is same as binary value" IDENTICAL "%1" "" /end COMPU_METHOD
/* Measurement point for signal Validity_Accel_Lateral of frame RT_IMU06_Accel (8388641x, 0x800021x) */
/begin MEASUREMENT crt_PT_800021_Validity_Accel_Lateral "signal Validity_Accel_Lateral of frame RT_IMU06_Accel (8388641x, 0x800021x). Valid when bit is set, invalid when bit is clear." UBYTE CONV_crt_PT_800021_Validity_Accel_Lateral 0 0 0 1 ECU_ADDRESS 0x0000 /end MEASUREMENT
/begin COMPU_METHOD CONV_crt_PT_800021_Validity_Accel_Lateral "Identity, real-world value is same as binary value" IDENTICAL "%1" "" /end COMPU_METHOD
/* Measurement point for signal Validity_Accel_Vertical of frame RT_IMU06_Accel (8388641x, 0x800021x) */
/begin MEASUREMENT crt_PT_800021_Validity_Accel_Vertical "signal Validity_Accel_Vertical of frame RT_IMU06_Accel (8388641x, 0x800021x). Valid when bit is set, invalid when bit is clear." UBYTE CONV_crt_PT_800021_Validity_Accel_Vertical 0 0 0 1 ECU_ADDRESS 0x0000 /end MEASUREMENT
/begin COMPU_METHOD CONV_crt_PT_800021_Validity_Accel_Vertical "Identity, real-world value is same as binary value" IDENTICAL "%1" "" /end COMPU_METHOD
/* Measurement point for signal Accuracy_Accel of frame RT_IMU06_Accel (8388641x, 0x800021x) */
/begin MEASUREMENT crt_PT_800021_Accuracy_Accel "signal Accuracy_Accel of frame RT_IMU06_Accel (8388641x, 0x800021x). Dimensionless.  Lower values imply but do not guarantee better accuracy than higher values." UBYTE CONV_crt_PT_800021_Accuracy_Accel 0 0 0 255 ECU_ADDRESS 0x0000 /end MEASUREMENT
/begin COMPU_METHOD CONV_crt_PT_800021_Accuracy_Accel "Identity, real-world value is same as binary value" IDENTICAL "%4" "" /end COMPU_METHOD
/* Measurement point for signal Accel_Longitudinal of frame RT_IMU06_Accel (8388641x, 0x800021x) */
/begin MEASUREMENT crt_PT_800021_Accel_Longitudinal "signal Accel_Longitudinal of frame RT_IMU06_Accel (8388641x, 0x800021x). Longitudinal acceleration.  This is positive when the vehicle accelerates in a forwards direction." SWORD CONV_crt_PT_800021_Accel_Longitudinal 0 0 -65.0 65.0 ECU_ADDRESS 0x0000 /end MEASUREMENT
/begin COMPU_METHOD CONV_crt_PT_800021_Accel_Longitudinal "Linear scaling, used for variable crt_PT_800021_Accel_Longitudinal, signal Accel_Longitudinal" RAT_FUNC "%6" "g" COEFFS 0 -1 0.0 0 0 -0.001 /end COMPU_METHOD
/* Measurement point for signal Accel_Lateral of frame RT_IMU06_Accel (8388641x, 0x800021x) */
/begin MEASUREMENT crt_PT_800021_Accel_Lateral "signal Accel_Lateral of frame RT_IMU06_Accel (8388641x, 0x800021x). Lateral acceleration.  This is positive when the vehicle accelerates towards the right, e.g. when cornering around a right-hand bend." SWORD CONV_crt_PT_800021_Accel_Lateral 0 0 -65.0 65.0 ECU_ADDRESS 0x0000 /end MEASUREMENT
/begin COMPU_METHOD CONV_crt_PT_800021_Accel_Lateral "Linear scaling, used for variable crt_PT_800021_Accel_Lateral, signal Accel_Lateral" RAT_FUNC "%6" "g" COEFFS 0 -1 0.0 0 0 -0.001 /end COMPU_METHOD
/* Measurement point for signal Accel_Vertical of frame RT_IMU06_Accel (8388641x, 0x800021x) */
/begin MEASUREMENT crt_PT_800021_Accel_Vertical "signal Accel_Vertical of frame RT_IMU06_Accel (8388641x, 0x800021x). Vertical acceleration.  This is positive when the vehicle accelerates in an upwards direction, e.g. when travelling through a dip." SWORD CONV_crt_PT_800021_Accel_Vertical 0 0 -65.0 65.0 ECU_ADDRESS 0x0000 /end MEASUREMENT
/begin COMPU_METHOD CONV_crt_PT_800021_Accel_Vertical "Linear scaling, used for variable crt_PT_800021_Accel_Vertical, signal Accel_Vertical" RAT_FUNC "%6" "g" COEFFS 0 -1 0.0 0 0 -0.001 /end COMPU_METHOD
/* Measurement point for signal Validity_Speed of frame RT_SB_Speed (8392738x, 0x801022x) */
/begin MEASUREMENT crt_PT_801022_Validity_Speed "signal Validity_Speed of frame RT_SB_Speed (8392738x, 0x801022x). Valid when bit is set, invalid when bit is clear." UBYTE CONV_crt_PT_801022_Validity_Speed 0 0 0 1 ECU_ADDRESS 0x0000 /end MEASUREMENT
/begin COMPU_METHOD CONV_crt_PT_801022_Validity_Speed "Identity, real-world value is same as binary value" IDENTICAL "%1" "" /end COMPU_METHOD
/* Measurement point for signal Accuracy_Speed of frame RT_SB_Speed (8392738x, 0x801022x) */
/begin MEASUREMENT crt_PT_801022_Accuracy_Speed "signal Accuracy_Speed of frame RT_SB_Speed (8392738x, 0x801022x). Dimensionless.  Lower values imply but do not guarantee better accuracy than higher values." UBYTE CONV_crt_PT_801022_Accuracy_Speed 0 0 0 255 ECU_ADDRESS 0x0000 /end MEASUREMENT
/begin COMPU_METHOD CONV_crt_PT_801022_Accuracy_Speed "Identity, real-world value is same as binary value" IDENTICAL "%4" "" /end COMPU_METHOD
/* Measurement point for signal Speed of frame RT_SB_Speed (8392738x, 0x801022x) */
/begin MEASUREMENT crt_PT_801022_Speed "signal Speed of frame RT_SB_Speed (8392738x, 0x801022x)" SLONG CONV_crt_PT_801022_Speed 0 0 -20000.0 20000.0 ECU_ADDRESS 0x0000 /end MEASUREMENT
/begin COMPU_METHOD CONV_crt_PT_801022_Speed "Linear scaling, used for variable crt_PT_801022_Speed, signal Speed" RAT_FUNC "%12" "m/s" COEFFS 0 -1 0.0 0 0 -1.0E-5 /end COMPU_METHOD
/* Measurement point for signal Validity_RTK_Slip of frame RT_SB_RTK_Slip (9183522x, 0x8C2122x) */
/begin MEASUREMENT crt_PT_8c2122_Validity_RTK_Slip "signal Validity_RTK_Slip of frame RT_SB_RTK_Slip (9183522x, 0x8C2122x). Valid when bit is set, invalid when bit is clear." UBYTE CONV_crt_PT_8c2122_Validity_RTK_Slip 0 0 0 1 ECU_ADDRESS 0x0000 /end MEASUREMENT
/begin COMPU_METHOD CONV_crt_PT_8c2122_Validity_RTK_Slip "Identity, real-world value is same as binary value" IDENTICAL "%1" "" /end COMPU_METHOD
/* Measurement point for signal Validity_RTK_Squat of frame RT_SB_RTK_Slip (9183522x, 0x8C2122x) */
/begin MEASUREMENT crt_PT_8c2122_Validity_RTK_Squat "signal Validity_RTK_Squat of frame RT_SB_RTK_Slip (9183522x, 0x8C2122x). Valid when bit is set, invalid when bit is clear." UBYTE CONV_crt_PT_8c2122_Validity_RTK_Squat 0 0 0 1 ECU_ADDRESS 0x0000 /end MEASUREMENT
/begin COMPU_METHOD CONV_crt_PT_8c2122_Validity_RTK_Squat "Identity, real-world value is same as binary value" IDENTICAL "%1" "" /end COMPU_METHOD
/* Measurement point for signal Validity_RTK_Baseline of frame RT_SB_RTK_Slip (9183522x, 0x8C2122x) */
/begin MEASUREMENT crt_PT_8c2122_Validity_RTK_Baseline "signal Validity_RTK_Baseline of frame RT_SB_RTK_Slip (9183522x, 0x8C2122x). Valid when bit is set, invalid when bit is clear." UBYTE CONV_crt_PT_8c2122_Validity_RTK_Baseline 0 0 0 1 ECU_ADDRESS 0x0000 /end MEASUREMENT
/begin COMPU_METHOD CONV_crt_PT_8c2122_Validity_RTK_Baseline "Identity, real-world value is same as binary value" IDENTICAL "%1" "" /end COMPU_METHOD
/* Measurement point for signal Accuracy_RTK_Baseline of frame RT_SB_RTK_Slip (9183522x, 0x8C2122x) */
/begin MEASUREMENT crt_PT_8c2122_Accuracy_RTK_Baseline "signal Accuracy_RTK_Baseline of frame RT_SB_RTK_Slip (9183522x, 0x8C2122x)" UBYTE CONV_crt_PT_8c2122_Accuracy_RTK_Baseline 0 0 0 255 ECU_ADDRESS 0x0000 /end MEASUREMENT
/begin COMPU_METHOD CONV_crt_PT_8c2122_Accuracy_RTK_Baseline "Identity, real-world value is same as binary value" IDENTICAL "%4" "" /end COMPU_METHOD
/* Measurement point for signal RTK_Slip of frame RT_SB_RTK_Slip (9183522x, 0x8C2122x) */
/begin MEASUREMENT crt_PT_8c2122_RTK_Slip "signal RTK_Slip of frame RT_SB_RTK_Slip (9183522x, 0x8C2122x). Slip is defined as the difference between yaw and heading." SWORD CONV_crt_PT_8c2122_RTK_Slip 0 0 -360.0 360.0 ECU_ADDRESS 0x0000 /end MEASUREMENT
/begin COMPU_METHOD CONV_crt_PT_8c2122_RTK_Slip "Linear scaling, used for variable crt_PT_8c2122_RTK_Slip, signal RTK_Slip" RAT_FUNC "%6" "degrees" COEFFS 0 -1 0.0 0 0 -0.01 /end COMPU_METHOD
/* Measurement point for signal RTK_Squat of frame RT_SB_RTK_Slip (9183522x, 0x8C2122x) */
/begin MEASUREMENT crt_PT_8c2122_RTK_Squat "signal RTK_Squat of frame RT_SB_RTK_Slip (9183522x, 0x8C2122x). Squat is defined as the difference between pitch and gradient." SWORD CONV_crt_PT_8c2122_RTK_Squat 0 0 -360.0 360.0 ECU_ADDRESS 0x0000 /end MEASUREMENT
/begin COMPU_METHOD CONV_crt_PT_8c2122_RTK_Squat "Linear scaling, used for variable crt_PT_8c2122_RTK_Squat, signal RTK_Squat" RAT_FUNC "%6" "degrees" COEFFS 0 -1 0.0 0 0 -0.01 /end COMPU_METHOD
/* Measurement point for signal RTK_Baseline of frame RT_SB_RTK_Slip (9183522x, 0x8C2122x) */
/begin MEASUREMENT crt_PT_8c2122_RTK_Baseline "signal RTK_Baseline of frame RT_SB_RTK_Slip (9183522x, 0x8C2122x). This is the estimated baseline length calculated by the RTK solution." UWORD CONV_crt_PT_8c2122_RTK_Baseline 0 0 0 65535 ECU_ADDRESS 0x0000 /end MEASUREMENT
/begin COMPU_METHOD CONV_crt_PT_8c2122_RTK_Baseline "Identity, real-world value is same as binary value" IDENTICAL "%6" "mm" /end COMPU_METHOD
/* Measurement point for signal Validity_RTK_Yaw of frame RT_SB_RTK_Attitude (9183266x, 0x8C2022x) */
/begin MEASUREMENT crt_PT_8c2022_Validity_RTK_Yaw "signal Validity_RTK_Yaw of frame RT_SB_RTK_Attitude (9183266x, 0x8C2022x). Valid when bit is set, invalid when bit is clear." UBYTE CONV_crt_PT_8c2022_Validity_RTK_Yaw 0 0 0 1 ECU_ADDRESS 0x0000 /end MEASUREMENT
/begin COMPU_METHOD CONV_crt_PT_8c2022_Validity_RTK_Yaw "Identity, real-world value is same as binary value" IDENTICAL "%1" "" /end COMPU_METHOD
/* Measurement point for signal Validity_RTK_Pitch of frame RT_SB_RTK_Attitude (9183266x, 0x8C2022x) */
/begin MEASUREMENT crt_PT_8c2022_Validity_RTK_Pitch "signal Validity_RTK_Pitch of frame RT_SB_RTK_Attitude (9183266x, 0x8C2022x). Valid when bit is set, invalid when bit is clear." UBYTE CONV_crt_PT_8c2022_Validity_RTK_Pitch 0 0 0 1 ECU_ADDRESS 0x0000 /end MEASUREMENT
/begin COMPU_METHOD CONV_crt_PT_8c2022_Validity_RTK_Pitch "Identity, real-world value is same as binary value" IDENTICAL "%1" "" /end COMPU_METHOD
/* Measurement point for signal Validity_RTK_Roll of frame RT_SB_RTK_Attitude (9183266x, 0x8C2022x) */
/begin MEASUREMENT crt_PT_8c2022_Validity_RTK_Roll "signal Validity_RTK_Roll of frame RT_SB_RTK_Attitude (9183266x, 0x8C2022x). Valid when bit is set, invalid when bit is clear." UBYTE CONV_crt_PT_8c2022_Validity_RTK_Roll 0 0 0 1 ECU_ADDRESS 0x0000 /end MEASUREMENT
/begin COMPU_METHOD CONV_crt_PT_8c2022_Validity_RTK_Roll "Identity, real-world value is same as binary value" IDENTICAL "%1" "" /end COMPU_METHOD
/* Measurement point for signal Accuracy_RTK_Attitude of frame RT_SB_RTK_Attitude (9183266x, 0x8C2022x) */
/begin MEASUREMENT crt_PT_8c2022_Accuracy_RTK_Attitude "signal Accuracy_RTK_Attitude of frame RT_SB_RTK_Attitude (9183266x, 0x8C2022x). Note that RTK yaw is typically up to about 4 times more accurate than RTK pitch or roll." UBYTE CONV_crt_PT_8c2022_Accuracy_RTK_Attitude 0 0 0 255 ECU_ADDRESS 0x0000 /end MEASUREMENT
/begin COMPU_METHOD CONV_crt_PT_8c2022_Accuracy_RTK_Attitude "Identity, real-world value is same as binary value" IDENTICAL "%4" "" /end COMPU_METHOD
/* Measurement point for signal RTK_Attitude_Yaw of frame RT_SB_RTK_Attitude (9183266x, 0x8C2022x) */
/begin MEASUREMENT crt_PT_8c2022_RTK_Attitude_Yaw "signal RTK_Attitude_Yaw of frame RT_SB_RTK_Attitude (9183266x, 0x8C2022x). RTK attitude is determined from the MB-RTK solution only.  Yaw is positive for a clockwise rotational displacement from due North, looking down on the vehicle from above." SWORD CONV_crt_PT_8c2022_RTK_Attitude_Yaw 0 0 -360.0 360.0 ECU_ADDRESS 0x0000 /end MEASUREMENT
/begin COMPU_METHOD CONV_crt_PT_8c2022_RTK_Attitude_Yaw "Linear scaling, used for variable crt_PT_8c2022_RTK_Attitude_Yaw, signal RTK_Attitude_Yaw" RAT_FUNC "%6" "degrees" COEFFS 0 -1 0.0 0 0 -0.01 /end COMPU_METHOD
/* Measurement point for signal RTK_Attitude_Pitch of frame RT_SB_RTK_Attitude (9183266x, 0x8C2022x) */
/begin MEASUREMENT crt_PT_8c2022_RTK_Attitude_Pitch "signal RTK_Attitude_Pitch of frame RT_SB_RTK_Attitude (9183266x, 0x8C2022x). RTK attitude is determined from the MB-RTK solution only.  Pitch is positive for a clockwise rotational displacement from the local horizontal plane when looking at the vehicle from the left hand side of it." SWORD CONV_crt_PT_8c2022_RTK_Attitude_Pitch 0 0 -90.0 90.0 ECU_ADDRESS 0x0000 /end MEASUREMENT
/begin COMPU_METHOD CONV_crt_PT_8c2022_RTK_Attitude_Pitch "Linear scaling, used for variable crt_PT_8c2022_RTK_Attitude_Pitch, signal RTK_Attitude_Pitch" RAT_FUNC "%6" "degrees" COEFFS 0 -1 0.0 0 0 -0.01 /end COMPU_METHOD
/* Measurement point for signal RTK_Attitude_Roll of frame RT_SB_RTK_Attitude (9183266x, 0x8C2022x) */
/begin MEASUREMENT crt_PT_8c2022_RTK_Attitude_Roll "signal RTK_Attitude_Roll of frame RT_SB_RTK_Attitude (9183266x, 0x8C2022x). RTK attitude is determined from the MB-RTK solution only.  Roll is positive for a clockwise rotational displacement relative to the local horizontal plane when looking at the vehicle from the rear of it." SWORD CONV_crt_PT_8c2022_RTK_Attitude_Roll 0 0 -90.0 90.0 ECU_ADDRESS 0x0000 /end MEASUREMENT
/begin COMPU_METHOD CONV_crt_PT_8c2022_RTK_Attitude_Roll "Linear scaling, used for variable crt_PT_8c2022_RTK_Attitude_Roll, signal RTK_Attitude_Roll" RAT_FUNC "%6" "degrees" COEFFS 0 -1 0.0 0 0 -0.01 /end COMPU_METHOD
/* Measurement point for signal Validity_GPS_Lateral_Accel of frame RT_SB_GPS_Mcycle_Lean (9187362x, 0x8C3022x) */
/begin MEASUREMENT crt_PT_8c3022_Validity_GPS_Lateral_Accel "signal Validity_GPS_Lateral_Accel of frame RT_SB_GPS_Mcycle_Lean (9187362x, 0x8C3022x). Valid when bit is set, invalid when bit is clear." UBYTE CONV_crt_PT_8c3022_Validity_GPS_Lateral_Accel 0 0 0 1 ECU_ADDRESS 0x0000 /end MEASUREMENT
/begin COMPU_METHOD CONV_crt_PT_8c3022_Validity_GPS_Lateral_Accel "Identity, real-world value is same as binary value" IDENTICAL "%1" "" /end COMPU_METHOD
/* Measurement point for signal Validity_GPS_Mcycle_Lean of frame RT_SB_GPS_Mcycle_Lean (9187362x, 0x8C3022x) */
/begin MEASUREMENT crt_PT_8c3022_Validity_GPS_Mcycle_Lean "signal Validity_GPS_Mcycle_Lean of frame RT_SB_GPS_Mcycle_Lean (9187362x, 0x8C3022x). Valid when bit is set, invalid when bit is clear." UBYTE CONV_crt_PT_8c3022_Validity_GPS_Mcycle_Lean 0 0 0 1 ECU_ADDRESS 0x0000 /end MEASUREMENT
/begin COMPU_METHOD CONV_crt_PT_8c3022_Validity_GPS_Mcycle_Lean "Identity, real-world value is same as binary value" IDENTICAL "%1" "" /end COMPU_METHOD
/* Measurement point for signal Accuracy_GPS_Lateral_Accel of frame RT_SB_GPS_Mcycle_Lean (9187362x, 0x8C3022x) */
/begin MEASUREMENT crt_PT_8c3022_Accuracy_GPS_Lateral_Accel "signal Accuracy_GPS_Lateral_Accel of frame RT_SB_GPS_Mcycle_Lean (9187362x, 0x8C3022x). This accuracy value applies to both GPS-derived lateral acceleration and motorcycle lean angle, since both are derived from the rate of change of GPS heading." UBYTE CONV_crt_PT_8c3022_Accuracy_GPS_Lateral_Accel 0 0 0 255 ECU_ADDRESS 0x0000 /end MEASUREMENT
/begin COMPU_METHOD CONV_crt_PT_8c3022_Accuracy_GPS_Lateral_Accel "Identity, real-world value is same as binary value" IDENTICAL "%4" "" /end COMPU_METHOD
/* Measurement point for signal GPS_Lateral_Accel of frame RT_SB_GPS_Mcycle_Lean (9187362x, 0x8C3022x) */
/begin MEASUREMENT crt_PT_8c3022_GPS_Lateral_Accel "signal GPS_Lateral_Accel of frame RT_SB_GPS_Mcycle_Lean (9187362x, 0x8C3022x). GPS-derived lateral acceleration.  This is derived by differentiating GPS heading - it is much more noisy than lateral accel from the accelerometers, but useful for m/cycle applications." SWORD CONV_crt_PT_8c3022_GPS_Lateral_Accel 0 0 -65.0 65.0 ECU_ADDRESS 0x0000 /end MEASUREMENT
/begin COMPU_METHOD CONV_crt_PT_8c3022_GPS_Lateral_Accel "Linear scaling, used for variable crt_PT_8c3022_GPS_Lateral_Accel, signal GPS_Lateral_Accel" RAT_FUNC "%6" "g" COEFFS 0 -1 0.0 0 0 -0.001 /end COMPU_METHOD
/* Measurement point for signal GPS_Mcycle_Lean_Angle of frame RT_SB_GPS_Mcycle_Lean (9187362x, 0x8C3022x) */
/begin MEASUREMENT crt_PT_8c3022_GPS_Mcycle_Lean_Angle "signal GPS_Mcycle_Lean_Angle of frame RT_SB_GPS_Mcycle_Lean (9187362x, 0x8C3022x). Motorcycle lean angle, derived from rate of change of heading from GPS.  This is the lean angle of the centre of mass of the combined bike + rider." SWORD CONV_crt_PT_8c3022_GPS_Mcycle_Lean_Angle 0 0 -90.0 90.0 ECU_ADDRESS 0x0000 /end MEASUREMENT
/begin COMPU_METHOD CONV_crt_PT_8c3022_GPS_Mcycle_Lean_Angle "Linear scaling, used for variable crt_PT_8c3022_GPS_Mcycle_Lean_Angle, signal GPS_Mcycle_Lean_Angle" RAT_FUNC "%6" "degrees" COEFFS 0 -1 0.0 0 0 -0.01 /end COMPU_METHOD
/* Measurement point for signal GPS_Status of frame RT_SB_GPS_Status (9175074x, 0x8C0022x) */
/begin MEASUREMENT crt_PT_8c0022_GPS_Status "signal GPS_Status of frame RT_SB_GPS_Status (9175074x, 0x8C0022x)" UBYTE CONV_crt_PT_8c0022_GPS_Status 0 0 0 255 ECU_ADDRESS 0x0000 /end MEASUREMENT
/begin COMPU_METHOD CONV_crt_PT_8c0022_GPS_Status "Identity, real-world value is same as binary value" IDENTICAL "%4" "" /end COMPU_METHOD
/* Measurement point for signal Firmware_Version_Major of frame RT_SB_GPS_Status (9175074x, 0x8C0022x) */
/begin MEASUREMENT crt_PT_8c0022_Firmware_Version_Major "signal Firmware_Version_Major of frame RT_SB_GPS_Status (9175074x, 0x8C0022x)" UBYTE CONV_crt_PT_8c0022_Firmware_Version_Major 0 0 0 255 ECU_ADDRESS 0x0000 /end MEASUREMENT
/begin COMPU_METHOD CONV_crt_PT_8c0022_Firmware_Version_Major "Identity, real-world value is same as binary value" IDENTICAL "%4" "" /end COMPU_METHOD
/* Measurement point for signal Firmware_Version_Intermediate of frame RT_SB_GPS_Status (9175074x, 0x8C0022x) */
/begin MEASUREMENT crt_PT_8c0022_Firmware_Version_Intermediate "signal Firmware_Version_Intermediate of frame RT_SB_GPS_Status (9175074x, 0x8C0022x)" UBYTE CONV_crt_PT_8c0022_Firmware_Version_Intermediate 0 0 0 255 ECU_ADDRESS 0x0000 /end MEASUREMENT
/begin COMPU_METHOD CONV_crt_PT_8c0022_Firmware_Version_Intermediate "Identity, real-world value is same as binary value" IDENTICAL "%4" "" /end COMPU_METHOD
/* Measurement point for signal Firmware_Version_Minor of frame RT_SB_GPS_Status (9175074x, 0x8C0022x) */
/begin MEASUREMENT crt_PT_8c0022_Firmware_Version_Minor "signal Firmware_Version_Minor of frame RT_SB_GPS_Status (9175074x, 0x8C0022x)" UBYTE CONV_crt_PT_8c0022_Firmware_Version_Minor 0 0 0 255 ECU_ADDRESS 0x0000 /end MEASUREMENT
/begin COMPU_METHOD CONV_crt_PT_8c0022_Firmware_Version_Minor "Identity, real-world value is same as binary value" IDENTICAL "%4" "" /end COMPU_METHOD
/* Measurement point for signal GPS_nSv of frame RT_SB_GPS_Status (9175074x, 0x8C0022x) */
/begin MEASUREMENT crt_PT_8c0022_GPS_nSv "signal GPS_nSv of frame RT_SB_GPS_Status (9175074x, 0x8C0022x). Number of satellites used in GPS solution" UBYTE CONV_crt_PT_8c0022_GPS_nSv 0 0 0 16 ECU_ADDRESS 0x0000 /end MEASUREMENT
/begin COMPU_METHOD CONV_crt_PT_8c0022_GPS_nSv "Identity, real-world value is same as binary value" IDENTICAL "%4" "" /end COMPU_METHOD
/* Measurement point for signal GPS_nSv_2 of frame RT_SB_GPS_Status (9175074x, 0x8C0022x) */
/begin MEASUREMENT crt_PT_8c0022_GPS_nSv_2 "signal GPS_nSv_2 of frame RT_SB_GPS_Status (9175074x, 0x8C0022x). Number of satellites used in GPS solution by module 2 on RTK units..." UBYTE CONV_crt_PT_8c0022_GPS_nSv_2 0 0 0 16 ECU_ADDRESS 0x0000 /end MEASUREMENT
/begin COMPU_METHOD CONV_crt_PT_8c0022_GPS_nSv_2 "Identity, real-world value is same as binary value" IDENTICAL "%4" "" /end COMPU_METHOD
/* Measurement point for signal GPS_nSv_RTK of frame RT_SB_GPS_Status (9175074x, 0x8C0022x) */
/begin MEASUREMENT crt_PT_8c0022_GPS_nSv_RTK "signal GPS_nSv_RTK of frame RT_SB_GPS_Status (9175074x, 0x8C0022x). Number of common satellites available to RTK solution" UBYTE CONV_crt_PT_8c0022_GPS_nSv_RTK 0 0 0 16 ECU_ADDRESS 0x0000 /end MEASUREMENT
/begin COMPU_METHOD CONV_crt_PT_8c0022_GPS_nSv_RTK "Identity, real-world value is same as binary value" IDENTICAL "%4" "" /end COMPU_METHOD
/* Measurement point for signal RTK_Status of frame RT_SB_GPS_Status (9175074x, 0x8C0022x) */
/begin MEASUREMENT crt_PT_8c0022_RTK_Status "signal RTK_Status of frame RT_SB_GPS_Status (9175074x, 0x8C0022x)" UBYTE CONV_crt_PT_8c0022_RTK_Status 0 0 0 255 ECU_ADDRESS 0x0000 /end MEASUREMENT
/begin COMPU_METHOD CONV_crt_PT_8c0022_RTK_Status "Identity, real-world value is same as binary value" IDENTICAL "%4" "" /end COMPU_METHOD
/* Measurement point for signal GPS_Pos_ECEF_Y of frame RT_SB_GPS_Pos_ECEF_2 (9176354x, 0x8C0522x) */
/begin MEASUREMENT crt_PT_8c0522_GPS_Pos_ECEF_Y "signal GPS_Pos_ECEF_Y of frame RT_SB_GPS_Pos_ECEF_2 (9176354x, 0x8C0522x). ECEF Y position.  The ECEF Y axis originates from the Earth centre, and the positive Y axis intersects the Earth surface at zero degrees latittude and 90 degrees longitude." SLONG CONV_crt_PT_8c0522_GPS_Pos_ECEF_Y 0 0 -1.0E7 1.0E7 ECU_ADDRESS 0x0000 /end MEASUREMENT
/begin COMPU_METHOD CONV_crt_PT_8c0522_GPS_Pos_ECEF_Y "Linear scaling, used for variable crt_PT_8c0522_GPS_Pos_ECEF_Y, signal GPS_Pos_ECEF_Y" RAT_FUNC "%12" "m" COEFFS 0 -1 0.0 0 0 -0.01 /end COMPU_METHOD
/* Measurement point for signal GPS_Pos_ECEF_Z of frame RT_SB_GPS_Pos_ECEF_2 (9176354x, 0x8C0522x) */
/begin MEASUREMENT crt_PT_8c0522_GPS_Pos_ECEF_Z "signal GPS_Pos_ECEF_Z of frame RT_SB_GPS_Pos_ECEF_2 (9176354x, 0x8C0522x). ECEF Z position.  The ECEF Z axis originates from the Earth centre, and the positive Z axis intersects the Earth surface at the North Pole." SLONG CONV_crt_PT_8c0522_GPS_Pos_ECEF_Z 0 0 -1.0E7 1.0E7 ECU_ADDRESS 0x0000 /end MEASUREMENT
/begin COMPU_METHOD CONV_crt_PT_8c0522_GPS_Pos_ECEF_Z "Linear scaling, used for variable crt_PT_8c0522_GPS_Pos_ECEF_Z, signal GPS_Pos_ECEF_Z" RAT_FUNC "%12" "m" COEFFS 0 -1 0.0 0 0 -0.01 /end COMPU_METHOD
/* Measurement point for signal Validity_GPS_Pos_ECEF_X of frame RT_SB_GPS_Pos_ECEF_1 (9176098x, 0x8C0422x) */
/begin MEASUREMENT crt_PT_8c0422_Validity_GPS_Pos_ECEF_X "signal Validity_GPS_Pos_ECEF_X of frame RT_SB_GPS_Pos_ECEF_1 (9176098x, 0x8C0422x). Valid when bit is set, invalid when bit is clear." UBYTE CONV_crt_PT_8c0422_Validity_GPS_Pos_ECEF_X 0 0 0 1 ECU_ADDRESS 0x0000 /end MEASUREMENT
/begin COMPU_METHOD CONV_crt_PT_8c0422_Validity_GPS_Pos_ECEF_X "Identity, real-world value is same as binary value" IDENTICAL "%1" "" /end COMPU_METHOD
/* Measurement point for signal Validity_GPS_Pos_ECEF_Y of frame RT_SB_GPS_Pos_ECEF_1 (9176098x, 0x8C0422x) */
/begin MEASUREMENT crt_PT_8c0422_Validity_GPS_Pos_ECEF_Y "signal Validity_GPS_Pos_ECEF_Y of frame RT_SB_GPS_Pos_ECEF_1 (9176098x, 0x8C0422x). Valid when bit is set, invalid when bit is clear." UBYTE CONV_crt_PT_8c0422_Validity_GPS_Pos_ECEF_Y 0 0 0 1 ECU_ADDRESS 0x0000 /end MEASUREMENT
/begin COMPU_METHOD CONV_crt_PT_8c0422_Validity_GPS_Pos_ECEF_Y "Identity, real-world value is same as binary value" IDENTICAL "%1" "" /end COMPU_METHOD
/* Measurement point for signal Validity_GPS_Pos_ECEF_Z of frame RT_SB_GPS_Pos_ECEF_1 (9176098x, 0x8C0422x) */
/begin MEASUREMENT crt_PT_8c0422_Validity_GPS_Pos_ECEF_Z "signal Validity_GPS_Pos_ECEF_Z of frame RT_SB_GPS_Pos_ECEF_1 (9176098x, 0x8C0422x). Valid when bit is set, invalid when bit is clear." UBYTE CONV_crt_PT_8c0422_Validity_GPS_Pos_ECEF_Z 0 0 0 1 ECU_ADDRESS 0x0000 /end MEASUREMENT
/begin COMPU_METHOD CONV_crt_PT_8c0422_Validity_GPS_Pos_ECEF_Z "Identity, real-world value is same as binary value" IDENTICAL "%1" "" /end COMPU_METHOD
/* Measurement point for signal Accuracy_GPS_Pos_ECEF_X of frame RT_SB_GPS_Pos_ECEF_1 (9176098x, 0x8C0422x) */
/begin MEASUREMENT crt_PT_8c0422_Accuracy_GPS_Pos_ECEF_X "signal Accuracy_GPS_Pos_ECEF_X of frame RT_SB_GPS_Pos_ECEF_1 (9176098x, 0x8C0422x). Dimensionless.  Lower values imply but do not guarantee better accuracy than higher values." UBYTE CONV_crt_PT_8c0422_Accuracy_GPS_Pos_ECEF_X 0 0 0 255 ECU_ADDRESS 0x0000 /end MEASUREMENT
/begin COMPU_METHOD CONV_crt_PT_8c0422_Accuracy_GPS_Pos_ECEF_X "Identity, real-world value is same as binary value" IDENTICAL "%4" "" /end COMPU_METHOD
/* Measurement point for signal Accuracy_GPS_Pos_ECEF_Y of frame RT_SB_GPS_Pos_ECEF_1 (9176098x, 0x8C0422x) */
/begin MEASUREMENT crt_PT_8c0422_Accuracy_GPS_Pos_ECEF_Y "signal Accuracy_GPS_Pos_ECEF_Y of frame RT_SB_GPS_Pos_ECEF_1 (9176098x, 0x8C0422x). Dimensionless.  Lower values imply but do not guarantee better accuracy than higher values." UBYTE CONV_crt_PT_8c0422_Accuracy_GPS_Pos_ECEF_Y 0 0 0 255 ECU_ADDRESS 0x0000 /end MEASUREMENT
/begin COMPU_METHOD CONV_crt_PT_8c0422_Accuracy_GPS_Pos_ECEF_Y "Identity, real-world value is same as binary value" IDENTICAL "%4" "" /end COMPU_METHOD
/* Measurement point for signal Accuracy_GPS_Pos_ECEF_Z of frame RT_SB_GPS_Pos_ECEF_1 (9176098x, 0x8C0422x) */
/begin MEASUREMENT crt_PT_8c0422_Accuracy_GPS_Pos_ECEF_Z "signal Accuracy_GPS_Pos_ECEF_Z of frame RT_SB_GPS_Pos_ECEF_1 (9176098x, 0x8C0422x). Dimensionless.  Lower values imply but do not guarantee better accuracy than higher values." UBYTE CONV_crt_PT_8c0422_Accuracy_GPS_Pos_ECEF_Z 0 0 0 255 ECU_ADDRESS 0x0000 /end MEASUREMENT
/begin COMPU_METHOD CONV_crt_PT_8c0422_Accuracy_GPS_Pos_ECEF_Z "Identity, real-world value is same as binary value" IDENTICAL "%4" "" /end COMPU_METHOD
/* Measurement point for signal GPS_Pos_ECEF_X of frame RT_SB_GPS_Pos_ECEF_1 (9176098x, 0x8C0422x) */
/begin MEASUREMENT crt_PT_8c0422_GPS_Pos_ECEF_X "signal GPS_Pos_ECEF_X of frame RT_SB_GPS_Pos_ECEF_1 (9176098x, 0x8C0422x). ECEF X position.  The ECEF X axis originates from the Earth centre, and the positive X axis intersects the Earth surface at zero degrees latittude and zero degrees longitude (the intersection of the equator and the prime meridian)." SLONG CONV_crt_PT_8c0422_GPS_Pos_ECEF_X 0 0 -1.0E7 1.0E7 ECU_ADDRESS 0x0000 /end MEASUREMENT
/begin COMPU_METHOD CONV_crt_PT_8c0422_GPS_Pos_ECEF_X "Linear scaling, used for variable crt_PT_8c0422_GPS_Pos_ECEF_X, signal GPS_Pos_ECEF_X" RAT_FUNC "%12" "m" COEFFS 0 -1 0.0 0 0 -0.01 /end COMPU_METHOD
/* Measurement point for signal GPS_Pos_LLH_Longitude of frame RT_SB_GPS_Pos_LLH_2 (9175842x, 0x8C0322x) */
/begin MEASUREMENT crt_PT_8c0322_GPS_Pos_LLH_Longitude "signal GPS_Pos_LLH_Longitude of frame RT_SB_GPS_Pos_LLH_2 (9175842x, 0x8C0322x)" SLONG CONV_crt_PT_8c0322_GPS_Pos_LLH_Longitude 0 0 -180.0 180.0 ECU_ADDRESS 0x0000 /end MEASUREMENT
/begin COMPU_METHOD CONV_crt_PT_8c0322_GPS_Pos_LLH_Longitude "Linear scaling, used for variable crt_PT_8c0322_GPS_Pos_LLH_Longitude, signal GPS_Pos_LLH_Longitude" RAT_FUNC "%12" "degrees" COEFFS 0 -1 0.0 0 0 -1.0E-7 /end COMPU_METHOD
/* Measurement point for signal GPS_Pos_LLH_Altitude of frame RT_SB_GPS_Pos_LLH_2 (9175842x, 0x8C0322x) */
/begin MEASUREMENT crt_PT_8c0322_GPS_Pos_LLH_Altitude "signal GPS_Pos_LLH_Altitude of frame RT_SB_GPS_Pos_LLH_2 (9175842x, 0x8C0322x)" SLONG CONV_crt_PT_8c0322_GPS_Pos_LLH_Altitude 0 0 -1000.0 100000.0 ECU_ADDRESS 0x0000 /end MEASUREMENT
/begin COMPU_METHOD CONV_crt_PT_8c0322_GPS_Pos_LLH_Altitude "Linear scaling, used for variable crt_PT_8c0322_GPS_Pos_LLH_Altitude, signal GPS_Pos_LLH_Altitude" RAT_FUNC "%12" "m" COEFFS 0 -1 0.0 0 0 -0.001 /end COMPU_METHOD
/* Measurement point for signal Validity_GPS_Pos_LLH_Latitude of frame RT_SB_GPS_Pos_LLH_1 (9175586x, 0x8C0222x) */
/begin MEASUREMENT crt_PT_8c0222_Validity_GPS_Pos_LLH_Latitude "signal Validity_GPS_Pos_LLH_Latitude of frame RT_SB_GPS_Pos_LLH_1 (9175586x, 0x8C0222x). Valid when bit is set, invalid when bit is clear." UBYTE CONV_crt_PT_8c0222_Validity_GPS_Pos_LLH_Latitude 0 0 0 1 ECU_ADDRESS 0x0000 /end MEASUREMENT
/begin COMPU_METHOD CONV_crt_PT_8c0222_Validity_GPS_Pos_LLH_Latitude "Identity, real-world value is same as binary value" IDENTICAL "%1" "" /end COMPU_METHOD
/* Measurement point for signal Validity_GPS_Pos_LLH_Longitude of frame RT_SB_GPS_Pos_LLH_1 (9175586x, 0x8C0222x) */
/begin MEASUREMENT crt_PT_8c0222_Validity_GPS_Pos_LLH_Longitude "signal Validity_GPS_Pos_LLH_Longitude of frame RT_SB_GPS_Pos_LLH_1 (9175586x, 0x8C0222x). Valid when bit is set, invalid when bit is clear." UBYTE CONV_crt_PT_8c0222_Validity_GPS_Pos_LLH_Longitude 0 0 0 1 ECU_ADDRESS 0x0000 /end MEASUREMENT
/begin COMPU_METHOD CONV_crt_PT_8c0222_Validity_GPS_Pos_LLH_Longitude "Identity, real-world value is same as binary value" IDENTICAL "%1" "" /end COMPU_METHOD
/* Measurement point for signal Validity_GPS_Pos_LLH_Altitude of frame RT_SB_GPS_Pos_LLH_1 (9175586x, 0x8C0222x) */
/begin MEASUREMENT crt_PT_8c0222_Validity_GPS_Pos_LLH_Altitude "signal Validity_GPS_Pos_LLH_Altitude of frame RT_SB_GPS_Pos_LLH_1 (9175586x, 0x8C0222x). Valid when bit is set, invalid when bit is clear." UBYTE CONV_crt_PT_8c0222_Validity_GPS_Pos_LLH_Altitude 0 0 0 1 ECU_ADDRESS 0x0000 /end MEASUREMENT
/begin COMPU_METHOD CONV_crt_PT_8c0222_Validity_GPS_Pos_LLH_Altitude "Identity, real-world value is same as binary value" IDENTICAL "%1" "" /end COMPU_METHOD
/* Measurement point for signal Accuracy_GPS_Pos_LLH_Latitude of frame RT_SB_GPS_Pos_LLH_1 (9175586x, 0x8C0222x) */
/begin MEASUREMENT crt_PT_8c0222_Accuracy_GPS_Pos_LLH_Latitude "signal Accuracy_GPS_Pos_LLH_Latitude of frame RT_SB_GPS_Pos_LLH_1 (9175586x, 0x8C0222x). This accuracy value applies to both 2D and 3D GPS speed." UBYTE CONV_crt_PT_8c0222_Accuracy_GPS_Pos_LLH_Latitude 0 0 0 255 ECU_ADDRESS 0x0000 /end MEASUREMENT
/begin COMPU_METHOD CONV_crt_PT_8c0222_Accuracy_GPS_Pos_LLH_Latitude "Identity, real-world value is same as binary value" IDENTICAL "%4" "" /end COMPU_METHOD
/* Measurement point for signal Accuracy_GPS_Pos_LLH_Longitude of frame RT_SB_GPS_Pos_LLH_1 (9175586x, 0x8C0222x) */
/begin MEASUREMENT crt_PT_8c0222_Accuracy_GPS_Pos_LLH_Longitude "signal Accuracy_GPS_Pos_LLH_Longitude of frame RT_SB_GPS_Pos_LLH_1 (9175586x, 0x8C0222x). This accuracy value applies to both 2D and 3D GPS speed." UBYTE CONV_crt_PT_8c0222_Accuracy_GPS_Pos_LLH_Longitude 0 0 0 255 ECU_ADDRESS 0x0000 /end MEASUREMENT
/begin COMPU_METHOD CONV_crt_PT_8c0222_Accuracy_GPS_Pos_LLH_Longitude "Identity, real-world value is same as binary value" IDENTICAL "%4" "" /end COMPU_METHOD
/* Measurement point for signal Accuracy_GPS_Pos_LLH_Altitude of frame RT_SB_GPS_Pos_LLH_1 (9175586x, 0x8C0222x) */
/begin MEASUREMENT crt_PT_8c0222_Accuracy_GPS_Pos_LLH_Altitude "signal Accuracy_GPS_Pos_LLH_Altitude of frame RT_SB_GPS_Pos_LLH_1 (9175586x, 0x8C0222x). This accuracy value applies to both 2D and 3D GPS speed." UBYTE CONV_crt_PT_8c0222_Accuracy_GPS_Pos_LLH_Altitude 0 0 0 255 ECU_ADDRESS 0x0000 /end MEASUREMENT
/begin COMPU_METHOD CONV_crt_PT_8c0222_Accuracy_GPS_Pos_LLH_Altitude "Identity, real-world value is same as binary value" IDENTICAL "%4" "" /end COMPU_METHOD
/* Measurement point for signal GPS_Pos_LLH_Latitude of frame RT_SB_GPS_Pos_LLH_1 (9175586x, 0x8C0222x) */
/begin MEASUREMENT crt_PT_8c0222_GPS_Pos_LLH_Latitude "signal GPS_Pos_LLH_Latitude of frame RT_SB_GPS_Pos_LLH_1 (9175586x, 0x8C0222x)" SLONG CONV_crt_PT_8c0222_GPS_Pos_LLH_Latitude 0 0 -90.0 90.0 ECU_ADDRESS 0x0000 /end MEASUREMENT
/begin COMPU_METHOD CONV_crt_PT_8c0222_GPS_Pos_LLH_Latitude "Linear scaling, used for variable crt_PT_8c0222_GPS_Pos_LLH_Latitude, signal GPS_Pos_LLH_Latitude" RAT_FUNC "%12" "degrees" COEFFS 0 -1 0.0 0 0 -1.0E-7 /end COMPU_METHOD
/* Measurement point for signal Validity_GPS_Heading of frame RT_SB_GPS_Heading_Gradient (9180450x, 0x8C1522x) */
/begin MEASUREMENT crt_PT_8c1522_Validity_GPS_Heading "signal Validity_GPS_Heading of frame RT_SB_GPS_Heading_Gradient (9180450x, 0x8C1522x). Valid when bit is set, invalid when bit is clear." UBYTE CONV_crt_PT_8c1522_Validity_GPS_Heading 0 0 0 1 ECU_ADDRESS 0x0000 /end MEASUREMENT
/begin COMPU_METHOD CONV_crt_PT_8c1522_Validity_GPS_Heading "Identity, real-world value is same as binary value" IDENTICAL "%1" "" /end COMPU_METHOD
/* Measurement point for signal Validity_GPS_Gradient of frame RT_SB_GPS_Heading_Gradient (9180450x, 0x8C1522x) */
/begin MEASUREMENT crt_PT_8c1522_Validity_GPS_Gradient "signal Validity_GPS_Gradient of frame RT_SB_GPS_Heading_Gradient (9180450x, 0x8C1522x). Valid when bit is set, invalid when bit is clear." UBYTE CONV_crt_PT_8c1522_Validity_GPS_Gradient 0 0 0 1 ECU_ADDRESS 0x0000 /end MEASUREMENT
/begin COMPU_METHOD CONV_crt_PT_8c1522_Validity_GPS_Gradient "Identity, real-world value is same as binary value" IDENTICAL "%1" "" /end COMPU_METHOD
/* Measurement point for signal Accuracy_GPS_Heading of frame RT_SB_GPS_Heading_Gradient (9180450x, 0x8C1522x) */
/begin MEASUREMENT crt_PT_8c1522_Accuracy_GPS_Heading "signal Accuracy_GPS_Heading of frame RT_SB_GPS_Heading_Gradient (9180450x, 0x8C1522x). Dimensionless.  Lower values imply but do not guarantee better accuracy than higher values." UBYTE CONV_crt_PT_8c1522_Accuracy_GPS_Heading 0 0 0 255 ECU_ADDRESS 0x0000 /end MEASUREMENT
/begin COMPU_METHOD CONV_crt_PT_8c1522_Accuracy_GPS_Heading "Identity, real-world value is same as binary value" IDENTICAL "%4" "" /end COMPU_METHOD
/* Measurement point for signal GPS_Heading of frame RT_SB_GPS_Heading_Gradient (9180450x, 0x8C1522x) */
/begin MEASUREMENT crt_PT_8c1522_GPS_Heading "signal GPS_Heading of frame RT_SB_GPS_Heading_Gradient (9180450x, 0x8C1522x). This is GPS heading, the direction that the vehicle is travelling in the local horizontal plane." SWORD CONV_crt_PT_8c1522_GPS_Heading 0 0 -180.0 180.0 ECU_ADDRESS 0x0000 /end MEASUREMENT
/begin COMPU_METHOD CONV_crt_PT_8c1522_GPS_Heading "Linear scaling, used for variable crt_PT_8c1522_GPS_Heading, signal GPS_Heading" RAT_FUNC "%6" "degrees" COEFFS 0 -1 0.0 0 0 -0.01 /end COMPU_METHOD
/* Measurement point for signal Accuracy_GPS_Gradient of frame RT_SB_GPS_Heading_Gradient (9180450x, 0x8C1522x) */
/begin MEASUREMENT crt_PT_8c1522_Accuracy_GPS_Gradient "signal Accuracy_GPS_Gradient of frame RT_SB_GPS_Heading_Gradient (9180450x, 0x8C1522x). Dimensionless.  Lower values imply but do not guarantee better accuracy than higher values." UBYTE CONV_crt_PT_8c1522_Accuracy_GPS_Gradient 0 0 0 255 ECU_ADDRESS 0x0000 /end MEASUREMENT
/begin COMPU_METHOD CONV_crt_PT_8c1522_Accuracy_GPS_Gradient "Identity, real-world value is same as binary value" IDENTICAL "%4" "" /end COMPU_METHOD
/* Measurement point for signal GPS_Gradient of frame RT_SB_GPS_Heading_Gradient (9180450x, 0x8C1522x) */
/begin MEASUREMENT crt_PT_8c1522_GPS_Gradient "signal GPS_Gradient of frame RT_SB_GPS_Heading_Gradient (9180450x, 0x8C1522x). This is GPS gradient, i.e. the vertical direction that the vehicle is travelling, NOT pointing (pitch)." SWORD CONV_crt_PT_8c1522_GPS_Gradient 0 0 -90.0 90.0 ECU_ADDRESS 0x0000 /end MEASUREMENT
/begin COMPU_METHOD CONV_crt_PT_8c1522_GPS_Gradient "Linear scaling, used for variable crt_PT_8c1522_GPS_Gradient, signal GPS_Gradient" RAT_FUNC "%6" "degrees" COEFFS 0 -1 0.0 0 0 -0.01 /end COMPU_METHOD
/* Measurement point for signal Validity_GPS_Vel_ECEF_Y of frame RT_SB_GPS_Vel_ECEF_2 (9180194x, 0x8C1422x) */
/begin MEASUREMENT crt_PT_8c1422_Validity_GPS_Vel_ECEF_Y "signal Validity_GPS_Vel_ECEF_Y of frame RT_SB_GPS_Vel_ECEF_2 (9180194x, 0x8C1422x). Valid when bit is set, invalid when bit is clear." UBYTE CONV_crt_PT_8c1422_Validity_GPS_Vel_ECEF_Y 0 0 0 1 ECU_ADDRESS 0x0000 /end MEASUREMENT
/begin COMPU_METHOD CONV_crt_PT_8c1422_Validity_GPS_Vel_ECEF_Y "Identity, real-world value is same as binary value" IDENTICAL "%1" "" /end COMPU_METHOD
/* Measurement point for signal Validity_GPS_Vel_ECEF_Z of frame RT_SB_GPS_Vel_ECEF_2 (9180194x, 0x8C1422x) */
/begin MEASUREMENT crt_PT_8c1422_Validity_GPS_Vel_ECEF_Z "signal Validity_GPS_Vel_ECEF_Z of frame RT_SB_GPS_Vel_ECEF_2 (9180194x, 0x8C1422x). Valid when bit is set, invalid when bit is clear." UBYTE CONV_crt_PT_8c1422_Validity_GPS_Vel_ECEF_Z 0 0 0 1 ECU_ADDRESS 0x0000 /end MEASUREMENT
/begin COMPU_METHOD CONV_crt_PT_8c1422_Validity_GPS_Vel_ECEF_Z "Identity, real-world value is same as binary value" IDENTICAL "%1" "" /end COMPU_METHOD
/* Measurement point for signal GPS_Vel_ECEF_Y of frame RT_SB_GPS_Vel_ECEF_2 (9180194x, 0x8C1422x) */
/begin MEASUREMENT crt_PT_8c1422_GPS_Vel_ECEF_Y "signal GPS_Vel_ECEF_Y of frame RT_SB_GPS_Vel_ECEF_2 (9180194x, 0x8C1422x). ECEF Y velocity.  The ECEF Y axis originates from the Earth centre, and the positive Y axis intersects the Earth surface at zero degrees latittude and 90 degrees longitude." SLONG CONV_crt_PT_8c1422_GPS_Vel_ECEF_Y 0 0 -838.0 838.0 ECU_ADDRESS 0x0000 /end MEASUREMENT
/begin COMPU_METHOD CONV_crt_PT_8c1422_GPS_Vel_ECEF_Y "Linear scaling, used for variable crt_PT_8c1422_GPS_Vel_ECEF_Y, signal GPS_Vel_ECEF_Y" RAT_FUNC "%12" "m/s" COEFFS 0 -1 0.0 0 0 -1.0E-4 /end COMPU_METHOD
/* Measurement point for signal GPS_Vel_ECEF_Z of frame RT_SB_GPS_Vel_ECEF_2 (9180194x, 0x8C1422x) */
/begin MEASUREMENT crt_PT_8c1422_GPS_Vel_ECEF_Z "signal GPS_Vel_ECEF_Z of frame RT_SB_GPS_Vel_ECEF_2 (9180194x, 0x8C1422x). ECEF Z velocity.  The ECEF Z axis originates from the Earth centre, and the positive Z axis intersects the Earth surface at the North Pole." SLONG CONV_crt_PT_8c1422_GPS_Vel_ECEF_Z 0 0 -838.0 838.0 ECU_ADDRESS 0x0000 /end MEASUREMENT
/begin COMPU_METHOD CONV_crt_PT_8c1422_GPS_Vel_ECEF_Z "Linear scaling, used for variable crt_PT_8c1422_GPS_Vel_ECEF_Z, signal GPS_Vel_ECEF_Z" RAT_FUNC "%12" "m/s" COEFFS 0 -1 0.0 0 0 -1.0E-4 /end COMPU_METHOD
/* Measurement point for signal Validity_GPS_Vel_ECEF_X of frame RT_SB_GPS_Vel_ECEF_1 (9179938x, 0x8C1322x) */
/begin MEASUREMENT crt_PT_8c1322_Validity_GPS_Vel_ECEF_X "signal Validity_GPS_Vel_ECEF_X of frame RT_SB_GPS_Vel_ECEF_1 (9179938x, 0x8C1322x). Valid when bit is set, invalid when bit is clear." UBYTE CONV_crt_PT_8c1322_Validity_GPS_Vel_ECEF_X 0 0 0 1 ECU_ADDRESS 0x0000 /end MEASUREMENT
/begin COMPU_METHOD CONV_crt_PT_8c1322_Validity_GPS_Vel_ECEF_X "Identity, real-world value is same as binary value" IDENTICAL "%1" "" /end COMPU_METHOD
/* Measurement point for signal Accuracy_GPS_Vel_ECEF_X of frame RT_SB_GPS_Vel_ECEF_1 (9179938x, 0x8C1322x) */
/begin MEASUREMENT crt_PT_8c1322_Accuracy_GPS_Vel_ECEF_X "signal Accuracy_GPS_Vel_ECEF_X of frame RT_SB_GPS_Vel_ECEF_1 (9179938x, 0x8C1322x)" UBYTE CONV_crt_PT_8c1322_Accuracy_GPS_Vel_ECEF_X 0 0 0 255 ECU_ADDRESS 0x0000 /end MEASUREMENT
/begin COMPU_METHOD CONV_crt_PT_8c1322_Accuracy_GPS_Vel_ECEF_X "Identity, real-world value is same as binary value" IDENTICAL "%4" "" /end COMPU_METHOD
/* Measurement point for signal Accuracy_GPS_Vel_ECEF_Y of frame RT_SB_GPS_Vel_ECEF_1 (9179938x, 0x8C1322x) */
/begin MEASUREMENT crt_PT_8c1322_Accuracy_GPS_Vel_ECEF_Y "signal Accuracy_GPS_Vel_ECEF_Y of frame RT_SB_GPS_Vel_ECEF_1 (9179938x, 0x8C1322x)" UBYTE CONV_crt_PT_8c1322_Accuracy_GPS_Vel_ECEF_Y 0 0 0 255 ECU_ADDRESS 0x0000 /end MEASUREMENT
/begin COMPU_METHOD CONV_crt_PT_8c1322_Accuracy_GPS_Vel_ECEF_Y "Identity, real-world value is same as binary value" IDENTICAL "%4" "" /end COMPU_METHOD
/* Measurement point for signal Accuracy_GPS_Vel_ECEF_Z of frame RT_SB_GPS_Vel_ECEF_1 (9179938x, 0x8C1322x) */
/begin MEASUREMENT crt_PT_8c1322_Accuracy_GPS_Vel_ECEF_Z "signal Accuracy_GPS_Vel_ECEF_Z of frame RT_SB_GPS_Vel_ECEF_1 (9179938x, 0x8C1322x)" UBYTE CONV_crt_PT_8c1322_Accuracy_GPS_Vel_ECEF_Z 0 0 0 255 ECU_ADDRESS 0x0000 /end MEASUREMENT
/begin COMPU_METHOD CONV_crt_PT_8c1322_Accuracy_GPS_Vel_ECEF_Z "Identity, real-world value is same as binary value" IDENTICAL "%4" "" /end COMPU_METHOD
/* Measurement point for signal GPS_Vel_ECEF_X of frame RT_SB_GPS_Vel_ECEF_1 (9179938x, 0x8C1322x) */
/begin MEASUREMENT crt_PT_8c1322_GPS_Vel_ECEF_X "signal GPS_Vel_ECEF_X of frame RT_SB_GPS_Vel_ECEF_1 (9179938x, 0x8C1322x). ECEF X velocity.  The ECEF X axis originates from the Earth centre, and the positive X axis intersects the Earth surface at zero degrees latittude and zero degrees longitude (the intersection of the equator and the prime meridian)." SLONG CONV_crt_PT_8c1322_GPS_Vel_ECEF_X 0 0 -838.0 838.0 ECU_ADDRESS 0x0000 /end MEASUREMENT
/begin COMPU_METHOD CONV_crt_PT_8c1322_GPS_Vel_ECEF_X "Linear scaling, used for variable crt_PT_8c1322_GPS_Vel_ECEF_X, signal GPS_Vel_ECEF_X" RAT_FUNC "%12" "m/s" COEFFS 0 -1 0.0 0 0 -1.0E-4 /end COMPU_METHOD
/* Measurement point for signal Validity_GPS_Vel_NED_D of frame RT_SB_GPS_Vel_NED_2 (0, 0x000) */
/begin MEASUREMENT crt_PT_000_Validity_GPS_Vel_NED_D "signal Validity_GPS_Vel_NED_D of frame RT_SB_GPS_Vel_NED_2 (0, 0x000). Valid when bit is set, invalid when bit is clear." UBYTE CONV_crt_PT_000_Validity_GPS_Vel_NED_D 0 0 0 1 ECU_ADDRESS 0x0000 /end MEASUREMENT
/begin COMPU_METHOD CONV_crt_PT_000_Validity_GPS_Vel_NED_D "Identity, real-world value is same as binary value" IDENTICAL "%1" "" /end COMPU_METHOD
/* Measurement point for signal Accuracy_GPS_Vel_D of frame RT_SB_GPS_Vel_NED_2 (0, 0x000) */
/begin MEASUREMENT crt_PT_000_Accuracy_GPS_Vel_D "signal Accuracy_GPS_Vel_D of frame RT_SB_GPS_Vel_NED_2 (0, 0x000)" UBYTE CONV_crt_PT_000_Accuracy_GPS_Vel_D 0 0 0 255 ECU_ADDRESS 0x0000 /end MEASUREMENT
/begin COMPU_METHOD CONV_crt_PT_000_Accuracy_GPS_Vel_D "Identity, real-world value is same as binary value" IDENTICAL "%4" "" /end COMPU_METHOD
/* Measurement point for signal GPS_Vel_NED_D of frame RT_SB_GPS_Vel_NED_2 (0, 0x000) */
/begin MEASUREMENT crt_PT_000_GPS_Vel_NED_D "signal GPS_Vel_NED_D of frame RT_SB_GPS_Vel_NED_2 (0, 0x000). VELNED D velocity.  This is the velocity vector directly downwards towards the Earth centre at the current local Earth surface position." SLONG CONV_crt_PT_000_GPS_Vel_NED_D 0 0 -838.0 838.0 ECU_ADDRESS 0x0000 /end MEASUREMENT
/begin COMPU_METHOD CONV_crt_PT_000_GPS_Vel_NED_D "Linear scaling, used for variable crt_PT_000_GPS_Vel_NED_D, signal GPS_Vel_NED_D" RAT_FUNC "%12" "m/s" COEFFS 0 -1 0.0 0 0 -1.0E-4 /end COMPU_METHOD
/* Measurement point for signal Validity_GPS_Vel_NED_N of frame RT_SB_GPS_Vel_NED_1 (536870911x, 0x1FFFFFFFx) */
/begin MEASUREMENT crt_PT_1fffffff_Validity_GPS_Vel_NED_N "signal Validity_GPS_Vel_NED_N of frame RT_SB_GPS_Vel_NED_1 (536870911x, 0x1FFFFFFFx). Valid when bit is set, invalid when bit is clear." UBYTE CONV_crt_PT_1fffffff_Validity_GPS_Vel_NED_N 0 0 0 1 ECU_ADDRESS 0x0000 /end MEASUREMENT
/begin COMPU_METHOD CONV_crt_PT_1fffffff_Validity_GPS_Vel_NED_N "Identity, real-world value is same as binary value" IDENTICAL "%1" "" /end COMPU_METHOD
/* Measurement point for signal Validity_GPS_Vel_NED_E of frame RT_SB_GPS_Vel_NED_1 (536870911x, 0x1FFFFFFFx) */
/begin MEASUREMENT crt_PT_1fffffff_Validity_GPS_Vel_NED_E "signal Validity_GPS_Vel_NED_E of frame RT_SB_GPS_Vel_NED_1 (536870911x, 0x1FFFFFFFx). Valid when bit is set, invalid when bit is clear." UBYTE CONV_crt_PT_1fffffff_Validity_GPS_Vel_NED_E 0 0 0 1 ECU_ADDRESS 0x0000 /end MEASUREMENT
/begin COMPU_METHOD CONV_crt_PT_1fffffff_Validity_GPS_Vel_NED_E "Identity, real-world value is same as binary value" IDENTICAL "%1" "" /end COMPU_METHOD
/* Measurement point for signal Accuracy_GPS_Vel_NE of frame RT_SB_GPS_Vel_NED_1 (536870911x, 0x1FFFFFFFx) */
/begin MEASUREMENT crt_PT_1fffffff_Accuracy_GPS_Vel_NE "signal Accuracy_GPS_Vel_NE of frame RT_SB_GPS_Vel_NED_1 (536870911x, 0x1FFFFFFFx)" UBYTE CONV_crt_PT_1fffffff_Accuracy_GPS_Vel_NE 0 0 0 255 ECU_ADDRESS 0x0000 /end MEASUREMENT
/begin COMPU_METHOD CONV_crt_PT_1fffffff_Accuracy_GPS_Vel_NE "Identity, real-world value is same as binary value" IDENTICAL "%4" "" /end COMPU_METHOD
/* Measurement point for signal GPS_Vel_NED_N of frame RT_SB_GPS_Vel_NED_1 (536870911x, 0x1FFFFFFFx) */
/begin MEASUREMENT crt_PT_1fffffff_GPS_Vel_NED_N "signal GPS_Vel_NED_N of frame RT_SB_GPS_Vel_NED_1 (536870911x, 0x1FFFFFFFx). VELNED N velocity.  This is the velocity vector directly North at the current local Earth surface position." SLONG CONV_crt_PT_1fffffff_GPS_Vel_NED_N 0 0 -838.0 838.0 ECU_ADDRESS 0x0000 /end MEASUREMENT
/begin COMPU_METHOD CONV_crt_PT_1fffffff_GPS_Vel_NED_N "Linear scaling, used for variable crt_PT_1fffffff_GPS_Vel_NED_N, signal GPS_Vel_NED_N" RAT_FUNC "%12" "m/s" COEFFS 0 -1 0.0 0 0 -1.0E-4 /end COMPU_METHOD
/* Measurement point for signal GPS_Vel_NED_E of frame RT_SB_GPS_Vel_NED_1 (536870911x, 0x1FFFFFFFx) */
/begin MEASUREMENT crt_PT_1fffffff_GPS_Vel_NED_E "signal GPS_Vel_NED_E of frame RT_SB_GPS_Vel_NED_1 (536870911x, 0x1FFFFFFFx). VELNED E velocity.  This is the velocity vector directly East at the current local Earth surface position." SLONG CONV_crt_PT_1fffffff_GPS_Vel_NED_E 0 0 -838.0 838.0 ECU_ADDRESS 0x0000 /end MEASUREMENT
/begin COMPU_METHOD CONV_crt_PT_1fffffff_GPS_Vel_NED_E "Linear scaling, used for variable crt_PT_1fffffff_GPS_Vel_NED_E, signal GPS_Vel_NED_E" RAT_FUNC "%12" "m/s" COEFFS 0 -1 0.0 0 0 -1.0E-4 /end COMPU_METHOD
/* Measurement point for signal Validity_GPS_Speed_2D of frame RT_SB_GPS_Speed (1818, 0x71A) */
/begin MEASUREMENT crt_PT_71a_Validity_GPS_Speed_2D "signal Validity_GPS_Speed_2D of frame RT_SB_GPS_Speed (1818, 0x71A). Valid when bit is set, invalid when bit is clear." UBYTE CONV_crt_PT_71a_Validity_GPS_Speed_2D 0 0 0 1 ECU_ADDRESS 0x0000 /end MEASUREMENT
/begin COMPU_METHOD CONV_crt_PT_71a_Validity_GPS_Speed_2D "Identity, real-world value is same as binary value" IDENTICAL "%1" "" /end COMPU_METHOD
/* Measurement point for signal Validity_GPS_Speed_3D of frame RT_SB_GPS_Speed (1818, 0x71A) */
/begin MEASUREMENT crt_PT_71a_Validity_GPS_Speed_3D "signal Validity_GPS_Speed_3D of frame RT_SB_GPS_Speed (1818, 0x71A). Valid when bit is set, invalid when bit is clear." UBYTE CONV_crt_PT_71a_Validity_GPS_Speed_3D 0 0 0 1 ECU_ADDRESS 0x0000 /end MEASUREMENT
/begin COMPU_METHOD CONV_crt_PT_71a_Validity_GPS_Speed_3D "Identity, real-world value is same as binary value" IDENTICAL "%1" "" /end COMPU_METHOD
/* Measurement point for signal Accuracy_GPS_Speed of frame RT_SB_GPS_Speed (1818, 0x71A) */
/begin MEASUREMENT crt_PT_71a_Accuracy_GPS_Speed "signal Accuracy_GPS_Speed of frame RT_SB_GPS_Speed (1818, 0x71A). This accuracy value applies to both 2D and 3D GPS speed." UBYTE CONV_crt_PT_71a_Accuracy_GPS_Speed 0 0 0 255 ECU_ADDRESS 0x0000 /end MEASUREMENT
/begin COMPU_METHOD CONV_crt_PT_71a_Accuracy_GPS_Speed "Identity, real-world value is same as binary value" IDENTICAL "%4" "" /end COMPU_METHOD
/* Measurement point for signal GPS_Speed_2D of frame RT_SB_GPS_Speed (1818, 0x71A) */
/begin MEASUREMENT crt_PT_71a_GPS_Speed_2D "signal GPS_Speed_2D of frame RT_SB_GPS_Speed (1818, 0x71A). This is GPS scalar 2D speed - scalar speed with no local Z axis component included." ULONG CONV_crt_PT_71a_GPS_Speed_2D 0 0 0.0 1675.0 ECU_ADDRESS 0x0000 /end MEASUREMENT
/begin COMPU_METHOD CONV_crt_PT_71a_GPS_Speed_2D "Linear scaling, used for variable crt_PT_71a_GPS_Speed_2D, signal GPS_Speed_2D" RAT_FUNC "%12" "m/s" COEFFS 0 -1 0.0 0 0 -1.0E-4 /end COMPU_METHOD
/* Measurement point for signal GPS_Speed_3D of frame RT_SB_GPS_Speed (1818, 0x71A) */
/begin MEASUREMENT crt_PT_71a_GPS_Speed_3D "signal GPS_Speed_3D of frame RT_SB_GPS_Speed (1818, 0x71A). This is GPS scalar 3D speed - scalar speed with the local Z axis component included." ULONG CONV_crt_PT_71a_GPS_Speed_3D 0 0 0.0 1675.0 ECU_ADDRESS 0x0000 /end MEASUREMENT
/begin COMPU_METHOD CONV_crt_PT_71a_GPS_Speed_3D "Linear scaling, used for variable crt_PT_71a_GPS_Speed_3D, signal GPS_Speed_3D" RAT_FUNC "%12" "m/s" COEFFS 0 -1 0.0 0 0 -1.0E-4 /end COMPU_METHOD
/* Measurement point for signal Validity_GPS_Time of frame RT_SB_GPS_Time (2047, 0x7FF) */
/begin MEASUREMENT crt_PT_7ff_Validity_GPS_Time "signal Validity_GPS_Time of frame RT_SB_GPS_Time (2047, 0x7FF). Valid when bit is set, invalid when bit is clear." UBYTE CONV_crt_PT_7ff_Validity_GPS_Time 0 0 0 1 ECU_ADDRESS 0x0000 /end MEASUREMENT
/begin COMPU_METHOD CONV_crt_PT_7ff_Validity_GPS_Time "Identity, real-world value is same as binary value" IDENTICAL "%1" "" /end COMPU_METHOD
/* Measurement point for signal Validity_GPS_Week of frame RT_SB_GPS_Time (2047, 0x7FF) */
/begin MEASUREMENT crt_PT_7ff_Validity_GPS_Week "signal Validity_GPS_Week of frame RT_SB_GPS_Time (2047, 0x7FF). Valid when bit is set, invalid when bit is clear." UBYTE CONV_crt_PT_7ff_Validity_GPS_Week 0 0 0 1 ECU_ADDRESS 0x0000 /end MEASUREMENT
/begin COMPU_METHOD CONV_crt_PT_7ff_Validity_GPS_Week "Identity, real-world value is same as binary value" IDENTICAL "%1" "" /end COMPU_METHOD
/* Measurement point for signal Accuracy_GPS_Time of frame RT_SB_GPS_Time (2047, 0x7FF) */
/begin MEASUREMENT crt_PT_7ff_Accuracy_GPS_Time "signal Accuracy_GPS_Time of frame RT_SB_GPS_Time (2047, 0x7FF)" UBYTE CONV_crt_PT_7ff_Accuracy_GPS_Time 0 0 0 255 ECU_ADDRESS 0x0000 /end MEASUREMENT
/begin COMPU_METHOD CONV_crt_PT_7ff_Accuracy_GPS_Time "Identity, real-world value is same as binary value" IDENTICAL "%4" "" /end COMPU_METHOD
/* Measurement point for signal GPS_Time of frame RT_SB_GPS_Time (2047, 0x7FF) */
/begin MEASUREMENT crt_PT_7ff_GPS_Time "signal GPS_Time of frame RT_SB_GPS_Time (2047, 0x7FF). GPS time is the time in seconds since midnight GMT on Saturday night." ULONG CONV_crt_PT_7ff_GPS_Time 0 0 0.0 604800.0 ECU_ADDRESS 0x0000 /end MEASUREMENT
/begin COMPU_METHOD CONV_crt_PT_7ff_GPS_Time "Linear scaling, used for variable crt_PT_7ff_GPS_Time, signal GPS_Time" RAT_FUNC "%12" "s" COEFFS 0 -1 0.0 0 0 -0.001 /end COMPU_METHOD
/* Measurement point for signal GPS_Week of frame RT_SB_GPS_Time (2047, 0x7FF) */
/begin MEASUREMENT crt_PT_7ff_GPS_Week "signal GPS_Week of frame RT_SB_GPS_Time (2047, 0x7FF)" UWORD CONV_crt_PT_7ff_GPS_Week 0 0 0 65535 ECU_ADDRESS 0x0000 /end MEASUREMENT
/begin COMPU_METHOD CONV_crt_PT_7ff_GPS_Week "Identity, real-world value is same as binary value" IDENTICAL "%6" "" /end COMPU_METHOD
/* Measurement point for signal Validity_Accel_Longitudinal of frame RT_SB_Accel (290, 0x122) */
/begin MEASUREMENT crt_PT_122_Validity_Accel_Longitudinal "signal Validity_Accel_Longitudinal of frame RT_SB_Accel (290, 0x122). Valid when bit is set, invalid when bit is clear." UBYTE CONV_crt_PT_122_Validity_Accel_Longitudinal 0 0 0 1 ECU_ADDRESS 0x0000 /end MEASUREMENT
/begin COMPU_METHOD CONV_crt_PT_122_Validity_Accel_Longitudinal "Identity, real-world value is same as binary value" IDENTICAL "%1" "" /end COMPU_METHOD
/* Measurement point for signal Validity_Accel_Lateral of frame RT_SB_Accel (290, 0x122) */
/begin MEASUREMENT crt_PT_122_Validity_Accel_Lateral "signal Validity_Accel_Lateral of frame RT_SB_Accel (290, 0x122). Valid when bit is set, invalid when bit is clear." UBYTE CONV_crt_PT_122_Validity_Accel_Lateral 0 0 0 1 ECU_ADDRESS 0x0000 /end MEASUREMENT
/begin COMPU_METHOD CONV_crt_PT_122_Validity_Accel_Lateral "Identity, real-world value is same as binary value" IDENTICAL "%1" "" /end COMPU_METHOD
/* Measurement point for signal Validity_Accel_Vertical of frame RT_SB_Accel (290, 0x122) */
/begin MEASUREMENT crt_PT_122_Validity_Accel_Vertical "signal Validity_Accel_Vertical of frame RT_SB_Accel (290, 0x122). Valid when bit is set, invalid when bit is clear." UBYTE CONV_crt_PT_122_Validity_Accel_Vertical 0 0 0 1 ECU_ADDRESS 0x0000 /end MEASUREMENT
/begin COMPU_METHOD CONV_crt_PT_122_Validity_Accel_Vertical "Identity, real-world value is same as binary value" IDENTICAL "%1" "" /end COMPU_METHOD
/* Measurement point for signal Accuracy_Accel of frame RT_SB_Accel (290, 0x122) */
/begin MEASUREMENT crt_PT_122_Accuracy_Accel "signal Accuracy_Accel of frame RT_SB_Accel (290, 0x122). Dimensionless.  Lower values imply but do not guarantee better accuracy than higher values." UBYTE CONV_crt_PT_122_Accuracy_Accel 0 0 0 255 ECU_ADDRESS 0x0000 /end MEASUREMENT
/begin COMPU_METHOD CONV_crt_PT_122_Accuracy_Accel "Identity, real-world value is same as binary value" IDENTICAL "%4" "" /end COMPU_METHOD
/* Measurement point for signal Accel_Longitudinal of frame RT_SB_Accel (290, 0x122) */
/begin MEASUREMENT crt_PT_122_Accel_Longitudinal "signal Accel_Longitudinal of frame RT_SB_Accel (290, 0x122). Longitudinal acceleration.  This is positive when the vehicle accelerates in a forwards direction." SWORD CONV_crt_PT_122_Accel_Longitudinal 0 0 -65.0 65.0 ECU_ADDRESS 0x0000 /end MEASUREMENT
/begin COMPU_METHOD CONV_crt_PT_122_Accel_Longitudinal "Linear scaling, used for variable crt_PT_122_Accel_Longitudinal, signal Accel_Longitudinal" RAT_FUNC "%6" "g" COEFFS 0 -1 0.0 0 0 -0.001 /end COMPU_METHOD
/* Measurement point for signal Accel_Lateral of frame RT_SB_Accel (290, 0x122) */
/begin MEASUREMENT crt_PT_122_Accel_Lateral "signal Accel_Lateral of frame RT_SB_Accel (290, 0x122). Lateral acceleration.  This is positive when the vehicle accelerates towards the right, e.g. when cornering around a right-hand bend." SWORD CONV_crt_PT_122_Accel_Lateral 0 0 -65.0 65.0 ECU_ADDRESS 0x0000 /end MEASUREMENT
/begin COMPU_METHOD CONV_crt_PT_122_Accel_Lateral "Linear scaling, used for variable crt_PT_122_Accel_Lateral, signal Accel_Lateral" RAT_FUNC "%6" "g" COEFFS 0 -1 0.0 0 0 -0.001 /end COMPU_METHOD
/* Measurement point for signal Accel_Vertical of frame RT_SB_Accel (290, 0x122) */
/begin MEASUREMENT crt_PT_122_Accel_Vertical "signal Accel_Vertical of frame RT_SB_Accel (290, 0x122). Vertical acceleration.  This is positive when the vehicle accelerates in an upwards direction, e.g. when travelling through a dip." SWORD CONV_crt_PT_122_Accel_Vertical 0 0 -65.0 65.0 ECU_ADDRESS 0x0000 /end MEASUREMENT
/begin COMPU_METHOD CONV_crt_PT_122_Accel_Vertical "Linear scaling, used for variable crt_PT_122_Accel_Vertical, signal Accel_Vertical" RAT_FUNC "%6" "g" COEFFS 0 -1 0.0 0 0 -0.001 /end COMPU_METHOD
/* Measurement point for signal Validity_Gyro_Rate_Yaw of frame RT_SB_Gyro_Rates (8388898x, 0x800122x) */
/begin MEASUREMENT crt_PT_800122_Validity_Gyro_Rate_Yaw "signal Validity_Gyro_Rate_Yaw of frame RT_SB_Gyro_Rates (8388898x, 0x800122x). Valid when bit is set, invalid when bit is clear." UBYTE CONV_crt_PT_800122_Validity_Gyro_Rate_Yaw 0 0 0 1 ECU_ADDRESS 0x0000 /end MEASUREMENT
/begin COMPU_METHOD CONV_crt_PT_800122_Validity_Gyro_Rate_Yaw "Identity, real-world value is same as binary value" IDENTICAL "%1" "" /end COMPU_METHOD
/* Measurement point for signal Validity_Gyro_Rate_Pitch of frame RT_SB_Gyro_Rates (8388898x, 0x800122x) */
/begin MEASUREMENT crt_PT_800122_Validity_Gyro_Rate_Pitch "signal Validity_Gyro_Rate_Pitch of frame RT_SB_Gyro_Rates (8388898x, 0x800122x). Valid when bit is set, invalid when bit is clear." UBYTE CONV_crt_PT_800122_Validity_Gyro_Rate_Pitch 0 0 0 1 ECU_ADDRESS 0x0000 /end MEASUREMENT
/begin COMPU_METHOD CONV_crt_PT_800122_Validity_Gyro_Rate_Pitch "Identity, real-world value is same as binary value" IDENTICAL "%1" "" /end COMPU_METHOD
/* Measurement point for signal Validity_Gyro_Rate_Roll of frame RT_SB_Gyro_Rates (8388898x, 0x800122x) */
/begin MEASUREMENT crt_PT_800122_Validity_Gyro_Rate_Roll "signal Validity_Gyro_Rate_Roll of frame RT_SB_Gyro_Rates (8388898x, 0x800122x). Valid when bit is set, invalid when bit is clear." UBYTE CONV_crt_PT_800122_Validity_Gyro_Rate_Roll 0 0 0 1 ECU_ADDRESS 0x0000 /end MEASUREMENT
/begin COMPU_METHOD CONV_crt_PT_800122_Validity_Gyro_Rate_Roll "Identity, real-world value is same as binary value" IDENTICAL "%1" "" /end COMPU_METHOD
/* Measurement point for signal Accuracy_Gyro_Rates of frame RT_SB_Gyro_Rates (8388898x, 0x800122x) */
/begin MEASUREMENT crt_PT_800122_Accuracy_Gyro_Rates "signal Accuracy_Gyro_Rates of frame RT_SB_Gyro_Rates (8388898x, 0x800122x). Dimensionless.  Lower values imply but do not guarantee better accuracy than higher values." UBYTE CONV_crt_PT_800122_Accuracy_Gyro_Rates 0 0 0 0 ECU_ADDRESS 0x0000 /end MEASUREMENT
/begin COMPU_METHOD CONV_crt_PT_800122_Accuracy_Gyro_Rates "Identity, real-world value is same as binary value" IDENTICAL "%4" "" /end COMPU_METHOD
/* Measurement point for signal Gyro_Rate_Yaw of frame RT_SB_Gyro_Rates (8388898x, 0x800122x) */
/begin MEASUREMENT crt_PT_800122_Gyro_Rate_Yaw "signal Gyro_Rate_Yaw of frame RT_SB_Gyro_Rates (8388898x, 0x800122x). Yaw rate is positive for clockwise rotation when looking down on the vehicle from above." SWORD CONV_crt_PT_800122_Gyro_Rate_Yaw 0 0 -327.0 327.0 ECU_ADDRESS 0x0000 /end MEASUREMENT
/begin COMPU_METHOD CONV_crt_PT_800122_Gyro_Rate_Yaw "Linear scaling, used for variable crt_PT_800122_Gyro_Rate_Yaw, signal Gyro_Rate_Yaw" RAT_FUNC "%6" "degrees/s" COEFFS 0 -1 0.0 0 0 -0.01 /end COMPU_METHOD
/* Measurement point for signal Gyro_Rate_Pitch of frame RT_SB_Gyro_Rates (8388898x, 0x800122x) */
/begin MEASUREMENT crt_PT_800122_Gyro_Rate_Pitch "signal Gyro_Rate_Pitch of frame RT_SB_Gyro_Rates (8388898x, 0x800122x). Pitch rate is positive for clockwise rotation when looking at the left hand side of the vehicle from the left of the vehicle." SWORD CONV_crt_PT_800122_Gyro_Rate_Pitch 0 0 -327.0 327.0 ECU_ADDRESS 0x0000 /end MEASUREMENT
/begin COMPU_METHOD CONV_crt_PT_800122_Gyro_Rate_Pitch "Linear scaling, used for variable crt_PT_800122_Gyro_Rate_Pitch, signal Gyro_Rate_Pitch" RAT_FUNC "%6" "degrees/s" COEFFS 0 -1 0.0 0 0 -0.01 /end COMPU_METHOD
/* Measurement point for signal Gyro_Rate_Roll of frame RT_SB_Gyro_Rates (8388898x, 0x800122x) */
/begin MEASUREMENT crt_PT_800122_Gyro_Rate_Roll "signal Gyro_Rate_Roll of frame RT_SB_Gyro_Rates (8388898x, 0x800122x). Roll rate is positive for clockwise rotation when looking at the rear of the vehicle from behind the vehicle." SWORD CONV_crt_PT_800122_Gyro_Rate_Roll 0 0 -327.0 327.0 ECU_ADDRESS 0x0000 /end MEASUREMENT
/begin COMPU_METHOD CONV_crt_PT_800122_Gyro_Rate_Roll "Linear scaling, used for variable crt_PT_800122_Gyro_Rate_Roll, signal Gyro_Rate_Roll" RAT_FUNC "%6" "degrees/s" COEFFS 0 -1 0.0 0 0 -0.01 /end COMPU_METHOD
/begin GROUP RT_DL1MK3_Accel "All signals of frame RT_DL1MK3_Accel (8388644x, 0x800024x)" /begin SUB_GROUP /end SUB_GROUP
 /begin REF_MEASUREMENT crt_PT_800024_Validity_Accel_Longitudinal crt_PT_800024_Validity_Accel_Lateral crt_PT_800024_Validity_Accel_Vertical crt_PT_800024_SQC crt_PT_800024_Accuracy_Accel crt_PT_800024_Accel_Longitudinal crt_PT_800024_Accel_Lateral crt_PT_800024_Accel_Vertical /end REF_MEASUREMENT
/end GROUP
/begin GROUP RT_SB_INS_Vpt_4_Vel_NED_2 "All signals of frame RT_SB_INS_Vpt_4_Vel_NED_2 (9384482x, 0x8F3222x)" /begin SUB_GROUP /end SUB_GROUP
 /begin REF_MEASUREMENT crt_PT_8f3222_Virtual_4_Vel_NED_D crt_PT_8f3222_Virtual_4_Heading crt_PT_8f3222_Virtual_4_Slip /end REF_MEASUREMENT
/end GROUP
/begin GROUP RT_SB_INS_Vpt_4_Vel_NED_1 "All signals of frame RT_SB_INS_Vpt_4_Vel_NED_1 (9384226x, 0x8F3122x)" /begin SUB_GROUP /end SUB_GROUP
 /begin REF_MEASUREMENT crt_PT_8f3122_Virtual_4_Vel_NED_N crt_PT_8f3122_Virtual_4_Vel_NED_E /end REF_MEASUREMENT
/end GROUP
/begin GROUP RT_SB_INS_Vpt_4_Offset "All signals of frame RT_SB_INS_Vpt_4_Offset (9383970x, 0x8F3022x)" /begin SUB_GROUP /end SUB_GROUP
 /begin REF_MEASUREMENT crt_PT_8f3022_Virtual_4_Offset_X crt_PT_8f3022_Virtual_4_Offset_Y crt_PT_8f3022_Virtual_4_Offset_Z /end REF_MEASUREMENT
/end GROUP
/begin GROUP RT_SB_INS_Vpt_3_Vel_NED_2 "All signals of frame RT_SB_INS_Vpt_3_Vel_NED_2 (9380386x, 0x8F2222x)" /begin SUB_GROUP /end SUB_GROUP
 /begin REF_MEASUREMENT crt_PT_8f2222_Virtual_3_Vel_NED_D crt_PT_8f2222_Virtual_3_Heading crt_PT_8f2222_Virtual_3_Slip /end REF_MEASUREMENT
/end GROUP
/begin GROUP RT_SB_INS_Vpt_3_Vel_NED_1 "All signals of frame RT_SB_INS_Vpt_3_Vel_NED_1 (9380130x, 0x8F2122x)" /begin SUB_GROUP /end SUB_GROUP
 /begin REF_MEASUREMENT crt_PT_8f2122_Virtual_3_Vel_NED_N crt_PT_8f2122_Virtual_3_Vel_NED_E /end REF_MEASUREMENT
/end GROUP
/begin GROUP RT_SB_INS_Vpt_3_Offset "All signals of frame RT_SB_INS_Vpt_3_Offset (9379874x, 0x8F2022x)" /begin SUB_GROUP /end SUB_GROUP
 /begin REF_MEASUREMENT crt_PT_8f2022_Virtual_3_Offset_X crt_PT_8f2022_Virtual_3_Offset_Y crt_PT_8f2022_Virtual_3_Offset_Z /end REF_MEASUREMENT
/end GROUP
/begin GROUP RT_SB_INS_Vpt_2_Vel_NED_2 "All signals of frame RT_SB_INS_Vpt_2_Vel_NED_2 (9376290x, 0x8F1222x)" /begin SUB_GROUP /end SUB_GROUP
 /begin REF_MEASUREMENT crt_PT_8f1222_Virtual_2_Vel_NED_D crt_PT_8f1222_Virtual_2_Heading crt_PT_8f1222_Virtual_2_Slip /end REF_MEASUREMENT
/end GROUP
/begin GROUP RT_SB_INS_Vpt_2_Vel_NED_1 "All signals of frame RT_SB_INS_Vpt_2_Vel_NED_1 (9376034x, 0x8F1122x)" /begin SUB_GROUP /end SUB_GROUP
 /begin REF_MEASUREMENT crt_PT_8f1122_Virtual_2_Vel_NED_N crt_PT_8f1122_Virtual_2_Vel_NED_E /end REF_MEASUREMENT
/end GROUP
/begin GROUP RT_SB_INS_Vpt_2_Offset "All signals of frame RT_SB_INS_Vpt_2_Offset (9375778x, 0x8F1022x)" /begin SUB_GROUP /end SUB_GROUP
 /begin REF_MEASUREMENT crt_PT_8f1022_Virtual_2_Offset_X crt_PT_8f1022_Virtual_2_Offset_Y crt_PT_8f1022_Virtual_2_Offset_Z /end REF_MEASUREMENT
/end GROUP
/begin GROUP RT_SB_INS_Vpt_1_Vel_NED_2 "All signals of frame RT_SB_INS_Vpt_1_Vel_NED_2 (9372194x, 0x8F0222x)" /begin SUB_GROUP /end SUB_GROUP
 /begin REF_MEASUREMENT crt_PT_8f0222_Virtual_1_Vel_NED_D crt_PT_8f0222_Virtual_1_Heading crt_PT_8f0222_Virtual_1_Slip /end REF_MEASUREMENT
/end GROUP
/begin GROUP RT_SB_INS_Vpt_1_Vel_NED_1 "All signals of frame RT_SB_INS_Vpt_1_Vel_NED_1 (9371938x, 0x8F0122x)" /begin SUB_GROUP /end SUB_GROUP
 /begin REF_MEASUREMENT crt_PT_8f0122_Virtual_1_Vel_NED_N crt_PT_8f0122_Virtual_1_Vel_NED_E /end REF_MEASUREMENT
/end GROUP
/begin GROUP RT_SB_INS_Vpt_1_Offset "All signals of frame RT_SB_INS_Vpt_1_Offset (9371682x, 0x8F0022x)" /begin SUB_GROUP /end SUB_GROUP
 /begin REF_MEASUREMENT crt_PT_8f0022_Virtual_1_Offset_X crt_PT_8f0022_Virtual_1_Offset_Y crt_PT_8f0022_Virtual_1_Offset_Z /end REF_MEASUREMENT
/end GROUP
/begin GROUP RT_SB_INS_Slip "All signals of frame RT_SB_INS_Slip (9311778x, 0x8E1622x)" /begin SUB_GROUP /end SUB_GROUP
 /begin REF_MEASUREMENT crt_PT_8e1622_Validity_INS_Slip crt_PT_8e1622_Validity_INS_Squat crt_PT_8e1622_Accuracy_INS_Slip crt_PT_8e1622_INS_Slip crt_PT_8e1622_Accuracy_INS_Squat crt_PT_8e1622_INS_Squat /end REF_MEASUREMENT
/end GROUP
/begin GROUP RT_SB_INS_Vel_ECEF_2 "All signals of frame RT_SB_INS_Vel_ECEF_2 (9311010x, 0x8E1322x)" /begin SUB_GROUP /end SUB_GROUP
 /begin REF_MEASUREMENT crt_PT_8e1322_Validity_INS_Vel_ECEF_Y crt_PT_8e1322_Validity_INS_Vel_ECEF_Z crt_PT_8e1322_INS_Vel_ECEF_Y crt_PT_8e1322_INS_Vel_ECEF_Z /end REF_MEASUREMENT
/end GROUP
/begin GROUP RT_SB_INS_Vel_ECEF_1 "All signals of frame RT_SB_INS_Vel_ECEF_1 (9310754x, 0x8E1222x)" /begin SUB_GROUP /end SUB_GROUP
 /begin REF_MEASUREMENT crt_PT_8e1222_Validity_INS_Vel_ECEF_X crt_PT_8e1222_Accuracy_INS_Vel_ECEF_X crt_PT_8e1222_Accuracy_INS_Vel_ECEF_Y crt_PT_8e1222_Accuracy_INS_Vel_ECEF_Z crt_PT_8e1222_INS_Vel_ECEF_X /end REF_MEASUREMENT
/end GROUP
/begin GROUP RT_SB_INS_Vel_NED_2 "All signals of frame RT_SB_INS_Vel_NED_2 (9310498x, 0x8E1122x)" /begin SUB_GROUP /end SUB_GROUP
 /begin REF_MEASUREMENT crt_PT_8e1122_Validity_INS_Vel_NED_D crt_PT_8e1122_Accuracy_INS_Vel_D crt_PT_8e1122_INS_Vel_NED_D /end REF_MEASUREMENT
/end GROUP
/begin GROUP RT_SB_INS_Vel_NED_1 "All signals of frame RT_SB_INS_Vel_NED_1 (9310242x, 0x8E1022x)" /begin SUB_GROUP /end SUB_GROUP
 /begin REF_MEASUREMENT crt_PT_8e1022_Validity_INS_Vel_NED_N crt_PT_8e1022_Validity_INS_Vel_NED_E crt_PT_8e1022_Accuracy_INS_Vel_NE crt_PT_8e1022_INS_Vel_NED_N crt_PT_8e1022_INS_Vel_NED_E /end REF_MEASUREMENT
/end GROUP
/begin GROUP RT_SB_INS_Pos_ECEF_2 "All signals of frame RT_SB_INS_Pos_ECEF_2 (9307426x, 0x8E0522x)" /begin SUB_GROUP /end SUB_GROUP /begin REF_MEASUREMENT crt_PT_8e0522_INS_Pos_ECEF_Y crt_PT_8e0522_INS_Pos_ECEF_Z /end REF_MEASUREMENT /end GROUP
/begin GROUP RT_SB_INS_Pos_ECEF_1 "All signals of frame RT_SB_INS_Pos_ECEF_1 (9307170x, 0x8E0422x)" /begin SUB_GROUP /end SUB_GROUP
 /begin REF_MEASUREMENT crt_PT_8e0422_Validity_INS_Pos_ECEF_X crt_PT_8e0422_Validity_INS_Pos_ECEF_Y crt_PT_8e0422_Validity_INS_Pos_ECEF_Z crt_PT_8e0422_Accuracy_INS_Pos_ECEF_X crt_PT_8e0422_Accuracy_INS_Pos_ECEF_Y crt_PT_8e0422_Accuracy_INS_Pos_ECEF_Z crt_PT_8e0422_INS_Pos_ECEF_X /end REF_MEASUREMENT
/end GROUP
/begin GROUP RT_SB_INS_Pos_LLH_2 "All signals of frame RT_SB_INS_Pos_LLH_2 (9306914x, 0x8E0322x)" /begin SUB_GROUP /end SUB_GROUP
 /begin REF_MEASUREMENT crt_PT_8e0322_INS_Pos_LLH_Longitude crt_PT_8e0322_INS_Pos_LLH_Altitude /end REF_MEASUREMENT
/end GROUP
/begin GROUP RT_SB_INS_Pos_LLH_1 "All signals of frame RT_SB_INS_Pos_LLH_1 (9306658x, 0x8E0222x)" /begin SUB_GROUP /end SUB_GROUP
 /begin REF_MEASUREMENT crt_PT_8e0222_Validity_INS_Pos_LLH_Latitude crt_PT_8e0222_Validity_INS_Pos_LLH_Longitude crt_PT_8e0222_Validity_INS_Pos_LLH_Altitude crt_PT_8e0222_Accuracy_INS_Pos_LLH_Latitude crt_PT_8e0222_Accuracy_INS_Pos_LLH_Longitude crt_PT_8e0222_Accuracy_INS_Pos_LLH_Altitude crt_PT_8e0222_INS_Pos_LLH_Latitude /end REF_MEASUREMENT
/end GROUP
/begin GROUP RT_SB_INS_Heading_Gradient_2 "All signals of frame RT_SB_INS_Heading_Gradient_2 (9311522x, 0x8E1522x)" /begin SUB_GROUP /end SUB_GROUP
 /begin REF_MEASUREMENT crt_PT_8e1522_Validity_INS_Heading crt_PT_8e1522_Validity_INS_Gradient crt_PT_8e1522_Accuracy_INS_Heading crt_PT_8e1522_INS_Heading_2 crt_PT_8e1522_Accuracy_INS_Gradient crt_PT_8e1522_INS_Gradient /end REF_MEASUREMENT
/end GROUP
/begin GROUP RT_SB_INS_Heading_Gradient "All signals of frame RT_SB_INS_Heading_Gradient (9311266x, 0x8E1422x)" /begin SUB_GROUP /end SUB_GROUP
 /begin REF_MEASUREMENT crt_PT_8e1422_Validity_INS_Heading crt_PT_8e1422_Validity_INS_Gradient crt_PT_8e1422_Accuracy_INS_Heading crt_PT_8e1422_INS_Heading crt_PT_8e1422_Accuracy_INS_Gradient crt_PT_8e1422_INS_Gradient /end REF_MEASUREMENT
/end GROUP
/begin GROUP RT_SB_INS_Status "All signals of frame RT_SB_INS_Status (9306146x, 0x8E0022x)" /begin SUB_GROUP /end SUB_GROUP /begin REF_MEASUREMENT crt_PT_8e0022_INS_Status /end REF_MEASUREMENT /end GROUP
/begin GROUP RT_SB_INS_Attitude "All signals of frame RT_SB_INS_Attitude (9306402x, 0x8E0122x)" /begin SUB_GROUP /end SUB_GROUP
 /begin REF_MEASUREMENT crt_PT_8e0122_Validity_Yaw crt_PT_8e0122_Validity_Pitch crt_PT_8e0122_Validity_Roll crt_PT_8e0122_Accuracy_Attitude crt_PT_8e0122_Attitude_Yaw crt_PT_8e0122_Attitude_Pitch crt_PT_8e0122_Attitude_Roll /end REF_MEASUREMENT
/end GROUP
/begin GROUP RT_SB_Output_Status "All signals of frame RT_SB_Output_Status (9240866x, 0x8D0122x)" /begin SUB_GROUP /end SUB_GROUP
 /begin REF_MEASUREMENT crt_PT_8d0122_Validity_Status_Timestamp crt_PT_8d0122_Status_Analogue_1 crt_PT_8d0122_Status_Analogue_2 crt_PT_8d0122_Status_Analogue_3 crt_PT_8d0122_Status_Analogue_4 crt_PT_8d0122_Status_Pulse_Output crt_PT_8d0122_Status_Serial_Output_1 crt_PT_8d0122_Status_Serial_Output_2 crt_PT_8d0122_Status_Trigger crt_PT_8d0122_GPS_Time /end REF_MEASUREMENT
/end GROUP
/begin GROUP RT_SB_GPS_Heading_Gradient_2 "All signals of frame RT_SB_GPS_Heading_Gradient_2 (9180706x, 0x8C1622x)" /begin SUB_GROUP /end SUB_GROUP
 /begin REF_MEASUREMENT crt_PT_8c1622_Validity_GPS_Heading crt_PT_8c1622_Validity_GPS_Gradient crt_PT_8c1622_Accuracy_GPS_Heading crt_PT_8c1622_GPS_Heading_2 crt_PT_8c1622_Accuracy_GPS_Gradient crt_PT_8c1622_GPS_Gradient /end REF_MEASUREMENT
/end GROUP
/begin GROUP RT_SB_Cumulative_Distance_2 "All signals of frame RT_SB_Cumulative_Distance_2 (8397090x, 0x802122x): This cumulative distance calculation is updated when the trigger is active." /begin SUB_GROUP /end SUB_GROUP
 /begin REF_MEASUREMENT crt_PT_802122_Validity_Cumulative_Time crt_PT_802122_Validity_Cumulative_Distance crt_PT_802122_Cumulative_Time crt_PT_802122_Cumulative_Distance /end REF_MEASUREMENT
/end GROUP
/begin GROUP RT_SB_Cumulative_Distance_1 "All signals of frame RT_SB_Cumulative_Distance_1 (8396834x, 0x802022x): This cumulative distance calculation is updated continuously once the first good GPS lock is obtained." /begin SUB_GROUP /end SUB_GROUP
 /begin REF_MEASUREMENT crt_PT_802022_Validity_Cumulative_Time crt_PT_802022_Validity_Cumulative_Distance crt_PT_802022_Cumulative_Time crt_PT_802022_Cumulative_Distance /end REF_MEASUREMENT
/end GROUP
/begin GROUP RT_SB_Trigger_Timestamp "All signals of frame RT_SB_Trigger_Timestamp (9240610x, 0x8D0022x)" /begin SUB_GROUP /end SUB_GROUP
 /begin REF_MEASUREMENT crt_PT_8d0022_Validity_Trigger_Timestamp crt_PT_8d0022_Accuracy_Trigger_Timestamp crt_PT_8d0022_Trigger_Number crt_PT_8d0022_Trigger_Timestamp_Type crt_PT_8d0022_GPS_High_Resolution_Time /end REF_MEASUREMENT
/end GROUP
/begin GROUP RT_IMU06_Gyro_Rates "All signals of frame RT_IMU06_Gyro_Rates (8388897x, 0x800121x)" /begin SUB_GROUP /end SUB_GROUP
 /begin REF_MEASUREMENT crt_PT_800121_Validity_Gyro_Rate_Yaw crt_PT_800121_Validity_Gyro_Rate_Pitch crt_PT_800121_Validity_Gyro_Rate_Roll crt_PT_800121_Accuracy_Gyro_Rates crt_PT_800121_Gyro_Rate_Yaw crt_PT_800121_Gyro_Rate_Pitch crt_PT_800121_Gyro_Rate_Roll /end REF_MEASUREMENT
/end GROUP
/begin GROUP RT_IMU06_Accel "All signals of frame RT_IMU06_Accel (8388641x, 0x800021x)" /begin SUB_GROUP /end SUB_GROUP
 /begin REF_MEASUREMENT crt_PT_800021_Validity_Accel_Longitudinal crt_PT_800021_Validity_Accel_Lateral crt_PT_800021_Validity_Accel_Vertical crt_PT_800021_Accuracy_Accel crt_PT_800021_Accel_Longitudinal crt_PT_800021_Accel_Lateral crt_PT_800021_Accel_Vertical /end REF_MEASUREMENT
/end GROUP
/begin GROUP RT_SB_Speed "All signals of frame RT_SB_Speed (8392738x, 0x801022x)" /begin SUB_GROUP /end SUB_GROUP
 /begin REF_MEASUREMENT crt_PT_801022_Validity_Speed crt_PT_801022_Accuracy_Speed crt_PT_801022_Speed /end REF_MEASUREMENT
/end GROUP
/begin GROUP RT_SB_RTK_Slip "All signals of frame RT_SB_RTK_Slip (9183522x, 0x8C2122x)" /begin SUB_GROUP /end SUB_GROUP
 /begin REF_MEASUREMENT crt_PT_8c2122_Validity_RTK_Slip crt_PT_8c2122_Validity_RTK_Squat crt_PT_8c2122_Validity_RTK_Baseline crt_PT_8c2122_Accuracy_RTK_Baseline crt_PT_8c2122_RTK_Slip crt_PT_8c2122_RTK_Squat crt_PT_8c2122_RTK_Baseline /end REF_MEASUREMENT
/end GROUP
/begin GROUP RT_SB_RTK_Attitude "All signals of frame RT_SB_RTK_Attitude (9183266x, 0x8C2022x)" /begin SUB_GROUP /end SUB_GROUP
 /begin REF_MEASUREMENT crt_PT_8c2022_Validity_RTK_Yaw crt_PT_8c2022_Validity_RTK_Pitch crt_PT_8c2022_Validity_RTK_Roll crt_PT_8c2022_Accuracy_RTK_Attitude crt_PT_8c2022_RTK_Attitude_Yaw crt_PT_8c2022_RTK_Attitude_Pitch crt_PT_8c2022_RTK_Attitude_Roll /end REF_MEASUREMENT
/end GROUP
/begin GROUP RT_SB_GPS_Mcycle_Lean "All signals of frame RT_SB_GPS_Mcycle_Lean (9187362x, 0x8C3022x)" /begin SUB_GROUP /end SUB_GROUP
 /begin REF_MEASUREMENT crt_PT_8c3022_Validity_GPS_Lateral_Accel crt_PT_8c3022_Validity_GPS_Mcycle_Lean crt_PT_8c3022_Accuracy_GPS_Lateral_Accel crt_PT_8c3022_GPS_Lateral_Accel crt_PT_8c3022_GPS_Mcycle_Lean_Angle /end REF_MEASUREMENT
/end GROUP
/begin GROUP RT_SB_GPS_Status "All signals of frame RT_SB_GPS_Status (9175074x, 0x8C0022x)" /begin SUB_GROUP /end SUB_GROUP
 /begin REF_MEASUREMENT crt_PT_8c0022_GPS_Status crt_PT_8c0022_Firmware_Version_Major crt_PT_8c0022_Firmware_Version_Intermediate crt_PT_8c0022_Firmware_Version_Minor crt_PT_8c0022_GPS_nSv crt_PT_8c0022_GPS_nSv_2 crt_PT_8c0022_GPS_nSv_RTK crt_PT_8c0022_RTK_Status /end REF_MEASUREMENT
/end GROUP
/begin GROUP RT_SB_GPS_Pos_ECEF_2 "All signals of frame RT_SB_GPS_Pos_ECEF_2 (9176354x, 0x8C0522x)" /begin SUB_GROUP /end SUB_GROUP /begin REF_MEASUREMENT crt_PT_8c0522_GPS_Pos_ECEF_Y crt_PT_8c0522_GPS_Pos_ECEF_Z /end REF_MEASUREMENT /end GROUP
/begin GROUP RT_SB_GPS_Pos_ECEF_1 "All signals of frame RT_SB_GPS_Pos_ECEF_1 (9176098x, 0x8C0422x)" /begin SUB_GROUP /end SUB_GROUP
 /begin REF_MEASUREMENT crt_PT_8c0422_Validity_GPS_Pos_ECEF_X crt_PT_8c0422_Validity_GPS_Pos_ECEF_Y crt_PT_8c0422_Validity_GPS_Pos_ECEF_Z crt_PT_8c0422_Accuracy_GPS_Pos_ECEF_X crt_PT_8c0422_Accuracy_GPS_Pos_ECEF_Y crt_PT_8c0422_Accuracy_GPS_Pos_ECEF_Z crt_PT_8c0422_GPS_Pos_ECEF_X /end REF_MEASUREMENT
/end GROUP
/begin GROUP RT_SB_GPS_Pos_LLH_2 "All signals of frame RT_SB_GPS_Pos_LLH_2 (9175842x, 0x8C0322x)" /begin SUB_GROUP /end SUB_GROUP
 /begin REF_MEASUREMENT crt_PT_8c0322_GPS_Pos_LLH_Longitude crt_PT_8c0322_GPS_Pos_LLH_Altitude /end REF_MEASUREMENT
/end GROUP
/begin GROUP RT_SB_GPS_Pos_LLH_1 "All signals of frame RT_SB_GPS_Pos_LLH_1 (9175586x, 0x8C0222x)" /begin SUB_GROUP /end SUB_GROUP
 /begin REF_MEASUREMENT crt_PT_8c0222_Validity_GPS_Pos_LLH_Latitude crt_PT_8c0222_Validity_GPS_Pos_LLH_Longitude crt_PT_8c0222_Validity_GPS_Pos_LLH_Altitude crt_PT_8c0222_Accuracy_GPS_Pos_LLH_Latitude crt_PT_8c0222_Accuracy_GPS_Pos_LLH_Longitude crt_PT_8c0222_Accuracy_GPS_Pos_LLH_Altitude crt_PT_8c0222_GPS_Pos_LLH_Latitude /end REF_MEASUREMENT
/end GROUP
/begin GROUP RT_SB_GPS_Heading_Gradient "All signals of frame RT_SB_GPS_Heading_Gradient (9180450x, 0x8C1522x)" /begin SUB_GROUP /end SUB_GROUP
 /begin REF_MEASUREMENT crt_PT_8c1522_Validity_GPS_Heading crt_PT_8c1522_Validity_GPS_Gradient crt_PT_8c1522_Accuracy_GPS_Heading crt_PT_8c1522_GPS_Heading crt_PT_8c1522_Accuracy_GPS_Gradient crt_PT_8c1522_GPS_Gradient /end REF_MEASUREMENT
/end GROUP
/begin GROUP RT_SB_GPS_Vel_ECEF_2 "All signals of frame RT_SB_GPS_Vel_ECEF_2 (9180194x, 0x8C1422x)" /begin SUB_GROUP /end SUB_GROUP
 /begin REF_MEASUREMENT crt_PT_8c1422_Validity_GPS_Vel_ECEF_Y crt_PT_8c1422_Validity_GPS_Vel_ECEF_Z crt_PT_8c1422_GPS_Vel_ECEF_Y crt_PT_8c1422_GPS_Vel_ECEF_Z /end REF_MEASUREMENT
/end GROUP
/begin GROUP RT_SB_GPS_Vel_ECEF_1 "All signals of frame RT_SB_GPS_Vel_ECEF_1 (9179938x, 0x8C1322x)" /begin SUB_GROUP /end SUB_GROUP
 /begin REF_MEASUREMENT crt_PT_8c1322_Validity_GPS_Vel_ECEF_X crt_PT_8c1322_Accuracy_GPS_Vel_ECEF_X crt_PT_8c1322_Accuracy_GPS_Vel_ECEF_Y crt_PT_8c1322_Accuracy_GPS_Vel_ECEF_Z crt_PT_8c1322_GPS_Vel_ECEF_X /end REF_MEASUREMENT
/end GROUP
/begin GROUP RT_SB_GPS_Vel_NED_2 "All signals of frame RT_SB_GPS_Vel_NED_2 (0, 0x000)" /begin SUB_GROUP /end SUB_GROUP
 /begin REF_MEASUREMENT crt_PT_000_Validity_GPS_Vel_NED_D crt_PT_000_Accuracy_GPS_Vel_D crt_PT_000_GPS_Vel_NED_D /end REF_MEASUREMENT
/end GROUP
/begin GROUP RT_SB_GPS_Vel_NED_1 "All signals of frame RT_SB_GPS_Vel_NED_1 (536870911x, 0x1FFFFFFFx)" /begin SUB_GROUP /end SUB_GROUP
 /begin REF_MEASUREMENT crt_PT_1fffffff_Validity_GPS_Vel_NED_N crt_PT_1fffffff_Validity_GPS_Vel_NED_E crt_PT_1fffffff_Accuracy_GPS_Vel_NE crt_PT_1fffffff_GPS_Vel_NED_N crt_PT_1fffffff_GPS_Vel_NED_E /end REF_MEASUREMENT
/end GROUP
/begin GROUP RT_SB_GPS_Speed "All signals of frame RT_SB_GPS_Speed (1818, 0x71A)" /begin SUB_GROUP /end SUB_GROUP
 /begin REF_MEASUREMENT crt_PT_71a_Validity_GPS_Speed_2D crt_PT_71a_Validity_GPS_Speed_3D crt_PT_71a_Accuracy_GPS_Speed crt_PT_71a_GPS_Speed_2D crt_PT_71a_GPS_Speed_3D /end REF_MEASUREMENT
/end GROUP
/begin GROUP RT_SB_GPS_Time "All signals of frame RT_SB_GPS_Time (2047, 0x7FF)" /begin SUB_GROUP /end SUB_GROUP
 /begin REF_MEASUREMENT crt_PT_7ff_Validity_GPS_Time crt_PT_7ff_Validity_GPS_Week crt_PT_7ff_Accuracy_GPS_Time crt_PT_7ff_GPS_Time crt_PT_7ff_GPS_Week /end REF_MEASUREMENT
/end GROUP
/begin GROUP RT_SB_Accel "All signals of frame RT_SB_Accel (290, 0x122)" /begin SUB_GROUP /end SUB_GROUP
 /begin REF_MEASUREMENT crt_PT_122_Validity_Accel_Longitudinal crt_PT_122_Validity_Accel_Lateral crt_PT_122_Validity_Accel_Vertical crt_PT_122_Accuracy_Accel crt_PT_122_Accel_Longitudinal crt_PT_122_Accel_Lateral crt_PT_122_Accel_Vertical /end REF_MEASUREMENT
/end GROUP
/begin GROUP RT_SB_Gyro_Rates "All signals of frame RT_SB_Gyro_Rates (8388898x, 0x800122x)" /begin SUB_GROUP /end SUB_GROUP
 /begin REF_MEASUREMENT crt_PT_800122_Validity_Gyro_Rate_Yaw crt_PT_800122_Validity_Gyro_Rate_Pitch crt_PT_800122_Validity_Gyro_Rate_Roll crt_PT_800122_Accuracy_Gyro_Rates crt_PT_800122_Gyro_Rate_Yaw crt_PT_800122_Gyro_Rate_Pitch crt_PT_800122_Gyro_Rate_Roll /end REF_MEASUREMENT
/end GROUP
/end MODULE
/end PROJECT
