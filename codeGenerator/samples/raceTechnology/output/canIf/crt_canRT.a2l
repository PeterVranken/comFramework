/* ASAM MCD-2MC interface specification for CAN network cluster raceCar */
/* Created with comFramework - codeGenerator version 1.14.0, see https://github.com/PeterVranken/comFramework */
/begin PROJECT MERGED_PROJECT "CAN interface of cluster raceCar"
/begin HEADER "This is an A2L fragment which has to be merged into the main project" VERSION "24.05.2025 14:36:28" /end HEADER
/begin MODULE MERGED_MODULE "CAN interface of cluster raceCar"
/begin MOD_PAR "MODULE PARAMETERS" VERSION "24.05.2025 14:36:28" /end MOD_PAR
/* Measurement point for signal Validity_INS_Vel_Forwards of frame RT_SB_INS_Vel_Body_Axes (215, 0x0D7) */
/begin MEASUREMENT crt_PT_0d7_Validity_INS_Vel_Forwards "signal Validity_INS_Vel_Forwards of frame RT_SB_INS_Vel_Body_Axes (215, 0x0D7)" UBYTE CONV_crt_PT_0d7_Validity_INS_Vel_Forwards 0 0 0 1 ECU_ADDRESS 0x0000 /end MEASUREMENT
/begin COMPU_METHOD CONV_crt_PT_0d7_Validity_INS_Vel_Forwards "Identity, real-world value is same as binary value" IDENTICAL "%1" "" /end COMPU_METHOD
/* Measurement point for signal Validity_INS_Vel_Sideways of frame RT_SB_INS_Vel_Body_Axes (215, 0x0D7) */
/begin MEASUREMENT crt_PT_0d7_Validity_INS_Vel_Sideways "signal Validity_INS_Vel_Sideways of frame RT_SB_INS_Vel_Body_Axes (215, 0x0D7)" UBYTE CONV_crt_PT_0d7_Validity_INS_Vel_Sideways 0 0 0 1 ECU_ADDRESS 0x0000 /end MEASUREMENT
/begin COMPU_METHOD CONV_crt_PT_0d7_Validity_INS_Vel_Sideways "Identity, real-world value is same as binary value" IDENTICAL "%1" "" /end COMPU_METHOD
/* Measurement point for signal Bit4 of frame RT_SB_INS_Vel_Body_Axes (215, 0x0D7) */
/begin MEASUREMENT crt_PT_0d7_Bit4 "signal Bit4 of frame RT_SB_INS_Vel_Body_Axes (215, 0x0D7)" UBYTE CONV_crt_PT_0d7_Bit4 0 0 0 1 ECU_ADDRESS 0x0000 /end MEASUREMENT
/begin COMPU_METHOD CONV_crt_PT_0d7_Bit4 "Identity, real-world value is same as binary value" IDENTICAL "%1" "" /end COMPU_METHOD
/* Measurement point for signal Bit7 of frame RT_SB_INS_Vel_Body_Axes (215, 0x0D7) */
/begin MEASUREMENT crt_PT_0d7_Bit7 "signal Bit7 of frame RT_SB_INS_Vel_Body_Axes (215, 0x0D7)" UBYTE CONV_crt_PT_0d7_Bit7 0 0 0 1 ECU_ADDRESS 0x0000 /end MEASUREMENT
/begin COMPU_METHOD CONV_crt_PT_0d7_Bit7 "Identity, real-world value is same as binary value" IDENTICAL "%1" "" /end COMPU_METHOD
/* Measurement point for signal Byte2_Bit0 of frame RT_SB_INS_Vel_Body_Axes (215, 0x0D7) */
/begin MEASUREMENT crt_PT_0d7_Byte2_Bit0 "signal Byte2_Bit0 of frame RT_SB_INS_Vel_Body_Axes (215, 0x0D7)" UBYTE CONV_crt_PT_0d7_Byte2_Bit0 0 0 0 1 ECU_ADDRESS 0x0000 /end MEASUREMENT
/begin COMPU_METHOD CONV_crt_PT_0d7_Byte2_Bit0 "Identity, real-world value is same as binary value" IDENTICAL "%1" "" /end COMPU_METHOD
/* Measurement point for signal INS_Vel_Sideways_2D of frame RT_SB_INS_Vel_Body_Axes (215, 0x0D7) */
/begin MEASUREMENT crt_PT_0d7_INS_Vel_Sideways_2D "signal INS_Vel_Sideways_2D of frame RT_SB_INS_Vel_Body_Axes (215, 0x0D7)" SLONG CONV_crt_PT_0d7_INS_Vel_Sideways_2D 0 0 -838.0 838.0 ECU_ADDRESS 0x0000 /end MEASUREMENT
/begin COMPU_METHOD CONV_crt_PT_0d7_INS_Vel_Sideways_2D "Linear scaling, used for variable crt_PT_0d7_INS_Vel_Sideways_2D, signal INS_Vel_Sideways_2D" RAT_FUNC "%12" "m/s" COEFFS 0 -1 0.0 0 0 -1.0E-4 /end COMPU_METHOD
/* Measurement point for signal Validity_Speed of frame RT_DL1MK3_Speed (8392740x, 0x801024x) */
/begin MEASUREMENT crt_PT_801024_Validity_Speed "signal Validity_Speed of frame RT_DL1MK3_Speed (8392740x, 0x801024x). Valid when bit is set, invalid when bit is clear." UBYTE CONV_crt_PT_801024_Validity_Speed 0 0 0 1 ECU_ADDRESS 0x0000 /end MEASUREMENT
/begin COMPU_METHOD CONV_crt_PT_801024_Validity_Speed "Identity, real-world value is same as binary value" IDENTICAL "%1" "" /end COMPU_METHOD
/* Measurement point for signal Accuracy_Speed of frame RT_DL1MK3_Speed (8392740x, 0x801024x) */
/begin MEASUREMENT crt_PT_801024_Accuracy_Speed "signal Accuracy_Speed of frame RT_DL1MK3_Speed (8392740x, 0x801024x). Dimensionless. Lower values imply but do not guarantee better accuracy than higher values." UBYTE CONV_crt_PT_801024_Accuracy_Speed 0 0 0 255 ECU_ADDRESS 0x0000 /end MEASUREMENT
/begin COMPU_METHOD CONV_crt_PT_801024_Accuracy_Speed "Identity, real-world value is same as binary value" IDENTICAL "%4" "" /end COMPU_METHOD
/* Measurement point for signal Direction of frame RT_DL1MK3_Speed (8392740x, 0x801024x) */
/begin MEASUREMENT crt_PT_801024_Direction "signal Direction of frame RT_DL1MK3_Speed (8392740x, 0x801024x). Dimensionless. Direction of speed. 1 means forward, -1 means reverse" UBYTE CONV_crt_PT_801024_Direction 0 0 -1.0 1.0 ECU_ADDRESS 0x0000 /end MEASUREMENT
/begin COMPU_METHOD CONV_crt_PT_801024_Direction "Linear scaling, used for variable crt_PT_801024_Direction, signal Direction" RAT_FUNC "%4" "" COEFFS 0 -1 -1.0 0 0 -2.0 /end COMPU_METHOD
/* Measurement point for signal Speed of frame RT_DL1MK3_Speed (8392740x, 0x801024x) */
/begin MEASUREMENT crt_PT_801024_Speed "signal Speed of frame RT_DL1MK3_Speed (8392740x, 0x801024x)" SLONG CONV_crt_PT_801024_Speed 0 0 -20000.0 20000.0 ECU_ADDRESS 0x0000 /end MEASUREMENT
/begin COMPU_METHOD CONV_crt_PT_801024_Speed "Linear scaling, used for variable crt_PT_801024_Speed, signal Speed" RAT_FUNC "%12" "m/s" COEFFS 0 -1 0.0 0 0 -1.0E-5 /end COMPU_METHOD
/* Measurement point for signal Validity_GPS_Time of frame RT_DL1MK3_GPS_Time (9175332x, 0x8C0124x) */
/begin MEASUREMENT crt_PT_8c0124_Validity_GPS_Time "signal Validity_GPS_Time of frame RT_DL1MK3_GPS_Time (9175332x, 0x8C0124x). Valid when bit is set, invalid when bit is clear." UBYTE CONV_crt_PT_8c0124_Validity_GPS_Time 0 0 0 1 ECU_ADDRESS 0x0000 /end MEASUREMENT
/begin COMPU_METHOD CONV_crt_PT_8c0124_Validity_GPS_Time "Identity, real-world value is same as binary value" IDENTICAL "%1" "" /end COMPU_METHOD
/* Measurement point for signal Validity_GPS_Week of frame RT_DL1MK3_GPS_Time (9175332x, 0x8C0124x) */
/begin MEASUREMENT crt_PT_8c0124_Validity_GPS_Week "signal Validity_GPS_Week of frame RT_DL1MK3_GPS_Time (9175332x, 0x8C0124x). Valid when bit is set, invalid when bit is clear." UBYTE CONV_crt_PT_8c0124_Validity_GPS_Week 0 0 0 1 ECU_ADDRESS 0x0000 /end MEASUREMENT
/begin COMPU_METHOD CONV_crt_PT_8c0124_Validity_GPS_Week "Identity, real-world value is same as binary value" IDENTICAL "%1" "" /end COMPU_METHOD
/* Measurement point for signal Accuracy_GPS_Time of frame RT_DL1MK3_GPS_Time (9175332x, 0x8C0124x) */
/begin MEASUREMENT crt_PT_8c0124_Accuracy_GPS_Time "signal Accuracy_GPS_Time of frame RT_DL1MK3_GPS_Time (9175332x, 0x8C0124x)" UBYTE CONV_crt_PT_8c0124_Accuracy_GPS_Time 0 0 0 255 ECU_ADDRESS 0x0000 /end MEASUREMENT
/begin COMPU_METHOD CONV_crt_PT_8c0124_Accuracy_GPS_Time "Identity, real-world value is same as binary value" IDENTICAL "%4" "" /end COMPU_METHOD
/* Measurement point for signal GPS_Time of frame RT_DL1MK3_GPS_Time (9175332x, 0x8C0124x) */
/begin MEASUREMENT crt_PT_8c0124_GPS_Time "signal GPS_Time of frame RT_DL1MK3_GPS_Time (9175332x, 0x8C0124x). GPS time is the time in seconds since midnight GMT on Saturday night." ULONG CONV_crt_PT_8c0124_GPS_Time 0 0 0.0 604800.0 ECU_ADDRESS 0x0000 /end MEASUREMENT
/begin COMPU_METHOD CONV_crt_PT_8c0124_GPS_Time "Linear scaling, used for variable crt_PT_8c0124_GPS_Time, signal GPS_Time" RAT_FUNC "%12" "s" COEFFS 0 -1 0.0 0 0 -0.001 /end COMPU_METHOD
/* Measurement point for signal GPS_Week of frame RT_DL1MK3_GPS_Time (9175332x, 0x8C0124x) */
/begin MEASUREMENT crt_PT_8c0124_GPS_Week "signal GPS_Week of frame RT_DL1MK3_GPS_Time (9175332x, 0x8C0124x)" UWORD CONV_crt_PT_8c0124_GPS_Week 0 0 0 65535 ECU_ADDRESS 0x0000 /end MEASUREMENT
/begin COMPU_METHOD CONV_crt_PT_8c0124_GPS_Week "Identity, real-world value is same as binary value" IDENTICAL "%6" "" /end COMPU_METHOD
/* Measurement point for signal GPS_Pos_LLH_Longitude of frame RT_DL1MK3_GPS_Pos_LLH_2 (9175844x, 0x8C0324x) */
/begin MEASUREMENT crt_PT_8c0324_GPS_Pos_LLH_Longitude "signal GPS_Pos_LLH_Longitude of frame RT_DL1MK3_GPS_Pos_LLH_2 (9175844x, 0x8C0324x)" SLONG CONV_crt_PT_8c0324_GPS_Pos_LLH_Longitude 0 0 -180.0 180.0 ECU_ADDRESS 0x0000 /end MEASUREMENT
/begin COMPU_METHOD CONV_crt_PT_8c0324_GPS_Pos_LLH_Longitude "Linear scaling, used for variable crt_PT_8c0324_GPS_Pos_LLH_Longitude, signal GPS_Pos_LLH_Longitude" RAT_FUNC "%12" "degrees" COEFFS 0 -1 0.0 0 0 -1.0E-7 /end COMPU_METHOD
/* Measurement point for signal GPS_Pos_LLH_Altitude of frame RT_DL1MK3_GPS_Pos_LLH_2 (9175844x, 0x8C0324x) */
/begin MEASUREMENT crt_PT_8c0324_GPS_Pos_LLH_Altitude "signal GPS_Pos_LLH_Altitude of frame RT_DL1MK3_GPS_Pos_LLH_2 (9175844x, 0x8C0324x)" SLONG CONV_crt_PT_8c0324_GPS_Pos_LLH_Altitude 0 0 -1000.0 100000.0 ECU_ADDRESS 0x0000 /end MEASUREMENT
/begin COMPU_METHOD CONV_crt_PT_8c0324_GPS_Pos_LLH_Altitude "Linear scaling, used for variable crt_PT_8c0324_GPS_Pos_LLH_Altitude, signal GPS_Pos_LLH_Altitude" RAT_FUNC "%12" "m" COEFFS 0 -1 0.0 0 0 -0.001 /end COMPU_METHOD
/* Measurement point for signal Validity_GPS_Pos_LLH_Latitude of frame RT_DL1MK3_GPS_Pos_LLH_1 (9175588x, 0x8C0224x) */
/begin MEASUREMENT crt_PT_8c0224_Validity_GPS_Pos_LLH_Latitude "signal Validity_GPS_Pos_LLH_Latitude of frame RT_DL1MK3_GPS_Pos_LLH_1 (9175588x, 0x8C0224x). Valid when bit is set, invalid when bit is clear." UBYTE CONV_crt_PT_8c0224_Validity_GPS_Pos_LLH_Latitude 0 0 0 1 ECU_ADDRESS 0x0000 /end MEASUREMENT
/begin COMPU_METHOD CONV_crt_PT_8c0224_Validity_GPS_Pos_LLH_Latitude "Identity, real-world value is same as binary value" IDENTICAL "%1" "" /end COMPU_METHOD
/* Measurement point for signal Validity_GPS_Pos_LLH_Longitude of frame RT_DL1MK3_GPS_Pos_LLH_1 (9175588x, 0x8C0224x) */
/begin MEASUREMENT crt_PT_8c0224_Validity_GPS_Pos_LLH_Longitude "signal Validity_GPS_Pos_LLH_Longitude of frame RT_DL1MK3_GPS_Pos_LLH_1 (9175588x, 0x8C0224x). Valid when bit is set, invalid when bit is clear." UBYTE CONV_crt_PT_8c0224_Validity_GPS_Pos_LLH_Longitude 0 0 0 1 ECU_ADDRESS 0x0000 /end MEASUREMENT
/begin COMPU_METHOD CONV_crt_PT_8c0224_Validity_GPS_Pos_LLH_Longitude "Identity, real-world value is same as binary value" IDENTICAL "%1" "" /end COMPU_METHOD
/* Measurement point for signal Validity_GPS_Pos_LLH_Altitude of frame RT_DL1MK3_GPS_Pos_LLH_1 (9175588x, 0x8C0224x) */
/begin MEASUREMENT crt_PT_8c0224_Validity_GPS_Pos_LLH_Altitude "signal Validity_GPS_Pos_LLH_Altitude of frame RT_DL1MK3_GPS_Pos_LLH_1 (9175588x, 0x8C0224x). Valid when bit is set, invalid when bit is clear." UBYTE CONV_crt_PT_8c0224_Validity_GPS_Pos_LLH_Altitude 0 0 0 1 ECU_ADDRESS 0x0000 /end MEASUREMENT
/begin COMPU_METHOD CONV_crt_PT_8c0224_Validity_GPS_Pos_LLH_Altitude "Identity, real-world value is same as binary value" IDENTICAL "%1" "" /end COMPU_METHOD
/* Measurement point for signal Accuracy_GPS_Pos_LLH_Latitude of frame RT_DL1MK3_GPS_Pos_LLH_1 (9175588x, 0x8C0224x) */
/begin MEASUREMENT crt_PT_8c0224_Accuracy_GPS_Pos_LLH_Latitude "signal Accuracy_GPS_Pos_LLH_Latitude of frame RT_DL1MK3_GPS_Pos_LLH_1 (9175588x, 0x8C0224x). This accuracy value applies to both 2D and 3D GPS speed." UBYTE CONV_crt_PT_8c0224_Accuracy_GPS_Pos_LLH_Latitude 0 0 0 255 ECU_ADDRESS 0x0000 /end MEASUREMENT
/begin COMPU_METHOD CONV_crt_PT_8c0224_Accuracy_GPS_Pos_LLH_Latitude "Identity, real-world value is same as binary value" IDENTICAL "%4" "" /end COMPU_METHOD
/* Measurement point for signal Accuracy_GPS_Pos_LLH_Longitude of frame RT_DL1MK3_GPS_Pos_LLH_1 (9175588x, 0x8C0224x) */
/begin MEASUREMENT crt_PT_8c0224_Accuracy_GPS_Pos_LLH_Longitude "signal Accuracy_GPS_Pos_LLH_Longitude of frame RT_DL1MK3_GPS_Pos_LLH_1 (9175588x, 0x8C0224x). This accuracy value applies to both 2D and 3D GPS speed." UBYTE CONV_crt_PT_8c0224_Accuracy_GPS_Pos_LLH_Longitude 0 0 0 255 ECU_ADDRESS 0x0000 /end MEASUREMENT
/begin COMPU_METHOD CONV_crt_PT_8c0224_Accuracy_GPS_Pos_LLH_Longitude "Identity, real-world value is same as binary value" IDENTICAL "%4" "" /end COMPU_METHOD
/* Measurement point for signal Accuracy_GPS_Pos_LLH_Altitude of frame RT_DL1MK3_GPS_Pos_LLH_1 (9175588x, 0x8C0224x) */
/begin MEASUREMENT crt_PT_8c0224_Accuracy_GPS_Pos_LLH_Altitude "signal Accuracy_GPS_Pos_LLH_Altitude of frame RT_DL1MK3_GPS_Pos_LLH_1 (9175588x, 0x8C0224x). This accuracy value applies to both 2D and 3D GPS speed." UBYTE CONV_crt_PT_8c0224_Accuracy_GPS_Pos_LLH_Altitude 0 0 0 255 ECU_ADDRESS 0x0000 /end MEASUREMENT
/begin COMPU_METHOD CONV_crt_PT_8c0224_Accuracy_GPS_Pos_LLH_Altitude "Identity, real-world value is same as binary value" IDENTICAL "%4" "" /end COMPU_METHOD
/* Measurement point for signal GPS_Pos_LLH_Latitude of frame RT_DL1MK3_GPS_Pos_LLH_1 (9175588x, 0x8C0224x) */
/begin MEASUREMENT crt_PT_8c0224_GPS_Pos_LLH_Latitude "signal GPS_Pos_LLH_Latitude of frame RT_DL1MK3_GPS_Pos_LLH_1 (9175588x, 0x8C0224x)" SLONG CONV_crt_PT_8c0224_GPS_Pos_LLH_Latitude 0 0 -90.0 90.0 ECU_ADDRESS 0x0000 /end MEASUREMENT
/begin COMPU_METHOD CONV_crt_PT_8c0224_GPS_Pos_LLH_Latitude "Linear scaling, used for variable crt_PT_8c0224_GPS_Pos_LLH_Latitude, signal GPS_Pos_LLH_Latitude" RAT_FUNC "%12" "degrees" COEFFS 0 -1 0.0 0 0 -1.0E-7 /end COMPU_METHOD
/* Measurement point for signal Validity_GPS_Speed_2D of frame RT_DL1MK3_GPS_Speed (1234, 0x4D2) */
/begin MEASUREMENT crt_PT_4d2_Validity_GPS_Speed_2D "signal Validity_GPS_Speed_2D of frame RT_DL1MK3_GPS_Speed (1234, 0x4D2). Valid when bit is set, invalid when bit is clear." UBYTE CONV_crt_PT_4d2_Validity_GPS_Speed_2D 0 0 0 1 ECU_ADDRESS 0x0000 /end MEASUREMENT
/begin COMPU_METHOD CONV_crt_PT_4d2_Validity_GPS_Speed_2D "Identity, real-world value is same as binary value" IDENTICAL "%1" "" /end COMPU_METHOD
/* Measurement point for signal Validity_GPS_Speed_3D of frame RT_DL1MK3_GPS_Speed (1234, 0x4D2) */
/begin MEASUREMENT crt_PT_4d2_Validity_GPS_Speed_3D "signal Validity_GPS_Speed_3D of frame RT_DL1MK3_GPS_Speed (1234, 0x4D2). Valid when bit is set, invalid when bit is clear." UBYTE CONV_crt_PT_4d2_Validity_GPS_Speed_3D 0 0 0 1 ECU_ADDRESS 0x0000 /end MEASUREMENT
/begin COMPU_METHOD CONV_crt_PT_4d2_Validity_GPS_Speed_3D "Identity, real-world value is same as binary value" IDENTICAL "%1" "" /end COMPU_METHOD
/* Measurement point for signal Accuracy_GPS_Speed of frame RT_DL1MK3_GPS_Speed (1234, 0x4D2) */
/begin MEASUREMENT crt_PT_4d2_Accuracy_GPS_Speed "signal Accuracy_GPS_Speed of frame RT_DL1MK3_GPS_Speed (1234, 0x4D2). This accuracy value applies to both 2D and 3D GPS speed." UBYTE CONV_crt_PT_4d2_Accuracy_GPS_Speed 0 0 0 255 ECU_ADDRESS 0x0000 /end MEASUREMENT
/begin COMPU_METHOD CONV_crt_PT_4d2_Accuracy_GPS_Speed "Identity, real-world value is same as binary value" IDENTICAL "%4" "" /end COMPU_METHOD
/* Measurement point for signal GPS_Speed_2D of frame RT_DL1MK3_GPS_Speed (1234, 0x4D2) */
/begin MEASUREMENT crt_PT_4d2_GPS_Speed_2D "signal GPS_Speed_2D of frame RT_DL1MK3_GPS_Speed (1234, 0x4D2). This is GPS scalar 2D speed - scalar speed with no local Z axis component included." ULONG CONV_crt_PT_4d2_GPS_Speed_2D 0 0 0.0 1675.0 ECU_ADDRESS 0x0000 /end MEASUREMENT
/begin COMPU_METHOD CONV_crt_PT_4d2_GPS_Speed_2D "Linear scaling, used for variable crt_PT_4d2_GPS_Speed_2D, signal GPS_Speed_2D" RAT_FUNC "%12" "m/s" COEFFS 0 -1 0.0 0 0 -1.0E-4 /end COMPU_METHOD
/* Measurement point for signal GPS_Speed_3D of frame RT_DL1MK3_GPS_Speed (1234, 0x4D2) */
/begin MEASUREMENT crt_PT_4d2_GPS_Speed_3D "signal GPS_Speed_3D of frame RT_DL1MK3_GPS_Speed (1234, 0x4D2). This is GPS scalar 3D speed - scalar speed with the local Z axis component included." ULONG CONV_crt_PT_4d2_GPS_Speed_3D 0 0 0.0 1675.0 ECU_ADDRESS 0x0000 /end MEASUREMENT
/begin COMPU_METHOD CONV_crt_PT_4d2_GPS_Speed_3D "Linear scaling, used for variable crt_PT_4d2_GPS_Speed_3D, signal GPS_Speed_3D" RAT_FUNC "%12" "m/s" COEFFS 0 -1 0.0 0 0 -1.0E-4 /end COMPU_METHOD
/* Measurement point for signal IR_Temperature_7 of frame RT_IRTemp_Temp_7 (9504549x, 0x910725x) */
/begin MEASUREMENT crt_PT_910725_IR_Temperature_7 "signal IR_Temperature_7 of frame RT_IRTemp_Temp_7 (9504549x, 0x910725x)" SWORD CONV_crt_PT_910725_IR_Temperature_7 0 0 0.0 0.0 ECU_ADDRESS 0x0000 /end MEASUREMENT
/begin COMPU_METHOD CONV_crt_PT_910725_IR_Temperature_7 "Linear scaling, used for variable crt_PT_910725_IR_Temperature_7, signal IR_Temperature_7" RAT_FUNC "%6" "" COEFFS 0 -1 0.0 0 0 -0.1 /end COMPU_METHOD
/* Measurement point for signal IR_Temperature_29 of frame RT_IRTemp_Temp_RR_2 (9963557x, 0x980825x) */
/begin MEASUREMENT crt_PT_980825_IR_Temperature_29 "signal IR_Temperature_29 of frame RT_IRTemp_Temp_RR_2 (9963557x, 0x980825x)" SWORD CONV_crt_PT_980825_IR_Temperature_29 0 0 0.0 0.0 ECU_ADDRESS 0x0000 /end MEASUREMENT
/begin COMPU_METHOD CONV_crt_PT_980825_IR_Temperature_29 "Linear scaling, used for variable crt_PT_980825_IR_Temperature_29, signal IR_Temperature_29" RAT_FUNC "%6" "" COEFFS 0 -1 0.0 0 0 -0.1 /end COMPU_METHOD
/* Measurement point for signal IR_Temperature_30 of frame RT_IRTemp_Temp_RR_2 (9963557x, 0x980825x) */
/begin MEASUREMENT crt_PT_980825_IR_Temperature_30 "signal IR_Temperature_30 of frame RT_IRTemp_Temp_RR_2 (9963557x, 0x980825x)" SWORD CONV_crt_PT_980825_IR_Temperature_30 0 0 0.0 0.0 ECU_ADDRESS 0x0000 /end MEASUREMENT
/begin COMPU_METHOD CONV_crt_PT_980825_IR_Temperature_30 "Linear scaling, used for variable crt_PT_980825_IR_Temperature_30, signal IR_Temperature_30" RAT_FUNC "%6" "" COEFFS 0 -1 0.0 0 0 -0.1 /end COMPU_METHOD
/* Measurement point for signal IR_Temperature_31 of frame RT_IRTemp_Temp_RR_2 (9963557x, 0x980825x) */
/begin MEASUREMENT crt_PT_980825_IR_Temperature_31 "signal IR_Temperature_31 of frame RT_IRTemp_Temp_RR_2 (9963557x, 0x980825x)" SWORD CONV_crt_PT_980825_IR_Temperature_31 0 0 0.0 0.0 ECU_ADDRESS 0x0000 /end MEASUREMENT
/begin COMPU_METHOD CONV_crt_PT_980825_IR_Temperature_31 "Linear scaling, used for variable crt_PT_980825_IR_Temperature_31, signal IR_Temperature_31" RAT_FUNC "%6" "" COEFFS 0 -1 0.0 0 0 -0.1 /end COMPU_METHOD
/* Measurement point for signal IR_Temperature_32 of frame RT_IRTemp_Temp_RR_2 (9963557x, 0x980825x) */
/begin MEASUREMENT crt_PT_980825_IR_Temperature_32 "signal IR_Temperature_32 of frame RT_IRTemp_Temp_RR_2 (9963557x, 0x980825x)" SWORD CONV_crt_PT_980825_IR_Temperature_32 0 0 0.0 0.0 ECU_ADDRESS 0x0000 /end MEASUREMENT
/begin COMPU_METHOD CONV_crt_PT_980825_IR_Temperature_32 "Linear scaling, used for variable crt_PT_980825_IR_Temperature_32, signal IR_Temperature_32" RAT_FUNC "%6" "" COEFFS 0 -1 0.0 0 0 -0.1 /end COMPU_METHOD
/* Measurement point for signal IR_Temperature_21 of frame RT_IRTemp_Temp_RL_2 (9963045x, 0x980625x) */
/begin MEASUREMENT crt_PT_980625_IR_Temperature_21 "signal IR_Temperature_21 of frame RT_IRTemp_Temp_RL_2 (9963045x, 0x980625x)" SWORD CONV_crt_PT_980625_IR_Temperature_21 0 0 0.0 0.0 ECU_ADDRESS 0x0000 /end MEASUREMENT
/begin COMPU_METHOD CONV_crt_PT_980625_IR_Temperature_21 "Linear scaling, used for variable crt_PT_980625_IR_Temperature_21, signal IR_Temperature_21" RAT_FUNC "%6" "" COEFFS 0 -1 0.0 0 0 -0.1 /end COMPU_METHOD
/* Measurement point for signal IR_Temperature_22 of frame RT_IRTemp_Temp_RL_2 (9963045x, 0x980625x) */
/begin MEASUREMENT crt_PT_980625_IR_Temperature_22 "signal IR_Temperature_22 of frame RT_IRTemp_Temp_RL_2 (9963045x, 0x980625x)" SWORD CONV_crt_PT_980625_IR_Temperature_22 0 0 0.0 0.0 ECU_ADDRESS 0x0000 /end MEASUREMENT
/begin COMPU_METHOD CONV_crt_PT_980625_IR_Temperature_22 "Linear scaling, used for variable crt_PT_980625_IR_Temperature_22, signal IR_Temperature_22" RAT_FUNC "%6" "" COEFFS 0 -1 0.0 0 0 -0.1 /end COMPU_METHOD
/* Measurement point for signal IR_Temperature_23 of frame RT_IRTemp_Temp_RL_2 (9963045x, 0x980625x) */
/begin MEASUREMENT crt_PT_980625_IR_Temperature_23 "signal IR_Temperature_23 of frame RT_IRTemp_Temp_RL_2 (9963045x, 0x980625x)" SWORD CONV_crt_PT_980625_IR_Temperature_23 0 0 0.0 0.0 ECU_ADDRESS 0x0000 /end MEASUREMENT
/begin COMPU_METHOD CONV_crt_PT_980625_IR_Temperature_23 "Linear scaling, used for variable crt_PT_980625_IR_Temperature_23, signal IR_Temperature_23" RAT_FUNC "%6" "" COEFFS 0 -1 0.0 0 0 -0.1 /end COMPU_METHOD
/* Measurement point for signal IR_Temperature_24 of frame RT_IRTemp_Temp_RL_2 (9963045x, 0x980625x) */
/begin MEASUREMENT crt_PT_980625_IR_Temperature_24 "signal IR_Temperature_24 of frame RT_IRTemp_Temp_RL_2 (9963045x, 0x980625x)" SWORD CONV_crt_PT_980625_IR_Temperature_24 0 0 0.0 0.0 ECU_ADDRESS 0x0000 /end MEASUREMENT
/begin COMPU_METHOD CONV_crt_PT_980625_IR_Temperature_24 "Linear scaling, used for variable crt_PT_980625_IR_Temperature_24, signal IR_Temperature_24" RAT_FUNC "%6" "" COEFFS 0 -1 0.0 0 0 -0.1 /end COMPU_METHOD
/* Measurement point for signal IR_Temperature_13 of frame RT_IRTemp_Temp_FR_2 (9962533x, 0x980425x) */
/begin MEASUREMENT crt_PT_980425_IR_Temperature_13 "signal IR_Temperature_13 of frame RT_IRTemp_Temp_FR_2 (9962533x, 0x980425x)" SWORD CONV_crt_PT_980425_IR_Temperature_13 0 0 0.0 0.0 ECU_ADDRESS 0x0000 /end MEASUREMENT
/begin COMPU_METHOD CONV_crt_PT_980425_IR_Temperature_13 "Linear scaling, used for variable crt_PT_980425_IR_Temperature_13, signal IR_Temperature_13" RAT_FUNC "%6" "" COEFFS 0 -1 0.0 0 0 -0.1 /end COMPU_METHOD
/* Measurement point for signal IR_Temperature_14 of frame RT_IRTemp_Temp_FR_2 (9962533x, 0x980425x) */
/begin MEASUREMENT crt_PT_980425_IR_Temperature_14 "signal IR_Temperature_14 of frame RT_IRTemp_Temp_FR_2 (9962533x, 0x980425x)" SWORD CONV_crt_PT_980425_IR_Temperature_14 0 0 0.0 0.0 ECU_ADDRESS 0x0000 /end MEASUREMENT
/begin COMPU_METHOD CONV_crt_PT_980425_IR_Temperature_14 "Linear scaling, used for variable crt_PT_980425_IR_Temperature_14, signal IR_Temperature_14" RAT_FUNC "%6" "" COEFFS 0 -1 0.0 0 0 -0.1 /end COMPU_METHOD
/* Measurement point for signal IR_Temperature_15 of frame RT_IRTemp_Temp_FR_2 (9962533x, 0x980425x) */
/begin MEASUREMENT crt_PT_980425_IR_Temperature_15 "signal IR_Temperature_15 of frame RT_IRTemp_Temp_FR_2 (9962533x, 0x980425x)" SWORD CONV_crt_PT_980425_IR_Temperature_15 0 0 0.0 0.0 ECU_ADDRESS 0x0000 /end MEASUREMENT
/begin COMPU_METHOD CONV_crt_PT_980425_IR_Temperature_15 "Linear scaling, used for variable crt_PT_980425_IR_Temperature_15, signal IR_Temperature_15" RAT_FUNC "%6" "" COEFFS 0 -1 0.0 0 0 -0.1 /end COMPU_METHOD
/* Measurement point for signal IR_Temperature_16 of frame RT_IRTemp_Temp_FR_2 (9962533x, 0x980425x) */
/begin MEASUREMENT crt_PT_980425_IR_Temperature_16 "signal IR_Temperature_16 of frame RT_IRTemp_Temp_FR_2 (9962533x, 0x980425x)" SWORD CONV_crt_PT_980425_IR_Temperature_16 0 0 0.0 0.0 ECU_ADDRESS 0x0000 /end MEASUREMENT
/begin COMPU_METHOD CONV_crt_PT_980425_IR_Temperature_16 "Linear scaling, used for variable crt_PT_980425_IR_Temperature_16, signal IR_Temperature_16" RAT_FUNC "%6" "" COEFFS 0 -1 0.0 0 0 -0.1 /end COMPU_METHOD
/* Measurement point for signal IR_Temperature_5 of frame RT_IRTemp_Temp_FL_2 (9962021x, 0x980225x) */
/begin MEASUREMENT crt_PT_980225_IR_Temperature_5 "signal IR_Temperature_5 of frame RT_IRTemp_Temp_FL_2 (9962021x, 0x980225x)" SWORD CONV_crt_PT_980225_IR_Temperature_5 0 0 0.0 0.0 ECU_ADDRESS 0x0000 /end MEASUREMENT
/begin COMPU_METHOD CONV_crt_PT_980225_IR_Temperature_5 "Linear scaling, used for variable crt_PT_980225_IR_Temperature_5, signal IR_Temperature_5" RAT_FUNC "%6" "" COEFFS 0 -1 0.0 0 0 -0.1 /end COMPU_METHOD
/* Measurement point for signal IR_Temperature_6 of frame RT_IRTemp_Temp_FL_2 (9962021x, 0x980225x) */
/begin MEASUREMENT crt_PT_980225_IR_Temperature_6 "signal IR_Temperature_6 of frame RT_IRTemp_Temp_FL_2 (9962021x, 0x980225x)" SWORD CONV_crt_PT_980225_IR_Temperature_6 0 0 0.0 0.0 ECU_ADDRESS 0x0000 /end MEASUREMENT
/begin COMPU_METHOD CONV_crt_PT_980225_IR_Temperature_6 "Linear scaling, used for variable crt_PT_980225_IR_Temperature_6, signal IR_Temperature_6" RAT_FUNC "%6" "" COEFFS 0 -1 0.0 0 0 -0.1 /end COMPU_METHOD
/* Measurement point for signal IR_Temperature_7 of frame RT_IRTemp_Temp_FL_2 (9962021x, 0x980225x) */
/begin MEASUREMENT crt_PT_980225_IR_Temperature_7 "signal IR_Temperature_7 of frame RT_IRTemp_Temp_FL_2 (9962021x, 0x980225x)" SWORD CONV_crt_PT_980225_IR_Temperature_7 0 0 0.0 0.0 ECU_ADDRESS 0x0000 /end MEASUREMENT
/begin COMPU_METHOD CONV_crt_PT_980225_IR_Temperature_7 "Linear scaling, used for variable crt_PT_980225_IR_Temperature_7, signal IR_Temperature_7" RAT_FUNC "%6" "" COEFFS 0 -1 0.0 0 0 -0.1 /end COMPU_METHOD
/* Measurement point for signal IR_Temperature_8 of frame RT_IRTemp_Temp_FL_2 (9962021x, 0x980225x) */
/begin MEASUREMENT crt_PT_980225_IR_Temperature_8 "signal IR_Temperature_8 of frame RT_IRTemp_Temp_FL_2 (9962021x, 0x980225x)" SWORD CONV_crt_PT_980225_IR_Temperature_8 0 0 0.0 0.0 ECU_ADDRESS 0x0000 /end MEASUREMENT
/begin COMPU_METHOD CONV_crt_PT_980225_IR_Temperature_8 "Linear scaling, used for variable crt_PT_980225_IR_Temperature_8, signal IR_Temperature_8" RAT_FUNC "%6" "" COEFFS 0 -1 0.0 0 0 -0.1 /end COMPU_METHOD
/* Measurement point for signal IR_Temperature_25 of frame RT_IRTemp_Temp_RR_1 (9963301x, 0x980725x) */
/begin MEASUREMENT crt_PT_980725_IR_Temperature_25 "signal IR_Temperature_25 of frame RT_IRTemp_Temp_RR_1 (9963301x, 0x980725x)" SWORD CONV_crt_PT_980725_IR_Temperature_25 0 0 0.0 0.0 ECU_ADDRESS 0x0000 /end MEASUREMENT
/begin COMPU_METHOD CONV_crt_PT_980725_IR_Temperature_25 "Linear scaling, used for variable crt_PT_980725_IR_Temperature_25, signal IR_Temperature_25" RAT_FUNC "%6" "" COEFFS 0 -1 0.0 0 0 -0.1 /end COMPU_METHOD
/* Measurement point for signal IR_Temperature_26 of frame RT_IRTemp_Temp_RR_1 (9963301x, 0x980725x) */
/begin MEASUREMENT crt_PT_980725_IR_Temperature_26 "signal IR_Temperature_26 of frame RT_IRTemp_Temp_RR_1 (9963301x, 0x980725x)" SWORD CONV_crt_PT_980725_IR_Temperature_26 0 0 0.0 0.0 ECU_ADDRESS 0x0000 /end MEASUREMENT
/begin COMPU_METHOD CONV_crt_PT_980725_IR_Temperature_26 "Linear scaling, used for variable crt_PT_980725_IR_Temperature_26, signal IR_Temperature_26" RAT_FUNC "%6" "" COEFFS 0 -1 0.0 0 0 -0.1 /end COMPU_METHOD
/* Measurement point for signal IR_Temperature_27 of frame RT_IRTemp_Temp_RR_1 (9963301x, 0x980725x) */
/begin MEASUREMENT crt_PT_980725_IR_Temperature_27 "signal IR_Temperature_27 of frame RT_IRTemp_Temp_RR_1 (9963301x, 0x980725x)" SWORD CONV_crt_PT_980725_IR_Temperature_27 0 0 0.0 0.0 ECU_ADDRESS 0x0000 /end MEASUREMENT
/begin COMPU_METHOD CONV_crt_PT_980725_IR_Temperature_27 "Linear scaling, used for variable crt_PT_980725_IR_Temperature_27, signal IR_Temperature_27" RAT_FUNC "%6" "" COEFFS 0 -1 0.0 0 0 -0.1 /end COMPU_METHOD
/* Measurement point for signal IR_Temperature_28 of frame RT_IRTemp_Temp_RR_1 (9963301x, 0x980725x) */
/begin MEASUREMENT crt_PT_980725_IR_Temperature_28 "signal IR_Temperature_28 of frame RT_IRTemp_Temp_RR_1 (9963301x, 0x980725x)" SWORD CONV_crt_PT_980725_IR_Temperature_28 0 0 0.0 0.0 ECU_ADDRESS 0x0000 /end MEASUREMENT
/begin COMPU_METHOD CONV_crt_PT_980725_IR_Temperature_28 "Linear scaling, used for variable crt_PT_980725_IR_Temperature_28, signal IR_Temperature_28" RAT_FUNC "%6" "" COEFFS 0 -1 0.0 0 0 -0.1 /end COMPU_METHOD
/* Measurement point for signal IR_Temperature_17 of frame RT_IRTemp_Temp_RL_1 (9962789x, 0x980525x) */
/begin MEASUREMENT crt_PT_980525_IR_Temperature_17 "signal IR_Temperature_17 of frame RT_IRTemp_Temp_RL_1 (9962789x, 0x980525x)" SWORD CONV_crt_PT_980525_IR_Temperature_17 0 0 0.0 0.0 ECU_ADDRESS 0x0000 /end MEASUREMENT
/begin COMPU_METHOD CONV_crt_PT_980525_IR_Temperature_17 "Linear scaling, used for variable crt_PT_980525_IR_Temperature_17, signal IR_Temperature_17" RAT_FUNC "%6" "" COEFFS 0 -1 0.0 0 0 -0.1 /end COMPU_METHOD
/* Measurement point for signal IR_Temperature_18 of frame RT_IRTemp_Temp_RL_1 (9962789x, 0x980525x) */
/begin MEASUREMENT crt_PT_980525_IR_Temperature_18 "signal IR_Temperature_18 of frame RT_IRTemp_Temp_RL_1 (9962789x, 0x980525x)" SWORD CONV_crt_PT_980525_IR_Temperature_18 0 0 0.0 0.0 ECU_ADDRESS 0x0000 /end MEASUREMENT
/begin COMPU_METHOD CONV_crt_PT_980525_IR_Temperature_18 "Linear scaling, used for variable crt_PT_980525_IR_Temperature_18, signal IR_Temperature_18" RAT_FUNC "%6" "" COEFFS 0 -1 0.0 0 0 -0.1 /end COMPU_METHOD
/* Measurement point for signal IR_Temperature_19 of frame RT_IRTemp_Temp_RL_1 (9962789x, 0x980525x) */
/begin MEASUREMENT crt_PT_980525_IR_Temperature_19 "signal IR_Temperature_19 of frame RT_IRTemp_Temp_RL_1 (9962789x, 0x980525x)" SWORD CONV_crt_PT_980525_IR_Temperature_19 0 0 0.0 0.0 ECU_ADDRESS 0x0000 /end MEASUREMENT
/begin COMPU_METHOD CONV_crt_PT_980525_IR_Temperature_19 "Linear scaling, used for variable crt_PT_980525_IR_Temperature_19, signal IR_Temperature_19" RAT_FUNC "%6" "" COEFFS 0 -1 0.0 0 0 -0.1 /end COMPU_METHOD
/* Measurement point for signal IR_Temperature_20 of frame RT_IRTemp_Temp_RL_1 (9962789x, 0x980525x) */
/begin MEASUREMENT crt_PT_980525_IR_Temperature_20 "signal IR_Temperature_20 of frame RT_IRTemp_Temp_RL_1 (9962789x, 0x980525x)" SWORD CONV_crt_PT_980525_IR_Temperature_20 0 0 0.0 0.0 ECU_ADDRESS 0x0000 /end MEASUREMENT
/begin COMPU_METHOD CONV_crt_PT_980525_IR_Temperature_20 "Linear scaling, used for variable crt_PT_980525_IR_Temperature_20, signal IR_Temperature_20" RAT_FUNC "%6" "" COEFFS 0 -1 0.0 0 0 -0.1 /end COMPU_METHOD
/* Measurement point for signal IR_Temperature_9 of frame RT_IRTemp_Temp_FR_1 (9962277x, 0x980325x) */
/begin MEASUREMENT crt_PT_980325_IR_Temperature_9 "signal IR_Temperature_9 of frame RT_IRTemp_Temp_FR_1 (9962277x, 0x980325x)" SWORD CONV_crt_PT_980325_IR_Temperature_9 0 0 0.0 0.0 ECU_ADDRESS 0x0000 /end MEASUREMENT
/begin COMPU_METHOD CONV_crt_PT_980325_IR_Temperature_9 "Linear scaling, used for variable crt_PT_980325_IR_Temperature_9, signal IR_Temperature_9" RAT_FUNC "%6" "" COEFFS 0 -1 0.0 0 0 -0.1 /end COMPU_METHOD
/* Measurement point for signal IR_Temperature_10 of frame RT_IRTemp_Temp_FR_1 (9962277x, 0x980325x) */
/begin MEASUREMENT crt_PT_980325_IR_Temperature_10 "signal IR_Temperature_10 of frame RT_IRTemp_Temp_FR_1 (9962277x, 0x980325x)" SWORD CONV_crt_PT_980325_IR_Temperature_10 0 0 0.0 0.0 ECU_ADDRESS 0x0000 /end MEASUREMENT
/begin COMPU_METHOD CONV_crt_PT_980325_IR_Temperature_10 "Linear scaling, used for variable crt_PT_980325_IR_Temperature_10, signal IR_Temperature_10" RAT_FUNC "%6" "" COEFFS 0 -1 0.0 0 0 -0.1 /end COMPU_METHOD
/* Measurement point for signal IR_Temperature_11 of frame RT_IRTemp_Temp_FR_1 (9962277x, 0x980325x) */
/begin MEASUREMENT crt_PT_980325_IR_Temperature_11 "signal IR_Temperature_11 of frame RT_IRTemp_Temp_FR_1 (9962277x, 0x980325x)" SWORD CONV_crt_PT_980325_IR_Temperature_11 0 0 0.0 0.0 ECU_ADDRESS 0x0000 /end MEASUREMENT
/begin COMPU_METHOD CONV_crt_PT_980325_IR_Temperature_11 "Linear scaling, used for variable crt_PT_980325_IR_Temperature_11, signal IR_Temperature_11" RAT_FUNC "%6" "" COEFFS 0 -1 0.0 0 0 -0.1 /end COMPU_METHOD
/* Measurement point for signal IR_Temperature_12 of frame RT_IRTemp_Temp_FR_1 (9962277x, 0x980325x) */
/begin MEASUREMENT crt_PT_980325_IR_Temperature_12 "signal IR_Temperature_12 of frame RT_IRTemp_Temp_FR_1 (9962277x, 0x980325x)" SWORD CONV_crt_PT_980325_IR_Temperature_12 0 0 0.0 0.0 ECU_ADDRESS 0x0000 /end MEASUREMENT
/begin COMPU_METHOD CONV_crt_PT_980325_IR_Temperature_12 "Linear scaling, used for variable crt_PT_980325_IR_Temperature_12, signal IR_Temperature_12" RAT_FUNC "%6" "" COEFFS 0 -1 0.0 0 0 -0.1 /end COMPU_METHOD
/* Measurement point for signal IR_Temperature_1 of frame RT_IRTemp_Temp_FL_1 (9961765x, 0x980125x) */
/begin MEASUREMENT crt_PT_980125_IR_Temperature_1 "signal IR_Temperature_1 of frame RT_IRTemp_Temp_FL_1 (9961765x, 0x980125x)" SWORD CONV_crt_PT_980125_IR_Temperature_1 0 0 0.0 0.0 ECU_ADDRESS 0x0000 /end MEASUREMENT
/begin COMPU_METHOD CONV_crt_PT_980125_IR_Temperature_1 "Linear scaling, used for variable crt_PT_980125_IR_Temperature_1, signal IR_Temperature_1" RAT_FUNC "%6" "" COEFFS 0 -1 0.0 0 0 -0.1 /end COMPU_METHOD
/* Measurement point for signal IR_Temperature_2 of frame RT_IRTemp_Temp_FL_1 (9961765x, 0x980125x) */
/begin MEASUREMENT crt_PT_980125_IR_Temperature_2 "signal IR_Temperature_2 of frame RT_IRTemp_Temp_FL_1 (9961765x, 0x980125x)" SWORD CONV_crt_PT_980125_IR_Temperature_2 0 0 0.0 0.0 ECU_ADDRESS 0x0000 /end MEASUREMENT
/begin COMPU_METHOD CONV_crt_PT_980125_IR_Temperature_2 "Linear scaling, used for variable crt_PT_980125_IR_Temperature_2, signal IR_Temperature_2" RAT_FUNC "%6" "" COEFFS 0 -1 0.0 0 0 -0.1 /end COMPU_METHOD
/* Measurement point for signal IR_Temperature_3 of frame RT_IRTemp_Temp_FL_1 (9961765x, 0x980125x) */
/begin MEASUREMENT crt_PT_980125_IR_Temperature_3 "signal IR_Temperature_3 of frame RT_IRTemp_Temp_FL_1 (9961765x, 0x980125x)" SWORD CONV_crt_PT_980125_IR_Temperature_3 0 0 0.0 0.0 ECU_ADDRESS 0x0000 /end MEASUREMENT
/begin COMPU_METHOD CONV_crt_PT_980125_IR_Temperature_3 "Linear scaling, used for variable crt_PT_980125_IR_Temperature_3, signal IR_Temperature_3" RAT_FUNC "%6" "" COEFFS 0 -1 0.0 0 0 -0.1 /end COMPU_METHOD
/* Measurement point for signal IR_Temperature_4 of frame RT_IRTemp_Temp_FL_1 (9961765x, 0x980125x) */
/begin MEASUREMENT crt_PT_980125_IR_Temperature_4 "signal IR_Temperature_4 of frame RT_IRTemp_Temp_FL_1 (9961765x, 0x980125x)" SWORD CONV_crt_PT_980125_IR_Temperature_4 0 0 0.0 0.0 ECU_ADDRESS 0x0000 /end MEASUREMENT
/begin COMPU_METHOD CONV_crt_PT_980125_IR_Temperature_4 "Linear scaling, used for variable crt_PT_980125_IR_Temperature_4, signal IR_Temperature_4" RAT_FUNC "%6" "" COEFFS 0 -1 0.0 0 0 -0.1 /end COMPU_METHOD
/* Measurement point for signal IR_Temperature_32 of frame RT_IRTemp_Temp_32 (9510949x, 0x912025x) */
/begin MEASUREMENT crt_PT_912025_IR_Temperature_32 "signal IR_Temperature_32 of frame RT_IRTemp_Temp_32 (9510949x, 0x912025x)" SWORD CONV_crt_PT_912025_IR_Temperature_32 0 0 0.0 0.0 ECU_ADDRESS 0x0000 /end MEASUREMENT
/begin COMPU_METHOD CONV_crt_PT_912025_IR_Temperature_32 "Linear scaling, used for variable crt_PT_912025_IR_Temperature_32, signal IR_Temperature_32" RAT_FUNC "%6" "" COEFFS 0 -1 0.0 0 0 -0.1 /end COMPU_METHOD
/* Measurement point for signal IR_Temperature_31 of frame RT_IRTemp_Temp_31 (9510693x, 0x911F25x) */
/begin MEASUREMENT crt_PT_911f25_IR_Temperature_31 "signal IR_Temperature_31 of frame RT_IRTemp_Temp_31 (9510693x, 0x911F25x)" SWORD CONV_crt_PT_911f25_IR_Temperature_31 0 0 0.0 0.0 ECU_ADDRESS 0x0000 /end MEASUREMENT
/begin COMPU_METHOD CONV_crt_PT_911f25_IR_Temperature_31 "Linear scaling, used for variable crt_PT_911f25_IR_Temperature_31, signal IR_Temperature_31" RAT_FUNC "%6" "" COEFFS 0 -1 0.0 0 0 -0.1 /end COMPU_METHOD
/* Measurement point for signal IR_Temperature_30 of frame RT_IRTemp_Temp_30 (9510437x, 0x911E25x) */
/begin MEASUREMENT crt_PT_911e25_IR_Temperature_30 "signal IR_Temperature_30 of frame RT_IRTemp_Temp_30 (9510437x, 0x911E25x)" SWORD CONV_crt_PT_911e25_IR_Temperature_30 0 0 0.0 0.0 ECU_ADDRESS 0x0000 /end MEASUREMENT
/begin COMPU_METHOD CONV_crt_PT_911e25_IR_Temperature_30 "Linear scaling, used for variable crt_PT_911e25_IR_Temperature_30, signal IR_Temperature_30" RAT_FUNC "%6" "" COEFFS 0 -1 0.0 0 0 -0.1 /end COMPU_METHOD
/* Measurement point for signal IR_Temperature_29 of frame RT_IRTemp_Temp_29 (9510181x, 0x911D25x) */
/begin MEASUREMENT crt_PT_911d25_IR_Temperature_29 "signal IR_Temperature_29 of frame RT_IRTemp_Temp_29 (9510181x, 0x911D25x)" SWORD CONV_crt_PT_911d25_IR_Temperature_29 0 0 0.0 0.0 ECU_ADDRESS 0x0000 /end MEASUREMENT
/begin COMPU_METHOD CONV_crt_PT_911d25_IR_Temperature_29 "Linear scaling, used for variable crt_PT_911d25_IR_Temperature_29, signal IR_Temperature_29" RAT_FUNC "%6" "" COEFFS 0 -1 0.0 0 0 -0.1 /end COMPU_METHOD
/* Measurement point for signal IR_Temperature_28 of frame RT_IRTemp_Temp_28 (9509925x, 0x911C25x) */
/begin MEASUREMENT crt_PT_911c25_IR_Temperature_28 "signal IR_Temperature_28 of frame RT_IRTemp_Temp_28 (9509925x, 0x911C25x)" SWORD CONV_crt_PT_911c25_IR_Temperature_28 0 0 0.0 0.0 ECU_ADDRESS 0x0000 /end MEASUREMENT
/begin COMPU_METHOD CONV_crt_PT_911c25_IR_Temperature_28 "Linear scaling, used for variable crt_PT_911c25_IR_Temperature_28, signal IR_Temperature_28" RAT_FUNC "%6" "" COEFFS 0 -1 0.0 0 0 -0.1 /end COMPU_METHOD
/* Measurement point for signal IR_Temperature_27 of frame RT_IRTemp_Temp_27 (9509669x, 0x911B25x) */
/begin MEASUREMENT crt_PT_911b25_IR_Temperature_27 "signal IR_Temperature_27 of frame RT_IRTemp_Temp_27 (9509669x, 0x911B25x)" SWORD CONV_crt_PT_911b25_IR_Temperature_27 0 0 0.0 0.0 ECU_ADDRESS 0x0000 /end MEASUREMENT
/begin COMPU_METHOD CONV_crt_PT_911b25_IR_Temperature_27 "Linear scaling, used for variable crt_PT_911b25_IR_Temperature_27, signal IR_Temperature_27" RAT_FUNC "%6" "" COEFFS 0 -1 0.0 0 0 -0.1 /end COMPU_METHOD
/* Measurement point for signal IR_Temperature_26 of frame RT_IRTemp_Temp_26 (9509413x, 0x911A25x) */
/begin MEASUREMENT crt_PT_911a25_IR_Temperature_26 "signal IR_Temperature_26 of frame RT_IRTemp_Temp_26 (9509413x, 0x911A25x)" SWORD CONV_crt_PT_911a25_IR_Temperature_26 0 0 0.0 0.0 ECU_ADDRESS 0x0000 /end MEASUREMENT
/begin COMPU_METHOD CONV_crt_PT_911a25_IR_Temperature_26 "Linear scaling, used for variable crt_PT_911a25_IR_Temperature_26, signal IR_Temperature_26" RAT_FUNC "%6" "" COEFFS 0 -1 0.0 0 0 -0.1 /end COMPU_METHOD
/* Measurement point for signal IR_Temperature_25 of frame RT_IRTemp_Temp_25 (9509157x, 0x911925x) */
/begin MEASUREMENT crt_PT_911925_IR_Temperature_25 "signal IR_Temperature_25 of frame RT_IRTemp_Temp_25 (9509157x, 0x911925x)" SWORD CONV_crt_PT_911925_IR_Temperature_25 0 0 0.0 0.0 ECU_ADDRESS 0x0000 /end MEASUREMENT
/begin COMPU_METHOD CONV_crt_PT_911925_IR_Temperature_25 "Linear scaling, used for variable crt_PT_911925_IR_Temperature_25, signal IR_Temperature_25" RAT_FUNC "%6" "" COEFFS 0 -1 0.0 0 0 -0.1 /end COMPU_METHOD
/* Measurement point for signal IR_Temperature_24 of frame RT_IRTemp_Temp_24 (9508901x, 0x911825x) */
/begin MEASUREMENT crt_PT_911825_IR_Temperature_24 "signal IR_Temperature_24 of frame RT_IRTemp_Temp_24 (9508901x, 0x911825x)" SWORD CONV_crt_PT_911825_IR_Temperature_24 0 0 0.0 0.0 ECU_ADDRESS 0x0000 /end MEASUREMENT
/begin COMPU_METHOD CONV_crt_PT_911825_IR_Temperature_24 "Linear scaling, used for variable crt_PT_911825_IR_Temperature_24, signal IR_Temperature_24" RAT_FUNC "%6" "" COEFFS 0 -1 0.0 0 0 -0.1 /end COMPU_METHOD
/* Measurement point for signal IR_Temperature_22 of frame RT_IRTemp_Temp_22 (9508389x, 0x911625x) */
/begin MEASUREMENT crt_PT_911625_IR_Temperature_22 "signal IR_Temperature_22 of frame RT_IRTemp_Temp_22 (9508389x, 0x911625x)" SWORD CONV_crt_PT_911625_IR_Temperature_22 0 0 0.0 0.0 ECU_ADDRESS 0x0000 /end MEASUREMENT
/begin COMPU_METHOD CONV_crt_PT_911625_IR_Temperature_22 "Linear scaling, used for variable crt_PT_911625_IR_Temperature_22, signal IR_Temperature_22" RAT_FUNC "%6" "" COEFFS 0 -1 0.0 0 0 -0.1 /end COMPU_METHOD
/* Measurement point for signal IR_Temperature_23 of frame RT_IRTemp_Temp_23 (9508645x, 0x911725x) */
/begin MEASUREMENT crt_PT_911725_IR_Temperature_23 "signal IR_Temperature_23 of frame RT_IRTemp_Temp_23 (9508645x, 0x911725x)" SWORD CONV_crt_PT_911725_IR_Temperature_23 0 0 0.0 0.0 ECU_ADDRESS 0x0000 /end MEASUREMENT
/begin COMPU_METHOD CONV_crt_PT_911725_IR_Temperature_23 "Linear scaling, used for variable crt_PT_911725_IR_Temperature_23, signal IR_Temperature_23" RAT_FUNC "%6" "" COEFFS 0 -1 0.0 0 0 -0.1 /end COMPU_METHOD
/* Measurement point for signal IR_Temperature_21 of frame RT_IRTemp_Temp_21 (9508133x, 0x911525x) */
/begin MEASUREMENT crt_PT_911525_IR_Temperature_21 "signal IR_Temperature_21 of frame RT_IRTemp_Temp_21 (9508133x, 0x911525x)" SWORD CONV_crt_PT_911525_IR_Temperature_21 0 0 0.0 0.0 ECU_ADDRESS 0x0000 /end MEASUREMENT
/begin COMPU_METHOD CONV_crt_PT_911525_IR_Temperature_21 "Linear scaling, used for variable crt_PT_911525_IR_Temperature_21, signal IR_Temperature_21" RAT_FUNC "%6" "" COEFFS 0 -1 0.0 0 0 -0.1 /end COMPU_METHOD
/* Measurement point for signal IR_Temperature_20 of frame RT_IRTemp_Temp_20 (9507877x, 0x911425x) */
/begin MEASUREMENT crt_PT_911425_IR_Temperature_20 "signal IR_Temperature_20 of frame RT_IRTemp_Temp_20 (9507877x, 0x911425x)" SWORD CONV_crt_PT_911425_IR_Temperature_20 0 0 0.0 0.0 ECU_ADDRESS 0x0000 /end MEASUREMENT
/begin COMPU_METHOD CONV_crt_PT_911425_IR_Temperature_20 "Linear scaling, used for variable crt_PT_911425_IR_Temperature_20, signal IR_Temperature_20" RAT_FUNC "%6" "" COEFFS 0 -1 0.0 0 0 -0.1 /end COMPU_METHOD
/* Measurement point for signal IR_Temperature_19 of frame RT_IRTemp_Temp_19 (9507621x, 0x911325x) */
/begin MEASUREMENT crt_PT_911325_IR_Temperature_19 "signal IR_Temperature_19 of frame RT_IRTemp_Temp_19 (9507621x, 0x911325x)" SWORD CONV_crt_PT_911325_IR_Temperature_19 0 0 0.0 0.0 ECU_ADDRESS 0x0000 /end MEASUREMENT
/begin COMPU_METHOD CONV_crt_PT_911325_IR_Temperature_19 "Linear scaling, used for variable crt_PT_911325_IR_Temperature_19, signal IR_Temperature_19" RAT_FUNC "%6" "" COEFFS 0 -1 0.0 0 0 -0.1 /end COMPU_METHOD
/* Measurement point for signal IR_Temperature_18 of frame RT_IRTemp_Temp_18 (9507365x, 0x911225x) */
/begin MEASUREMENT crt_PT_911225_IR_Temperature_18 "signal IR_Temperature_18 of frame RT_IRTemp_Temp_18 (9507365x, 0x911225x)" SWORD CONV_crt_PT_911225_IR_Temperature_18 0 0 0.0 0.0 ECU_ADDRESS 0x0000 /end MEASUREMENT
/begin COMPU_METHOD CONV_crt_PT_911225_IR_Temperature_18 "Linear scaling, used for variable crt_PT_911225_IR_Temperature_18, signal IR_Temperature_18" RAT_FUNC "%6" "" COEFFS 0 -1 0.0 0 0 -0.1 /end COMPU_METHOD
/* Measurement point for signal IR_Temperature_16 of frame RT_IRTemp_Temp_16 (9506853x, 0x911025x) */
/begin MEASUREMENT crt_PT_911025_IR_Temperature_16 "signal IR_Temperature_16 of frame RT_IRTemp_Temp_16 (9506853x, 0x911025x)" SWORD CONV_crt_PT_911025_IR_Temperature_16 0 0 0.0 0.0 ECU_ADDRESS 0x0000 /end MEASUREMENT
/begin COMPU_METHOD CONV_crt_PT_911025_IR_Temperature_16 "Linear scaling, used for variable crt_PT_911025_IR_Temperature_16, signal IR_Temperature_16" RAT_FUNC "%6" "" COEFFS 0 -1 0.0 0 0 -0.1 /end COMPU_METHOD
/* Measurement point for signal IR_Temperature_15 of frame RT_IRTemp_Temp_15 (9506597x, 0x910F25x) */
/begin MEASUREMENT crt_PT_910f25_IR_Temperature_15 "signal IR_Temperature_15 of frame RT_IRTemp_Temp_15 (9506597x, 0x910F25x)" SWORD CONV_crt_PT_910f25_IR_Temperature_15 0 0 0.0 0.0 ECU_ADDRESS 0x0000 /end MEASUREMENT
/begin COMPU_METHOD CONV_crt_PT_910f25_IR_Temperature_15 "Linear scaling, used for variable crt_PT_910f25_IR_Temperature_15, signal IR_Temperature_15" RAT_FUNC "%6" "" COEFFS 0 -1 0.0 0 0 -0.1 /end COMPU_METHOD
/* Measurement point for signal IR_Temperature_14 of frame RT_IRTemp_Temp_14 (9506341x, 0x910E25x) */
/begin MEASUREMENT crt_PT_910e25_IR_Temperature_14 "signal IR_Temperature_14 of frame RT_IRTemp_Temp_14 (9506341x, 0x910E25x)" SWORD CONV_crt_PT_910e25_IR_Temperature_14 0 0 0.0 0.0 ECU_ADDRESS 0x0000 /end MEASUREMENT
/begin COMPU_METHOD CONV_crt_PT_910e25_IR_Temperature_14 "Linear scaling, used for variable crt_PT_910e25_IR_Temperature_14, signal IR_Temperature_14" RAT_FUNC "%6" "" COEFFS 0 -1 0.0 0 0 -0.1 /end COMPU_METHOD
/* Measurement point for signal IR_Temperature_13 of frame RT_IRTemp_Temp_13 (9506085x, 0x910D25x) */
/begin MEASUREMENT crt_PT_910d25_IR_Temperature_13 "signal IR_Temperature_13 of frame RT_IRTemp_Temp_13 (9506085x, 0x910D25x)" SWORD CONV_crt_PT_910d25_IR_Temperature_13 0 0 0.0 0.0 ECU_ADDRESS 0x0000 /end MEASUREMENT
/begin COMPU_METHOD CONV_crt_PT_910d25_IR_Temperature_13 "Linear scaling, used for variable crt_PT_910d25_IR_Temperature_13, signal IR_Temperature_13" RAT_FUNC "%6" "" COEFFS 0 -1 0.0 0 0 -0.1 /end COMPU_METHOD
/* Measurement point for signal IR_Temperature_12 of frame RT_IRTemp_Temp_12 (9505829x, 0x910C25x) */
/begin MEASUREMENT crt_PT_910c25_IR_Temperature_12 "signal IR_Temperature_12 of frame RT_IRTemp_Temp_12 (9505829x, 0x910C25x)" SWORD CONV_crt_PT_910c25_IR_Temperature_12 0 0 0.0 0.0 ECU_ADDRESS 0x0000 /end MEASUREMENT
/begin COMPU_METHOD CONV_crt_PT_910c25_IR_Temperature_12 "Linear scaling, used for variable crt_PT_910c25_IR_Temperature_12, signal IR_Temperature_12" RAT_FUNC "%6" "" COEFFS 0 -1 0.0 0 0 -0.1 /end COMPU_METHOD
/* Measurement point for signal IR_Temperature_11 of frame RT_IRTemp_Temp_11 (9505573x, 0x910B25x) */
/begin MEASUREMENT crt_PT_910b25_IR_Temperature_11 "signal IR_Temperature_11 of frame RT_IRTemp_Temp_11 (9505573x, 0x910B25x)" SWORD CONV_crt_PT_910b25_IR_Temperature_11 0 0 0.0 0.0 ECU_ADDRESS 0x0000 /end MEASUREMENT
/begin COMPU_METHOD CONV_crt_PT_910b25_IR_Temperature_11 "Linear scaling, used for variable crt_PT_910b25_IR_Temperature_11, signal IR_Temperature_11" RAT_FUNC "%6" "" COEFFS 0 -1 0.0 0 0 -0.1 /end COMPU_METHOD
/* Measurement point for signal IR_Temperature_10 of frame RT_IRTemp_Temp_10 (9505317x, 0x910A25x) */
/begin MEASUREMENT crt_PT_910a25_IR_Temperature_10 "signal IR_Temperature_10 of frame RT_IRTemp_Temp_10 (9505317x, 0x910A25x)" SWORD CONV_crt_PT_910a25_IR_Temperature_10 0 0 0.0 0.0 ECU_ADDRESS 0x0000 /end MEASUREMENT
/begin COMPU_METHOD CONV_crt_PT_910a25_IR_Temperature_10 "Linear scaling, used for variable crt_PT_910a25_IR_Temperature_10, signal IR_Temperature_10" RAT_FUNC "%6" "" COEFFS 0 -1 0.0 0 0 -0.1 /end COMPU_METHOD
/* Measurement point for signal IR_Temperature_8 of frame RT_IRTemp_Temp_8 (9504805x, 0x910825x) */
/begin MEASUREMENT crt_PT_910825_IR_Temperature_8 "signal IR_Temperature_8 of frame RT_IRTemp_Temp_8 (9504805x, 0x910825x)" SWORD CONV_crt_PT_910825_IR_Temperature_8 0 0 0.0 0.0 ECU_ADDRESS 0x0000 /end MEASUREMENT
/begin COMPU_METHOD CONV_crt_PT_910825_IR_Temperature_8 "Linear scaling, used for variable crt_PT_910825_IR_Temperature_8, signal IR_Temperature_8" RAT_FUNC "%6" "" COEFFS 0 -1 0.0 0 0 -0.1 /end COMPU_METHOD
/* Measurement point for signal IR_Temperature_9 of frame RT_IRTemp_Temp_9 (9505061x, 0x910925x) */
/begin MEASUREMENT crt_PT_910925_IR_Temperature_9 "signal IR_Temperature_9 of frame RT_IRTemp_Temp_9 (9505061x, 0x910925x)" SWORD CONV_crt_PT_910925_IR_Temperature_9 0 0 0.0 0.0 ECU_ADDRESS 0x0000 /end MEASUREMENT
/begin COMPU_METHOD CONV_crt_PT_910925_IR_Temperature_9 "Linear scaling, used for variable crt_PT_910925_IR_Temperature_9, signal IR_Temperature_9" RAT_FUNC "%6" "" COEFFS 0 -1 0.0 0 0 -0.1 /end COMPU_METHOD
/* Measurement point for signal IR_Temperature_17 of frame RT_IRTemp_Temp_17 (9507109x, 0x911125x) */
/begin MEASUREMENT crt_PT_911125_IR_Temperature_17 "signal IR_Temperature_17 of frame RT_IRTemp_Temp_17 (9507109x, 0x911125x)" SWORD CONV_crt_PT_911125_IR_Temperature_17 0 0 0.0 0.0 ECU_ADDRESS 0x0000 /end MEASUREMENT
/begin COMPU_METHOD CONV_crt_PT_911125_IR_Temperature_17 "Linear scaling, used for variable crt_PT_911125_IR_Temperature_17, signal IR_Temperature_17" RAT_FUNC "%6" "" COEFFS 0 -1 0.0 0 0 -0.1 /end COMPU_METHOD
/* Measurement point for signal IR_Temperature_6 of frame RT_IRTemp_Temp_6 (9504293x, 0x910625x) */
/begin MEASUREMENT crt_PT_910625_IR_Temperature_6 "signal IR_Temperature_6 of frame RT_IRTemp_Temp_6 (9504293x, 0x910625x)" SWORD CONV_crt_PT_910625_IR_Temperature_6 0 0 0.0 0.0 ECU_ADDRESS 0x0000 /end MEASUREMENT
/begin COMPU_METHOD CONV_crt_PT_910625_IR_Temperature_6 "Linear scaling, used for variable crt_PT_910625_IR_Temperature_6, signal IR_Temperature_6" RAT_FUNC "%6" "" COEFFS 0 -1 0.0 0 0 -0.1 /end COMPU_METHOD
/* Measurement point for signal IR_Temperature_5 of frame RT_IRTemp_Temp_5 (9504037x, 0x910525x) */
/begin MEASUREMENT crt_PT_910525_IR_Temperature_5 "signal IR_Temperature_5 of frame RT_IRTemp_Temp_5 (9504037x, 0x910525x)" SWORD CONV_crt_PT_910525_IR_Temperature_5 0 0 0.0 0.0 ECU_ADDRESS 0x0000 /end MEASUREMENT
/begin COMPU_METHOD CONV_crt_PT_910525_IR_Temperature_5 "Linear scaling, used for variable crt_PT_910525_IR_Temperature_5, signal IR_Temperature_5" RAT_FUNC "%6" "" COEFFS 0 -1 0.0 0 0 -0.1 /end COMPU_METHOD
/* Measurement point for signal IR_Temperature_4 of frame RT_IRTemp_Temp_4 (9503781x, 0x910425x) */
/begin MEASUREMENT crt_PT_910425_IR_Temperature_4 "signal IR_Temperature_4 of frame RT_IRTemp_Temp_4 (9503781x, 0x910425x)" SWORD CONV_crt_PT_910425_IR_Temperature_4 0 0 0.0 0.0 ECU_ADDRESS 0x0000 /end MEASUREMENT
/begin COMPU_METHOD CONV_crt_PT_910425_IR_Temperature_4 "Linear scaling, used for variable crt_PT_910425_IR_Temperature_4, signal IR_Temperature_4" RAT_FUNC "%6" "" COEFFS 0 -1 0.0 0 0 -0.1 /end COMPU_METHOD
/* Measurement point for signal IR_Temperature_3 of frame RT_IRTemp_Temp_3 (9503525x, 0x910325x) */
/begin MEASUREMENT crt_PT_910325_IR_Temperature_3 "signal IR_Temperature_3 of frame RT_IRTemp_Temp_3 (9503525x, 0x910325x)" SWORD CONV_crt_PT_910325_IR_Temperature_3 0 0 0.0 0.0 ECU_ADDRESS 0x0000 /end MEASUREMENT
/begin COMPU_METHOD CONV_crt_PT_910325_IR_Temperature_3 "Linear scaling, used for variable crt_PT_910325_IR_Temperature_3, signal IR_Temperature_3" RAT_FUNC "%6" "" COEFFS 0 -1 0.0 0 0 -0.1 /end COMPU_METHOD
/* Measurement point for signal IR_Temperature_2 of frame RT_IRTemp_Temp_2 (9503269x, 0x910225x) */
/begin MEASUREMENT crt_PT_910225_IR_Temperature_2 "signal IR_Temperature_2 of frame RT_IRTemp_Temp_2 (9503269x, 0x910225x)" SWORD CONV_crt_PT_910225_IR_Temperature_2 0 0 0.0 0.0 ECU_ADDRESS 0x0000 /end MEASUREMENT
/begin COMPU_METHOD CONV_crt_PT_910225_IR_Temperature_2 "Linear scaling, used for variable crt_PT_910225_IR_Temperature_2, signal IR_Temperature_2" RAT_FUNC "%6" "" COEFFS 0 -1 0.0 0 0 -0.1 /end COMPU_METHOD
/* Measurement point for signal IR_Temperature_1 of frame RT_IRTemp_Temp_1 (9503013x, 0x910125x) */
/begin MEASUREMENT crt_PT_910125_IR_Temperature_1 "signal IR_Temperature_1 of frame RT_IRTemp_Temp_1 (9503013x, 0x910125x)" SWORD CONV_crt_PT_910125_IR_Temperature_1 0 0 0.0 0.0 ECU_ADDRESS 0x0000 /end MEASUREMENT
/begin COMPU_METHOD CONV_crt_PT_910125_IR_Temperature_1 "Linear scaling, used for variable crt_PT_910125_IR_Temperature_1, signal IR_Temperature_1" RAT_FUNC "%6" "" COEFFS 0 -1 0.0 0 0 -0.1 /end COMPU_METHOD
/* Measurement point for signal CRC of frame RT_IRTemp_Temp_1 (9503013x, 0x910125x) */
/begin MEASUREMENT crt_PT_910125_CRC "signal CRC of frame RT_IRTemp_Temp_1 (9503013x, 0x910125x). Checksum" UBYTE CONV_crt_PT_910125_CRC 0 0 1 255 ECU_ADDRESS 0x0000 /end MEASUREMENT
/begin COMPU_METHOD CONV_crt_PT_910125_CRC "Identity, real-world value is same as binary value" IDENTICAL "%4" "" /end COMPU_METHOD
/* Measurement point for signal Validity_Final_Speed of frame RT_SB_Trig_Final_Condition (9242402x, 0x8D0722x) */
/begin MEASUREMENT crt_PT_8d0722_Validity_Final_Speed "signal Validity_Final_Speed of frame RT_SB_Trig_Final_Condition (9242402x, 0x8D0722x). Valid when bit is set, invalid when bit is clear." UBYTE CONV_crt_PT_8d0722_Validity_Final_Speed 0 0 0 1 ECU_ADDRESS 0x0000 /end MEASUREMENT
/begin COMPU_METHOD CONV_crt_PT_8d0722_Validity_Final_Speed "Identity, real-world value is same as binary value" IDENTICAL "%1" "" /end COMPU_METHOD
/* Measurement point for signal Final_Speed of frame RT_SB_Trig_Final_Condition (9242402x, 0x8D0722x) */
/begin MEASUREMENT crt_PT_8d0722_Final_Speed "signal Final_Speed of frame RT_SB_Trig_Final_Condition (9242402x, 0x8D0722x). Speed at end of triggered test" ULONG CONV_crt_PT_8d0722_Final_Speed 0 0 0.0 1675.0 ECU_ADDRESS 0x0000 /end MEASUREMENT
/begin COMPU_METHOD CONV_crt_PT_8d0722_Final_Speed "Linear scaling, used for variable crt_PT_8d0722_Final_Speed, signal Final_Speed" RAT_FUNC "%12" "m/s" COEFFS 0 -1 0.0 0 0 -1.0E-4 /end COMPU_METHOD
/* Measurement point for signal Validity_Initial_Speed of frame RT_SB_Trig_Initial_Condition (794, 0x31A) */
/begin MEASUREMENT crt_PT_31a_Validity_Initial_Speed "signal Validity_Initial_Speed of frame RT_SB_Trig_Initial_Condition (794, 0x31A). Valid when bit is set, invalid when bit is clear. Valid when bit is set, invalid when bit is clear." UBYTE CONV_crt_PT_31a_Validity_Initial_Speed 0 0 0 1 ECU_ADDRESS 0x0000 /end MEASUREMENT
/begin COMPU_METHOD CONV_crt_PT_31a_Validity_Initial_Speed "Identity, real-world value is same as binary value" IDENTICAL "%1" "" /end COMPU_METHOD
/* Measurement point for signal Validity_Initial_Heading of frame RT_SB_Trig_Initial_Condition (794, 0x31A) */
/begin MEASUREMENT crt_PT_31a_Validity_Initial_Heading "signal Validity_Initial_Heading of frame RT_SB_Trig_Initial_Condition (794, 0x31A). Valid when bit is set, invalid when bit is clear. Valid when bit is set, invalid when bit is clear." UBYTE CONV_crt_PT_31a_Validity_Initial_Heading 0 0 0 1 ECU_ADDRESS 0x0000 /end MEASUREMENT
/begin COMPU_METHOD CONV_crt_PT_31a_Validity_Initial_Heading "Identity, real-world value is same as binary value" IDENTICAL "%1" "" /end COMPU_METHOD
/* Measurement point for signal Initial_Speed of frame RT_SB_Trig_Initial_Condition (794, 0x31A) */
/begin MEASUREMENT crt_PT_31a_Initial_Speed "signal Initial_Speed of frame RT_SB_Trig_Initial_Condition (794, 0x31A). Speed at start of triggered test Speed at start of triggered test" ULONG CONV_crt_PT_31a_Initial_Speed 0 0 0.0 1675.0 ECU_ADDRESS 0x0000 /end MEASUREMENT
/begin COMPU_METHOD CONV_crt_PT_31a_Initial_Speed "Linear scaling, used for variable crt_PT_31a_Initial_Speed, signal Initial_Speed" RAT_FUNC "%12" "m/s" COEFFS 0 -1 0.0 0 0 -1.0E-4 /end COMPU_METHOD
/* Measurement point for signal Initial_Heading of frame RT_SB_Trig_Initial_Condition (794, 0x31A) */
/begin MEASUREMENT crt_PT_31a_Initial_Heading "signal Initial_Heading of frame RT_SB_Trig_Initial_Condition (794, 0x31A). Heading (track) at start of triggered test Heading (track) at start of triggered test" SWORD CONV_crt_PT_31a_Initial_Heading 0 0 -180.0 180.0 ECU_ADDRESS 0x0000 /end MEASUREMENT
/begin COMPU_METHOD CONV_crt_PT_31a_Initial_Heading "Linear scaling, used for variable crt_PT_31a_Initial_Heading, signal Initial_Heading" RAT_FUNC "%6" "degrees" COEFFS 0 -1 0.0 0 0 -0.01 /end COMPU_METHOD
/* Measurement point for signal MFDD_Start_Threshold of frame RT_SB_Trig_Initial_Condition (794, 0x31A) */
/begin MEASUREMENT crt_PT_31a_MFDD_Start_Threshold "signal MFDD_Start_Threshold of frame RT_SB_Trig_Initial_Condition (794, 0x31A)" UBYTE CONV_crt_PT_31a_MFDD_Start_Threshold 0 0 0 100 ECU_ADDRESS 0x0000 /end MEASUREMENT
/begin COMPU_METHOD CONV_crt_PT_31a_MFDD_Start_Threshold "Identity, real-world value is same as binary value" IDENTICAL "%4" "%" /end COMPU_METHOD
/* Measurement point for signal MFDD_End_Threshold of frame RT_SB_Trig_Initial_Condition (794, 0x31A) */
/begin MEASUREMENT crt_PT_31a_MFDD_End_Threshold "signal MFDD_End_Threshold of frame RT_SB_Trig_Initial_Condition (794, 0x31A)" UBYTE CONV_crt_PT_31a_MFDD_End_Threshold 0 0 0 100 ECU_ADDRESS 0x0000 /end MEASUREMENT
/begin COMPU_METHOD CONV_crt_PT_31a_MFDD_End_Threshold "Identity, real-world value is same as binary value" IDENTICAL "%4" "%" /end COMPU_METHOD
/* Measurement point for signal Direct_Distance of frame RT_SB_Trig_Direct_Dist (9241890x, 0x8D0522x) */
/begin MEASUREMENT crt_PT_8d0522_Direct_Distance "signal Direct_Distance of frame RT_SB_Trig_Direct_Dist (9241890x, 0x8D0522x). Direct distance from start of test to current position" ULONG CONV_crt_PT_8d0522_Direct_Distance 0 0 0.0 4294970.0 ECU_ADDRESS 0x0000 /end MEASUREMENT
/begin COMPU_METHOD CONV_crt_PT_8d0522_Direct_Distance "Linear scaling, used for variable crt_PT_8d0522_Direct_Distance, signal Direct_Distance" RAT_FUNC "%12" "m" COEFFS 0 -1 0.0 0 0 -0.001 /end COMPU_METHOD
/* Measurement point for signal Path_Distance_2D of frame RT_SB_Trig_Direct_Dist (9241890x, 0x8D0522x) */
/begin MEASUREMENT crt_PT_8d0522_Path_Distance_2D "signal Path_Distance_2D of frame RT_SB_Trig_Direct_Dist (9241890x, 0x8D0522x). 2D path distance (horizontal components only)" ULONG CONV_crt_PT_8d0522_Path_Distance_2D 0 0 0.0 4294970.0 ECU_ADDRESS 0x0000 /end MEASUREMENT
/begin COMPU_METHOD CONV_crt_PT_8d0522_Path_Distance_2D "Linear scaling, used for variable crt_PT_8d0522_Path_Distance_2D, signal Path_Distance_2D" RAT_FUNC "%12" "m" COEFFS 0 -1 0.0 0 0 -0.001 /end COMPU_METHOD
/* Measurement point for signal Forward_Distance of frame RT_SB_Trig_Forward_Dist (9241634x, 0x8D0422x) */
/begin MEASUREMENT crt_PT_8d0422_Forward_Distance "signal Forward_Distance of frame RT_SB_Trig_Forward_Dist (9241634x, 0x8D0422x). Current forward distance from start of test in direction of initial heading at start of test" SLONG CONV_crt_PT_8d0422_Forward_Distance 0 0 -2147480.0 2147480.0 ECU_ADDRESS 0x0000 /end MEASUREMENT
/begin COMPU_METHOD CONV_crt_PT_8d0422_Forward_Distance "Linear scaling, used for variable crt_PT_8d0422_Forward_Distance, signal Forward_Distance" RAT_FUNC "%12" "m" COEFFS 0 -1 0.0 0 0 -0.001 /end COMPU_METHOD
/* Measurement point for signal Deviation_Distance of frame RT_SB_Trig_Forward_Dist (9241634x, 0x8D0422x) */
/begin MEASUREMENT crt_PT_8d0422_Deviation_Distance "signal Deviation_Distance of frame RT_SB_Trig_Forward_Dist (9241634x, 0x8D0422x). Current deviation distance from a line projected along the initial heading at start of test, +ve for deviation to the right." SLONG CONV_crt_PT_8d0422_Deviation_Distance 0 0 -2147480.0 2147480.0 ECU_ADDRESS 0x0000 /end MEASUREMENT
/begin COMPU_METHOD CONV_crt_PT_8d0422_Deviation_Distance "Linear scaling, used for variable crt_PT_8d0422_Deviation_Distance, signal Deviation_Distance" RAT_FUNC "%12" "m" COEFFS 0 -1 0.0 0 0 -0.001 /end COMPU_METHOD
/* Measurement point for signal Path_Distance_3D of frame RT_SB_Trig_Path_Dist (9241378x, 0x8D0322x) */
/begin MEASUREMENT crt_PT_8d0322_Path_Distance_3D "signal Path_Distance_3D of frame RT_SB_Trig_Path_Dist (9241378x, 0x8D0322x). 3D path distance" ULONG CONV_crt_PT_8d0322_Path_Distance_3D 0 0 0.0 4294970.0 ECU_ADDRESS 0x0000 /end MEASUREMENT
/begin COMPU_METHOD CONV_crt_PT_8d0322_Path_Distance_3D "Linear scaling, used for variable crt_PT_8d0322_Path_Distance_3D, signal Path_Distance_3D" RAT_FUNC "%12" "m" COEFFS 0 -1 0.0 0 0 -0.001 /end COMPU_METHOD
/* Measurement point for signal Validity_MFDD of frame RT_SB_Trig_Accel (9241122x, 0x8D0222x) */
/begin MEASUREMENT crt_PT_8d0222_Validity_MFDD "signal Validity_MFDD of frame RT_SB_Trig_Accel (9241122x, 0x8D0222x). Valid when bit is set, invalid when bit is clear." UBYTE CONV_crt_PT_8d0222_Validity_MFDD 0 0 0 1 ECU_ADDRESS 0x0000 /end MEASUREMENT
/begin COMPU_METHOD CONV_crt_PT_8d0222_Validity_MFDD "Identity, real-world value is same as binary value" IDENTICAL "%1" "" /end COMPU_METHOD
/* Measurement point for signal Validity_Average_Accel of frame RT_SB_Trig_Accel (9241122x, 0x8D0222x) */
/begin MEASUREMENT crt_PT_8d0222_Validity_Average_Accel "signal Validity_Average_Accel of frame RT_SB_Trig_Accel (9241122x, 0x8D0222x). Valid when bit is set, invalid when bit is clear." UBYTE CONV_crt_PT_8d0222_Validity_Average_Accel 0 0 0 1 ECU_ADDRESS 0x0000 /end MEASUREMENT
/begin COMPU_METHOD CONV_crt_PT_8d0222_Validity_Average_Accel "Identity, real-world value is same as binary value" IDENTICAL "%1" "" /end COMPU_METHOD
/* Measurement point for signal Validity_Triggered_Time of frame RT_SB_Trig_Accel (9241122x, 0x8D0222x) */
/begin MEASUREMENT crt_PT_8d0222_Validity_Triggered_Time "signal Validity_Triggered_Time of frame RT_SB_Trig_Accel (9241122x, 0x8D0222x). Valid when bit is set, invalid when bit is clear." UBYTE CONV_crt_PT_8d0222_Validity_Triggered_Time 0 0 0 1 ECU_ADDRESS 0x0000 /end MEASUREMENT
/begin COMPU_METHOD CONV_crt_PT_8d0222_Validity_Triggered_Time "Identity, real-world value is same as binary value" IDENTICAL "%1" "" /end COMPU_METHOD
/* Measurement point for signal MFDD of frame RT_SB_Trig_Accel (9241122x, 0x8D0222x) */
/begin MEASUREMENT crt_PT_8d0222_MFDD "signal MFDD of frame RT_SB_Trig_Accel (9241122x, 0x8D0222x). Mean fully-developed decelleration of triggered test.  Thresholds used are as set in the logger configuration." SWORD CONV_crt_PT_8d0222_MFDD 0 0 -65.0 65.0 ECU_ADDRESS 0x0000 /end MEASUREMENT
/begin COMPU_METHOD CONV_crt_PT_8d0222_MFDD "Linear scaling, used for variable crt_PT_8d0222_MFDD, signal MFDD" RAT_FUNC "%6" "g" COEFFS 0 -1 0.0 0 0 -0.001 /end COMPU_METHOD
/* Measurement point for signal Average_Accel of frame RT_SB_Trig_Accel (9241122x, 0x8D0222x) */
/begin MEASUREMENT crt_PT_8d0222_Average_Accel "signal Average_Accel of frame RT_SB_Trig_Accel (9241122x, 0x8D0222x). Average acceleration from start of triggered test to current time." SWORD CONV_crt_PT_8d0222_Average_Accel 0 0 -65.0 65.0 ECU_ADDRESS 0x0000 /end MEASUREMENT
/begin COMPU_METHOD CONV_crt_PT_8d0222_Average_Accel "Linear scaling, used for variable crt_PT_8d0222_Average_Accel, signal Average_Accel" RAT_FUNC "%6" "g" COEFFS 0 -1 0.0 0 0 -0.001 /end COMPU_METHOD
/* Measurement point for signal Triggered_Time of frame RT_SB_Trig_Accel (9241122x, 0x8D0222x) */
/begin MEASUREMENT crt_PT_8d0222_Triggered_Time "signal Triggered_Time of frame RT_SB_Trig_Accel (9241122x, 0x8D0222x). Cumulative time from start of triggered test to current time." ULONG CONV_crt_PT_8d0222_Triggered_Time 0 0 0.0 167772.0 ECU_ADDRESS 0x0000 /end MEASUREMENT
/begin COMPU_METHOD CONV_crt_PT_8d0222_Triggered_Time "Linear scaling, used for variable crt_PT_8d0222_Triggered_Time, signal Triggered_Time" RAT_FUNC "%12" "s" COEFFS 0 -1 0.0 0 0 -0.01 /end COMPU_METHOD
/* Measurement point for signal Measured_Time_12 of frame RT_DL1MK3_Measure_Time_12 (9833508x, 0x960C24x) */
/begin MEASUREMENT crt_PT_960c24_Measured_Time_12 "signal Measured_Time_12 of frame RT_DL1MK3_Measure_Time_12 (9833508x, 0x960C24x)" ULONG CONV_crt_PT_960c24_Measured_Time_12 0 0 0 0 ECU_ADDRESS 0x0000 /end MEASUREMENT
/begin COMPU_METHOD CONV_crt_PT_960c24_Measured_Time_12 "Identity, real-world value is same as binary value" IDENTICAL "%12" "" /end COMPU_METHOD
/* Measurement point for signal Measured_Time_11 of frame RT_DL1MK3_Measure_Time_11 (9833252x, 0x960B24x) */
/begin MEASUREMENT crt_PT_960b24_Measured_Time_11 "signal Measured_Time_11 of frame RT_DL1MK3_Measure_Time_11 (9833252x, 0x960B24x)" ULONG CONV_crt_PT_960b24_Measured_Time_11 0 0 0 0 ECU_ADDRESS 0x0000 /end MEASUREMENT
/begin COMPU_METHOD CONV_crt_PT_960b24_Measured_Time_11 "Identity, real-world value is same as binary value" IDENTICAL "%12" "" /end COMPU_METHOD
/* Measurement point for signal Measured_Time_10 of frame RT_DL1MK3_Measure_Time_10 (9832996x, 0x960A24x) */
/begin MEASUREMENT crt_PT_960a24_Measured_Time_10 "signal Measured_Time_10 of frame RT_DL1MK3_Measure_Time_10 (9832996x, 0x960A24x)" ULONG CONV_crt_PT_960a24_Measured_Time_10 0 0 0 0 ECU_ADDRESS 0x0000 /end MEASUREMENT
/begin COMPU_METHOD CONV_crt_PT_960a24_Measured_Time_10 "Identity, real-world value is same as binary value" IDENTICAL "%12" "" /end COMPU_METHOD
/* Measurement point for signal Measured_Time_9 of frame RT_DL1MK3_Measure_Time_9 (9832740x, 0x960924x) */
/begin MEASUREMENT crt_PT_960924_Measured_Time_9 "signal Measured_Time_9 of frame RT_DL1MK3_Measure_Time_9 (9832740x, 0x960924x)" ULONG CONV_crt_PT_960924_Measured_Time_9 0 0 0 0 ECU_ADDRESS 0x0000 /end MEASUREMENT
/begin COMPU_METHOD CONV_crt_PT_960924_Measured_Time_9 "Identity, real-world value is same as binary value" IDENTICAL "%12" "" /end COMPU_METHOD
/* Measurement point for signal Measured_Time_8 of frame RT_DL1MK3_Measure_Time_8 (9832484x, 0x960824x) */
/begin MEASUREMENT crt_PT_960824_Measured_Time_8 "signal Measured_Time_8 of frame RT_DL1MK3_Measure_Time_8 (9832484x, 0x960824x)" ULONG CONV_crt_PT_960824_Measured_Time_8 0 0 0 0 ECU_ADDRESS 0x0000 /end MEASUREMENT
/begin COMPU_METHOD CONV_crt_PT_960824_Measured_Time_8 "Identity, real-world value is same as binary value" IDENTICAL "%12" "" /end COMPU_METHOD
/* Measurement point for signal Measured_Time_7 of frame RT_DL1MK3_Measure_Time_7 (9832228x, 0x960724x) */
/begin MEASUREMENT crt_PT_960724_Measured_Time_7 "signal Measured_Time_7 of frame RT_DL1MK3_Measure_Time_7 (9832228x, 0x960724x)" ULONG CONV_crt_PT_960724_Measured_Time_7 0 0 0 0 ECU_ADDRESS 0x0000 /end MEASUREMENT
/begin COMPU_METHOD CONV_crt_PT_960724_Measured_Time_7 "Identity, real-world value is same as binary value" IDENTICAL "%12" "" /end COMPU_METHOD
/* Measurement point for signal Measured_Time_6 of frame RT_DL1MK3_Measure_Time_6 (9831972x, 0x960624x) */
/begin MEASUREMENT crt_PT_960624_Measured_Time_6 "signal Measured_Time_6 of frame RT_DL1MK3_Measure_Time_6 (9831972x, 0x960624x)" ULONG CONV_crt_PT_960624_Measured_Time_6 0 0 0 0 ECU_ADDRESS 0x0000 /end MEASUREMENT
/begin COMPU_METHOD CONV_crt_PT_960624_Measured_Time_6 "Identity, real-world value is same as binary value" IDENTICAL "%12" "" /end COMPU_METHOD
/* Measurement point for signal Measured_Time_5 of frame RT_DL1MK3_Measure_Time_5 (9831716x, 0x960524x) */
/begin MEASUREMENT crt_PT_960524_Measured_Time_5 "signal Measured_Time_5 of frame RT_DL1MK3_Measure_Time_5 (9831716x, 0x960524x)" ULONG CONV_crt_PT_960524_Measured_Time_5 0 0 0 0 ECU_ADDRESS 0x0000 /end MEASUREMENT
/begin COMPU_METHOD CONV_crt_PT_960524_Measured_Time_5 "Identity, real-world value is same as binary value" IDENTICAL "%12" "" /end COMPU_METHOD
/* Measurement point for signal Measured_Time_4 of frame RT_DL1MK3_Measure_Time_4 (9831460x, 0x960424x) */
/begin MEASUREMENT crt_PT_960424_Measured_Time_4 "signal Measured_Time_4 of frame RT_DL1MK3_Measure_Time_4 (9831460x, 0x960424x)" ULONG CONV_crt_PT_960424_Measured_Time_4 0 0 0 0 ECU_ADDRESS 0x0000 /end MEASUREMENT
/begin COMPU_METHOD CONV_crt_PT_960424_Measured_Time_4 "Identity, real-world value is same as binary value" IDENTICAL "%12" "" /end COMPU_METHOD
/* Measurement point for signal Measured_Time_3 of frame RT_DL1MK3_Measure_Time_3 (9831204x, 0x960324x) */
/begin MEASUREMENT crt_PT_960324_Measured_Time_3 "signal Measured_Time_3 of frame RT_DL1MK3_Measure_Time_3 (9831204x, 0x960324x)" ULONG CONV_crt_PT_960324_Measured_Time_3 0 0 0 0 ECU_ADDRESS 0x0000 /end MEASUREMENT
/begin COMPU_METHOD CONV_crt_PT_960324_Measured_Time_3 "Identity, real-world value is same as binary value" IDENTICAL "%12" "" /end COMPU_METHOD
/* Measurement point for signal Measured_Time_2 of frame RT_DL1MK3_Measure_Time_2 (9830948x, 0x960224x) */
/begin MEASUREMENT crt_PT_960224_Measured_Time_2 "signal Measured_Time_2 of frame RT_DL1MK3_Measure_Time_2 (9830948x, 0x960224x)" ULONG CONV_crt_PT_960224_Measured_Time_2 0 0 0 0 ECU_ADDRESS 0x0000 /end MEASUREMENT
/begin COMPU_METHOD CONV_crt_PT_960224_Measured_Time_2 "Identity, real-world value is same as binary value" IDENTICAL "%12" "" /end COMPU_METHOD
/* Measurement point for signal Measured_Time_1 of frame RT_DL1MK3_Measure_Time_1 (9830692x, 0x960124x) */
/begin MEASUREMENT crt_PT_960124_Measured_Time_1 "signal Measured_Time_1 of frame RT_DL1MK3_Measure_Time_1 (9830692x, 0x960124x)" ULONG CONV_crt_PT_960124_Measured_Time_1 0 0 0 0 ECU_ADDRESS 0x0000 /end MEASUREMENT
/begin COMPU_METHOD CONV_crt_PT_960124_Measured_Time_1 "Identity, real-world value is same as binary value" IDENTICAL "%12" "" /end COMPU_METHOD
/* Measurement point for signal RPM of frame RT_DL1MK3_RPM (9767972x, 0x950C24x) */
/begin MEASUREMENT crt_PT_950c24_RPM "signal RPM of frame RT_DL1MK3_RPM (9767972x, 0x950C24x)" UWORD CONV_crt_PT_950c24_RPM 0 0 0 0 ECU_ADDRESS 0x0000 /end MEASUREMENT
/begin COMPU_METHOD CONV_crt_PT_950c24_RPM "Identity, real-world value is same as binary value" IDENTICAL "%6" "" /end COMPU_METHOD
/* Measurement point for signal Frequency_4 of frame RT_DL1MK3_Freq_4 (9767716x, 0x950B24x) */
/begin MEASUREMENT crt_PT_950b24_Frequency_4 "signal Frequency_4 of frame RT_DL1MK3_Freq_4 (9767716x, 0x950B24x)" UWORD CONV_crt_PT_950b24_Frequency_4 0 0 0.0 0.0 ECU_ADDRESS 0x0000 /end MEASUREMENT
/begin COMPU_METHOD CONV_crt_PT_950b24_Frequency_4 "Linear scaling, used for variable crt_PT_950b24_Frequency_4, signal Frequency_4" RAT_FUNC "%6" "" COEFFS 0 -1 0.0 0 0 -0.1 /end COMPU_METHOD
/* Measurement point for signal Frequency_3 of frame RT_DL1MK3_Freq_3 (9767460x, 0x950A24x) */
/begin MEASUREMENT crt_PT_950a24_Frequency_3 "signal Frequency_3 of frame RT_DL1MK3_Freq_3 (9767460x, 0x950A24x)" UWORD CONV_crt_PT_950a24_Frequency_3 0 0 0.0 0.0 ECU_ADDRESS 0x0000 /end MEASUREMENT
/begin COMPU_METHOD CONV_crt_PT_950a24_Frequency_3 "Linear scaling, used for variable crt_PT_950a24_Frequency_3, signal Frequency_3" RAT_FUNC "%6" "" COEFFS 0 -1 0.0 0 0 -0.1 /end COMPU_METHOD
/* Measurement point for signal Frequency_2 of frame RT_DL1MK3_Freq_2 (9767204x, 0x950924x) */
/begin MEASUREMENT crt_PT_950924_Frequency_2 "signal Frequency_2 of frame RT_DL1MK3_Freq_2 (9767204x, 0x950924x)" UWORD CONV_crt_PT_950924_Frequency_2 0 0 0.0 0.0 ECU_ADDRESS 0x0000 /end MEASUREMENT
/begin COMPU_METHOD CONV_crt_PT_950924_Frequency_2 "Linear scaling, used for variable crt_PT_950924_Frequency_2, signal Frequency_2" RAT_FUNC "%6" "" COEFFS 0 -1 0.0 0 0 -0.1 /end COMPU_METHOD
/* Measurement point for signal Misc_3 of frame RT_DL1MK3_Misc_3 (9896740x, 0x970324x) */
/begin MEASUREMENT crt_PT_970324_Misc_3 "signal Misc_3 of frame RT_DL1MK3_Misc_3 (9896740x, 0x970324x)" UWORD CONV_crt_PT_970324_Misc_3 0 0 0.0 0.0 ECU_ADDRESS 0x0000 /end MEASUREMENT
/begin COMPU_METHOD CONV_crt_PT_970324_Misc_3 "Linear scaling, used for variable crt_PT_970324_Misc_3, signal Misc_3" RAT_FUNC "%6" "" COEFFS 0 -1 0.0 0 0 -0.001 /end COMPU_METHOD
/* Measurement point for signal Misc_2 of frame RT_DL1MK3_Misc_2 (9896484x, 0x970224x) */
/begin MEASUREMENT crt_PT_970224_Misc_2 "signal Misc_2 of frame RT_DL1MK3_Misc_2 (9896484x, 0x970224x)" UWORD CONV_crt_PT_970224_Misc_2 0 0 0.0 0.0 ECU_ADDRESS 0x0000 /end MEASUREMENT
/begin COMPU_METHOD CONV_crt_PT_970224_Misc_2 "Linear scaling, used for variable crt_PT_970224_Misc_2, signal Misc_2" RAT_FUNC "%6" "" COEFFS 0 -1 0.0 0 0 -0.001 /end COMPU_METHOD
/* Measurement point for signal Misc_1 of frame RT_DL1MK3_Misc_1 (9896228x, 0x970124x) */
/begin MEASUREMENT crt_PT_970124_Misc_1 "signal Misc_1 of frame RT_DL1MK3_Misc_1 (9896228x, 0x970124x)" UWORD CONV_crt_PT_970124_Misc_1 0 0 0.0 0.0 ECU_ADDRESS 0x0000 /end MEASUREMENT
/begin COMPU_METHOD CONV_crt_PT_970124_Misc_1 "Linear scaling, used for variable crt_PT_970124_Misc_1, signal Misc_1" RAT_FUNC "%6" "" COEFFS 0 -1 0.0 0 0 -0.001 /end COMPU_METHOD
/* Measurement point for signal AUX_31 of frame RT_DL1MK3_Aux_31 (9707300x, 0x941F24x) */
/begin MEASUREMENT crt_PT_941f24_AUX_31 "signal AUX_31 of frame RT_DL1MK3_Aux_31 (9707300x, 0x941F24x)" UWORD CONV_crt_PT_941f24_AUX_31 0 0 0.0 0.0 ECU_ADDRESS 0x0000 /end MEASUREMENT
/begin COMPU_METHOD CONV_crt_PT_941f24_AUX_31 "Linear scaling, used for variable crt_PT_941f24_AUX_31, signal AUX_31" RAT_FUNC "%6" "" COEFFS 0 -1 0.0 0 0 -0.1 /end COMPU_METHOD
/* Measurement point for signal AUX_30 of frame RT_DL1MK3_Aux_30 (9707044x, 0x941E24x) */
/begin MEASUREMENT crt_PT_941e24_AUX_30 "signal AUX_30 of frame RT_DL1MK3_Aux_30 (9707044x, 0x941E24x)" UWORD CONV_crt_PT_941e24_AUX_30 0 0 0.0 0.0 ECU_ADDRESS 0x0000 /end MEASUREMENT
/begin COMPU_METHOD CONV_crt_PT_941e24_AUX_30 "Linear scaling, used for variable crt_PT_941e24_AUX_30, signal AUX_30" RAT_FUNC "%6" "" COEFFS 0 -1 0.0 0 0 -0.1 /end COMPU_METHOD
/* Measurement point for signal AUX_29 of frame RT_DL1MK3_Aux_29 (9706788x, 0x941D24x) */
/begin MEASUREMENT crt_PT_941d24_AUX_29 "signal AUX_29 of frame RT_DL1MK3_Aux_29 (9706788x, 0x941D24x)" UWORD CONV_crt_PT_941d24_AUX_29 0 0 0.0 0.0 ECU_ADDRESS 0x0000 /end MEASUREMENT
/begin COMPU_METHOD CONV_crt_PT_941d24_AUX_29 "Linear scaling, used for variable crt_PT_941d24_AUX_29, signal AUX_29" RAT_FUNC "%6" "" COEFFS 0 -1 0.0 0 0 -0.1 /end COMPU_METHOD
/* Measurement point for signal AUX_28 of frame RT_DL1MK3_Aux_28 (9706532x, 0x941C24x) */
/begin MEASUREMENT crt_PT_941c24_AUX_28 "signal AUX_28 of frame RT_DL1MK3_Aux_28 (9706532x, 0x941C24x)" UWORD CONV_crt_PT_941c24_AUX_28 0 0 0.0 0.0 ECU_ADDRESS 0x0000 /end MEASUREMENT
/begin COMPU_METHOD CONV_crt_PT_941c24_AUX_28 "Linear scaling, used for variable crt_PT_941c24_AUX_28, signal AUX_28" RAT_FUNC "%6" "" COEFFS 0 -1 0.0 0 0 -0.1 /end COMPU_METHOD
/* Measurement point for signal AUX_27 of frame RT_DL1MK3_Aux_27 (9706276x, 0x941B24x) */
/begin MEASUREMENT crt_PT_941b24_AUX_27 "signal AUX_27 of frame RT_DL1MK3_Aux_27 (9706276x, 0x941B24x)" UWORD CONV_crt_PT_941b24_AUX_27 0 0 0.0 0.0 ECU_ADDRESS 0x0000 /end MEASUREMENT
/begin COMPU_METHOD CONV_crt_PT_941b24_AUX_27 "Linear scaling, used for variable crt_PT_941b24_AUX_27, signal AUX_27" RAT_FUNC "%6" "" COEFFS 0 -1 0.0 0 0 -0.1 /end COMPU_METHOD
/* Measurement point for signal AUX_26 of frame RT_DL1MK3_Aux_26 (9706020x, 0x941A24x) */
/begin MEASUREMENT crt_PT_941a24_AUX_26 "signal AUX_26 of frame RT_DL1MK3_Aux_26 (9706020x, 0x941A24x)" UWORD CONV_crt_PT_941a24_AUX_26 0 0 0.0 0.0 ECU_ADDRESS 0x0000 /end MEASUREMENT
/begin COMPU_METHOD CONV_crt_PT_941a24_AUX_26 "Linear scaling, used for variable crt_PT_941a24_AUX_26, signal AUX_26" RAT_FUNC "%6" "" COEFFS 0 -1 0.0 0 0 -0.1 /end COMPU_METHOD
/* Measurement point for signal AUX_25 of frame RT_DL1MK3_Aux_25 (9705764x, 0x941924x) */
/begin MEASUREMENT crt_PT_941924_AUX_25 "signal AUX_25 of frame RT_DL1MK3_Aux_25 (9705764x, 0x941924x)" UWORD CONV_crt_PT_941924_AUX_25 0 0 0.0 0.0 ECU_ADDRESS 0x0000 /end MEASUREMENT
/begin COMPU_METHOD CONV_crt_PT_941924_AUX_25 "Linear scaling, used for variable crt_PT_941924_AUX_25, signal AUX_25" RAT_FUNC "%6" "" COEFFS 0 -1 0.0 0 0 -0.1 /end COMPU_METHOD
/* Measurement point for signal AUX_24 of frame RT_DL1MK3_Aux_24 (9705508x, 0x941824x) */
/begin MEASUREMENT crt_PT_941824_AUX_24 "signal AUX_24 of frame RT_DL1MK3_Aux_24 (9705508x, 0x941824x)" UWORD CONV_crt_PT_941824_AUX_24 0 0 0.0 0.0 ECU_ADDRESS 0x0000 /end MEASUREMENT
/begin COMPU_METHOD CONV_crt_PT_941824_AUX_24 "Linear scaling, used for variable crt_PT_941824_AUX_24, signal AUX_24" RAT_FUNC "%6" "" COEFFS 0 -1 0.0 0 0 -0.1 /end COMPU_METHOD
/* Measurement point for signal AUX_23 of frame RT_DL1MK3_Aux_23 (9705252x, 0x941724x) */
/begin MEASUREMENT crt_PT_941724_AUX_23 "signal AUX_23 of frame RT_DL1MK3_Aux_23 (9705252x, 0x941724x)" UWORD CONV_crt_PT_941724_AUX_23 0 0 0.0 0.0 ECU_ADDRESS 0x0000 /end MEASUREMENT
/begin COMPU_METHOD CONV_crt_PT_941724_AUX_23 "Linear scaling, used for variable crt_PT_941724_AUX_23, signal AUX_23" RAT_FUNC "%6" "" COEFFS 0 -1 0.0 0 0 -0.1 /end COMPU_METHOD
/* Measurement point for signal AUX_22 of frame RT_DL1MK3_Aux_22 (9704996x, 0x941624x) */
/begin MEASUREMENT crt_PT_941624_AUX_22 "signal AUX_22 of frame RT_DL1MK3_Aux_22 (9704996x, 0x941624x)" UWORD CONV_crt_PT_941624_AUX_22 0 0 0.0 0.0 ECU_ADDRESS 0x0000 /end MEASUREMENT
/begin COMPU_METHOD CONV_crt_PT_941624_AUX_22 "Linear scaling, used for variable crt_PT_941624_AUX_22, signal AUX_22" RAT_FUNC "%6" "" COEFFS 0 -1 0.0 0 0 -10.0 /end COMPU_METHOD
/* Measurement point for signal AUX_21 of frame RT_DL1MK3_Aux_21 (9704740x, 0x941524x) */
/begin MEASUREMENT crt_PT_941524_AUX_21 "signal AUX_21 of frame RT_DL1MK3_Aux_21 (9704740x, 0x941524x)" UWORD CONV_crt_PT_941524_AUX_21 0 0 0.0 0.0 ECU_ADDRESS 0x0000 /end MEASUREMENT
/begin COMPU_METHOD CONV_crt_PT_941524_AUX_21 "Linear scaling, used for variable crt_PT_941524_AUX_21, signal AUX_21" RAT_FUNC "%6" "" COEFFS 0 -1 0.0 0 0 -0.1 /end COMPU_METHOD
/* Measurement point for signal AUX_20 of frame RT_DL1MK3_Aux_20 (9704484x, 0x941424x) */
/begin MEASUREMENT crt_PT_941424_AUX_20 "signal AUX_20 of frame RT_DL1MK3_Aux_20 (9704484x, 0x941424x)" UWORD CONV_crt_PT_941424_AUX_20 0 0 0.0 0.0 ECU_ADDRESS 0x0000 /end MEASUREMENT
/begin COMPU_METHOD CONV_crt_PT_941424_AUX_20 "Linear scaling, used for variable crt_PT_941424_AUX_20, signal AUX_20" RAT_FUNC "%6" "" COEFFS 0 -1 0.0 0 0 -0.1 /end COMPU_METHOD
/* Measurement point for signal AUX_19 of frame RT_DL1MK3_Aux_19 (9704228x, 0x941324x) */
/begin MEASUREMENT crt_PT_941324_AUX_19 "signal AUX_19 of frame RT_DL1MK3_Aux_19 (9704228x, 0x941324x)" UWORD CONV_crt_PT_941324_AUX_19 0 0 0.0 0.0 ECU_ADDRESS 0x0000 /end MEASUREMENT
/begin COMPU_METHOD CONV_crt_PT_941324_AUX_19 "Linear scaling, used for variable crt_PT_941324_AUX_19, signal AUX_19" RAT_FUNC "%6" "" COEFFS 0 -1 0.0 0 0 -0.1 /end COMPU_METHOD
/* Measurement point for signal AUX_18 of frame RT_DL1MK3_Aux_18 (9703972x, 0x941224x) */
/begin MEASUREMENT crt_PT_941224_AUX_18 "signal AUX_18 of frame RT_DL1MK3_Aux_18 (9703972x, 0x941224x)" UWORD CONV_crt_PT_941224_AUX_18 0 0 0.0 0.0 ECU_ADDRESS 0x0000 /end MEASUREMENT
/begin COMPU_METHOD CONV_crt_PT_941224_AUX_18 "Linear scaling, used for variable crt_PT_941224_AUX_18, signal AUX_18" RAT_FUNC "%6" "" COEFFS 0 -1 0.0 0 0 -0.1 /end COMPU_METHOD
/* Measurement point for signal AUX_17 of frame RT_DL1MK3_Aux_17 (9703716x, 0x941124x) */
/begin MEASUREMENT crt_PT_941124_AUX_17 "signal AUX_17 of frame RT_DL1MK3_Aux_17 (9703716x, 0x941124x)" UWORD CONV_crt_PT_941124_AUX_17 0 0 0.0 0.0 ECU_ADDRESS 0x0000 /end MEASUREMENT
/begin COMPU_METHOD CONV_crt_PT_941124_AUX_17 "Linear scaling, used for variable crt_PT_941124_AUX_17, signal AUX_17" RAT_FUNC "%6" "" COEFFS 0 -1 0.0 0 0 -0.1 /end COMPU_METHOD
/* Measurement point for signal AUX_16 of frame RT_DL1MK3_Aux_16 (9703460x, 0x941024x) */
/begin MEASUREMENT crt_PT_941024_AUX_16 "signal AUX_16 of frame RT_DL1MK3_Aux_16 (9703460x, 0x941024x)" UWORD CONV_crt_PT_941024_AUX_16 0 0 0.0 0.0 ECU_ADDRESS 0x0000 /end MEASUREMENT
/begin COMPU_METHOD CONV_crt_PT_941024_AUX_16 "Linear scaling, used for variable crt_PT_941024_AUX_16, signal AUX_16" RAT_FUNC "%6" "" COEFFS 0 -1 0.0 0 0 -0.1 /end COMPU_METHOD
/* Measurement point for signal AUX_15 of frame RT_DL1MK3_Aux_15 (9703204x, 0x940F24x) */
/begin MEASUREMENT crt_PT_940f24_AUX_15 "signal AUX_15 of frame RT_DL1MK3_Aux_15 (9703204x, 0x940F24x)" UWORD CONV_crt_PT_940f24_AUX_15 0 0 0.0 0.0 ECU_ADDRESS 0x0000 /end MEASUREMENT
/begin COMPU_METHOD CONV_crt_PT_940f24_AUX_15 "Linear scaling, used for variable crt_PT_940f24_AUX_15, signal AUX_15" RAT_FUNC "%6" "" COEFFS 0 -1 0.0 0 0 -0.1 /end COMPU_METHOD
/* Measurement point for signal AUX_14 of frame RT_DL1MK3_Aux_14 (9702948x, 0x940E24x) */
/begin MEASUREMENT crt_PT_940e24_AUX_14 "signal AUX_14 of frame RT_DL1MK3_Aux_14 (9702948x, 0x940E24x)" UWORD CONV_crt_PT_940e24_AUX_14 0 0 0.0 0.0 ECU_ADDRESS 0x0000 /end MEASUREMENT
/begin COMPU_METHOD CONV_crt_PT_940e24_AUX_14 "Linear scaling, used for variable crt_PT_940e24_AUX_14, signal AUX_14" RAT_FUNC "%6" "" COEFFS 0 -1 0.0 0 0 -0.1 /end COMPU_METHOD
/* Measurement point for signal AUX_13 of frame RT_DL1MK3_Aux_13 (9702692x, 0x940D24x) */
/begin MEASUREMENT crt_PT_940d24_AUX_13 "signal AUX_13 of frame RT_DL1MK3_Aux_13 (9702692x, 0x940D24x)" UWORD CONV_crt_PT_940d24_AUX_13 0 0 0.0 0.0 ECU_ADDRESS 0x0000 /end MEASUREMENT
/begin COMPU_METHOD CONV_crt_PT_940d24_AUX_13 "Linear scaling, used for variable crt_PT_940d24_AUX_13, signal AUX_13" RAT_FUNC "%6" "" COEFFS 0 -1 0.0 0 0 -0.1 /end COMPU_METHOD
/* Measurement point for signal AUX_12 of frame RT_DL1MK3_Aux_12 (9702436x, 0x940C24x) */
/begin MEASUREMENT crt_PT_940c24_AUX_12 "signal AUX_12 of frame RT_DL1MK3_Aux_12 (9702436x, 0x940C24x)" UWORD CONV_crt_PT_940c24_AUX_12 0 0 0.0 0.0 ECU_ADDRESS 0x0000 /end MEASUREMENT
/begin COMPU_METHOD CONV_crt_PT_940c24_AUX_12 "Linear scaling, used for variable crt_PT_940c24_AUX_12, signal AUX_12" RAT_FUNC "%6" "" COEFFS 0 -1 0.0 0 0 -0.1 /end COMPU_METHOD
/* Measurement point for signal AUX_11 of frame RT_DL1MK3_Aux_11 (9702180x, 0x940B24x) */
/begin MEASUREMENT crt_PT_940b24_AUX_11 "signal AUX_11 of frame RT_DL1MK3_Aux_11 (9702180x, 0x940B24x)" UWORD CONV_crt_PT_940b24_AUX_11 0 0 0.0 0.0 ECU_ADDRESS 0x0000 /end MEASUREMENT
/begin COMPU_METHOD CONV_crt_PT_940b24_AUX_11 "Linear scaling, used for variable crt_PT_940b24_AUX_11, signal AUX_11" RAT_FUNC "%6" "" COEFFS 0 -1 0.0 0 0 -0.1 /end COMPU_METHOD
/* Measurement point for signal AUX_9 of frame RT_DL1MK3_Aux_9 (9701668x, 0x940924x) */
/begin MEASUREMENT crt_PT_940924_AUX_9 "signal AUX_9 of frame RT_DL1MK3_Aux_9 (9701668x, 0x940924x)" UWORD CONV_crt_PT_940924_AUX_9 0 0 0.0 0.0 ECU_ADDRESS 0x0000 /end MEASUREMENT
/begin COMPU_METHOD CONV_crt_PT_940924_AUX_9 "Linear scaling, used for variable crt_PT_940924_AUX_9, signal AUX_9" RAT_FUNC "%6" "" COEFFS 0 -1 0.0 0 0 -0.1 /end COMPU_METHOD
/* Measurement point for signal AUX_10 of frame RT_DL1MK3_Aux_10 (9701924x, 0x940A24x) */
/begin MEASUREMENT crt_PT_940a24_AUX_10 "signal AUX_10 of frame RT_DL1MK3_Aux_10 (9701924x, 0x940A24x)" UWORD CONV_crt_PT_940a24_AUX_10 0 0 0.0 0.0 ECU_ADDRESS 0x0000 /end MEASUREMENT
/begin COMPU_METHOD CONV_crt_PT_940a24_AUX_10 "Linear scaling, used for variable crt_PT_940a24_AUX_10, signal AUX_10" RAT_FUNC "%6" "" COEFFS 0 -1 0.0 0 0 -0.1 /end COMPU_METHOD
/* Measurement point for signal AUX_8 of frame RT_DL1MK3_Aux_8 (9701412x, 0x940824x) */
/begin MEASUREMENT crt_PT_940824_AUX_8 "signal AUX_8 of frame RT_DL1MK3_Aux_8 (9701412x, 0x940824x)" UWORD CONV_crt_PT_940824_AUX_8 0 0 0.0 0.0 ECU_ADDRESS 0x0000 /end MEASUREMENT
/begin COMPU_METHOD CONV_crt_PT_940824_AUX_8 "Linear scaling, used for variable crt_PT_940824_AUX_8, signal AUX_8" RAT_FUNC "%6" "" COEFFS 0 -1 0.0 0 0 -0.1 /end COMPU_METHOD
/* Measurement point for signal AUX_7 of frame RT_DL1MK3_Aux_7 (9701156x, 0x940724x) */
/begin MEASUREMENT crt_PT_940724_AUX_7 "signal AUX_7 of frame RT_DL1MK3_Aux_7 (9701156x, 0x940724x)" UWORD CONV_crt_PT_940724_AUX_7 0 0 0.0 0.0 ECU_ADDRESS 0x0000 /end MEASUREMENT
/begin COMPU_METHOD CONV_crt_PT_940724_AUX_7 "Linear scaling, used for variable crt_PT_940724_AUX_7, signal AUX_7" RAT_FUNC "%6" "" COEFFS 0 -1 0.0 0 0 -0.1 /end COMPU_METHOD
/* Measurement point for signal AUX_6 of frame RT_DL1MK3_Aux_6 (9700900x, 0x940624x) */
/begin MEASUREMENT crt_PT_940624_AUX_6 "signal AUX_6 of frame RT_DL1MK3_Aux_6 (9700900x, 0x940624x)" UWORD CONV_crt_PT_940624_AUX_6 0 0 0.0 0.0 ECU_ADDRESS 0x0000 /end MEASUREMENT
/begin COMPU_METHOD CONV_crt_PT_940624_AUX_6 "Linear scaling, used for variable crt_PT_940624_AUX_6, signal AUX_6" RAT_FUNC "%6" "" COEFFS 0 -1 0.0 0 0 -0.1 /end COMPU_METHOD
/* Measurement point for signal AUX_5 of frame RT_DL1MK3_Aux_5 (9700644x, 0x940524x) */
/begin MEASUREMENT crt_PT_940524_AUX_5 "signal AUX_5 of frame RT_DL1MK3_Aux_5 (9700644x, 0x940524x)" UWORD CONV_crt_PT_940524_AUX_5 0 0 0.0 0.0 ECU_ADDRESS 0x0000 /end MEASUREMENT
/begin COMPU_METHOD CONV_crt_PT_940524_AUX_5 "Linear scaling, used for variable crt_PT_940524_AUX_5, signal AUX_5" RAT_FUNC "%6" "" COEFFS 0 -1 0.0 0 0 -0.1 /end COMPU_METHOD
/* Measurement point for signal AUX_4 of frame RT_DL1MK3_Aux_4 (9700388x, 0x940424x) */
/begin MEASUREMENT crt_PT_940424_AUX_4 "signal AUX_4 of frame RT_DL1MK3_Aux_4 (9700388x, 0x940424x)" UWORD CONV_crt_PT_940424_AUX_4 0 0 0.0 0.0 ECU_ADDRESS 0x0000 /end MEASUREMENT
/begin COMPU_METHOD CONV_crt_PT_940424_AUX_4 "Linear scaling, used for variable crt_PT_940424_AUX_4, signal AUX_4" RAT_FUNC "%6" "" COEFFS 0 -1 0.0 0 0 -0.1 /end COMPU_METHOD
/* Measurement point for signal AUX_3 of frame RT_DL1MK3_Aux_3 (9700132x, 0x940324x) */
/begin MEASUREMENT crt_PT_940324_AUX_3 "signal AUX_3 of frame RT_DL1MK3_Aux_3 (9700132x, 0x940324x)" UWORD CONV_crt_PT_940324_AUX_3 0 0 0.0 0.0 ECU_ADDRESS 0x0000 /end MEASUREMENT
/begin COMPU_METHOD CONV_crt_PT_940324_AUX_3 "Linear scaling, used for variable crt_PT_940324_AUX_3, signal AUX_3" RAT_FUNC "%6" "" COEFFS 0 -1 0.0 0 0 -0.1 /end COMPU_METHOD
/* Measurement point for signal AUX_2 of frame RT_DL1MK3_Aux_2 (9699876x, 0x940224x) */
/begin MEASUREMENT crt_PT_940224_AUX_2 "signal AUX_2 of frame RT_DL1MK3_Aux_2 (9699876x, 0x940224x)" UWORD CONV_crt_PT_940224_AUX_2 0 0 0.0 0.0 ECU_ADDRESS 0x0000 /end MEASUREMENT
/begin COMPU_METHOD CONV_crt_PT_940224_AUX_2 "Linear scaling, used for variable crt_PT_940224_AUX_2, signal AUX_2" RAT_FUNC "%6" "" COEFFS 0 -1 0.0 0 0 -0.1 /end COMPU_METHOD
/* Measurement point for signal AUX_1 of frame RT_DL1MK3_Aux_1 (9699620x, 0x940124x) */
/begin MEASUREMENT crt_PT_940124_AUX_1 "signal AUX_1 of frame RT_DL1MK3_Aux_1 (9699620x, 0x940124x)" UWORD CONV_crt_PT_940124_AUX_1 0 0 0.0 0.0 ECU_ADDRESS 0x0000 /end MEASUREMENT
/begin COMPU_METHOD CONV_crt_PT_940124_AUX_1 "Linear scaling, used for variable crt_PT_940124_AUX_1, signal AUX_1" RAT_FUNC "%6" "" COEFFS 0 -1 0.0 0 0 -0.1 /end COMPU_METHOD
/* Measurement point for signal Pressure_5 of frame RT_DL1MK3_Pressure_5 (9438500x, 0x900524x) */
/begin MEASUREMENT crt_PT_900524_Pressure_5 "signal Pressure_5 of frame RT_DL1MK3_Pressure_5 (9438500x, 0x900524x)" ULONG CONV_crt_PT_900524_Pressure_5 0 0 0.0 0.0 ECU_ADDRESS 0x0000 /end MEASUREMENT
/begin COMPU_METHOD CONV_crt_PT_900524_Pressure_5 "Linear scaling, used for variable crt_PT_900524_Pressure_5, signal Pressure_5" RAT_FUNC "%12" "" COEFFS 0 -1 0.0 0 0 -0.1 /end COMPU_METHOD
/* Measurement point for signal Pressure_4 of frame RT_DL1MK3_Pressure_4 (9438244x, 0x900424x) */
/begin MEASUREMENT crt_PT_900424_Pressure_4 "signal Pressure_4 of frame RT_DL1MK3_Pressure_4 (9438244x, 0x900424x)" ULONG CONV_crt_PT_900424_Pressure_4 0 0 0.0 0.0 ECU_ADDRESS 0x0000 /end MEASUREMENT
/begin COMPU_METHOD CONV_crt_PT_900424_Pressure_4 "Linear scaling, used for variable crt_PT_900424_Pressure_4, signal Pressure_4" RAT_FUNC "%12" "" COEFFS 0 -1 0.0 0 0 -0.1 /end COMPU_METHOD
/* Measurement point for signal Pressure_3 of frame RT_DL1MK3_Pressure_3 (9437988x, 0x900324x) */
/begin MEASUREMENT crt_PT_900324_Pressure_3 "signal Pressure_3 of frame RT_DL1MK3_Pressure_3 (9437988x, 0x900324x)" ULONG CONV_crt_PT_900324_Pressure_3 0 0 0.0 0.0 ECU_ADDRESS 0x0000 /end MEASUREMENT
/begin COMPU_METHOD CONV_crt_PT_900324_Pressure_3 "Linear scaling, used for variable crt_PT_900324_Pressure_3, signal Pressure_3" RAT_FUNC "%12" "" COEFFS 0 -1 0.0 0 0 -0.1 /end COMPU_METHOD
/* Measurement point for signal Pressure_2 of frame RT_DL1MK3_Pressure_2 (9437732x, 0x900224x) */
/begin MEASUREMENT crt_PT_900224_Pressure_2 "signal Pressure_2 of frame RT_DL1MK3_Pressure_2 (9437732x, 0x900224x)" ULONG CONV_crt_PT_900224_Pressure_2 0 0 0.0 0.0 ECU_ADDRESS 0x0000 /end MEASUREMENT
/begin COMPU_METHOD CONV_crt_PT_900224_Pressure_2 "Linear scaling, used for variable crt_PT_900224_Pressure_2, signal Pressure_2" RAT_FUNC "%12" "" COEFFS 0 -1 0.0 0 0 -0.1 /end COMPU_METHOD
/* Measurement point for signal Pressure_1 of frame RT_DL1MK3_Pressure_1 (9437476x, 0x900124x) */
/begin MEASUREMENT crt_PT_900124_Pressure_1 "signal Pressure_1 of frame RT_DL1MK3_Pressure_1 (9437476x, 0x900124x)" ULONG CONV_crt_PT_900124_Pressure_1 0 0 0.0 0.0 ECU_ADDRESS 0x0000 /end MEASUREMENT
/begin COMPU_METHOD CONV_crt_PT_900124_Pressure_1 "Linear scaling, used for variable crt_PT_900124_Pressure_1, signal Pressure_1" RAT_FUNC "%12" "" COEFFS 0 -1 0.0 0 0 -0.1 /end COMPU_METHOD
/* Measurement point for signal Angle_3 of frame RT_DL1MK3_Angle_3 (9569060x, 0x920324x) */
/begin MEASUREMENT crt_PT_920324_Angle_3 "signal Angle_3 of frame RT_DL1MK3_Angle_3 (9569060x, 0x920324x)" SWORD CONV_crt_PT_920324_Angle_3 0 0 0.0 0.0 ECU_ADDRESS 0x0000 /end MEASUREMENT
/begin COMPU_METHOD CONV_crt_PT_920324_Angle_3 "Linear scaling, used for variable crt_PT_920324_Angle_3, signal Angle_3" RAT_FUNC "%6" "" COEFFS 0 -1 0.0 0 0 -0.1 /end COMPU_METHOD
/* Measurement point for signal Angle_2 of frame RT_DL1MK3_Angle_2 (9568804x, 0x920224x) */
/begin MEASUREMENT crt_PT_920224_Angle_2 "signal Angle_2 of frame RT_DL1MK3_Angle_2 (9568804x, 0x920224x)" SWORD CONV_crt_PT_920224_Angle_2 0 0 0.0 0.0 ECU_ADDRESS 0x0000 /end MEASUREMENT
/begin COMPU_METHOD CONV_crt_PT_920224_Angle_2 "Linear scaling, used for variable crt_PT_920224_Angle_2, signal Angle_2" RAT_FUNC "%6" "" COEFFS 0 -1 0.0 0 0 -0.1 /end COMPU_METHOD
/* Measurement point for signal Angle_1 of frame RT_DL1MK3_Angle_1 (9568548x, 0x920124x) */
/begin MEASUREMENT crt_PT_920124_Angle_1 "signal Angle_1 of frame RT_DL1MK3_Angle_1 (9568548x, 0x920124x)" SWORD CONV_crt_PT_920124_Angle_1 0 0 0.0 0.0 ECU_ADDRESS 0x0000 /end MEASUREMENT
/begin COMPU_METHOD CONV_crt_PT_920124_Angle_1 "Linear scaling, used for variable crt_PT_920124_Angle_1, signal Angle_1" RAT_FUNC "%6" "" COEFFS 0 -1 0.0 0 0 -0.1 /end COMPU_METHOD
/* Measurement point for signal Temperature_25 of frame RT_DL1MK3_Temp_25 (9509156x, 0x911924x) */
/begin MEASUREMENT crt_PT_911924_Temperature_25 "signal Temperature_25 of frame RT_DL1MK3_Temp_25 (9509156x, 0x911924x)" SWORD CONV_crt_PT_911924_Temperature_25 0 0 0.0 0.0 ECU_ADDRESS 0x0000 /end MEASUREMENT
/begin COMPU_METHOD CONV_crt_PT_911924_Temperature_25 "Linear scaling, used for variable crt_PT_911924_Temperature_25, signal Temperature_25" RAT_FUNC "%6" "" COEFFS 0 -1 0.0 0 0 -0.1 /end COMPU_METHOD
/* Measurement point for signal Temperature_24 of frame RT_DL1MK3_Temp_24 (9508900x, 0x911824x) */
/begin MEASUREMENT crt_PT_911824_Temperature_24 "signal Temperature_24 of frame RT_DL1MK3_Temp_24 (9508900x, 0x911824x)" SWORD CONV_crt_PT_911824_Temperature_24 0 0 0.0 0.0 ECU_ADDRESS 0x0000 /end MEASUREMENT
/begin COMPU_METHOD CONV_crt_PT_911824_Temperature_24 "Linear scaling, used for variable crt_PT_911824_Temperature_24, signal Temperature_24" RAT_FUNC "%6" "" COEFFS 0 -1 0.0 0 0 -0.1 /end COMPU_METHOD
/* Measurement point for signal Temperature_23 of frame RT_DL1MK3_Temp_23 (9508644x, 0x911724x) */
/begin MEASUREMENT crt_PT_911724_Temperature_23 "signal Temperature_23 of frame RT_DL1MK3_Temp_23 (9508644x, 0x911724x)" SWORD CONV_crt_PT_911724_Temperature_23 0 0 0.0 0.0 ECU_ADDRESS 0x0000 /end MEASUREMENT
/begin COMPU_METHOD CONV_crt_PT_911724_Temperature_23 "Linear scaling, used for variable crt_PT_911724_Temperature_23, signal Temperature_23" RAT_FUNC "%6" "" COEFFS 0 -1 0.0 0 0 -0.1 /end COMPU_METHOD
/* Measurement point for signal Temperature_22 of frame RT_DL1MK3_Temp_22 (9508388x, 0x911624x) */
/begin MEASUREMENT crt_PT_911624_Temperature_22 "signal Temperature_22 of frame RT_DL1MK3_Temp_22 (9508388x, 0x911624x)" SWORD CONV_crt_PT_911624_Temperature_22 0 0 0.0 0.0 ECU_ADDRESS 0x0000 /end MEASUREMENT
/begin COMPU_METHOD CONV_crt_PT_911624_Temperature_22 "Linear scaling, used for variable crt_PT_911624_Temperature_22, signal Temperature_22" RAT_FUNC "%6" "" COEFFS 0 -1 0.0 0 0 -0.1 /end COMPU_METHOD
/* Measurement point for signal Temperature_21 of frame RT_DL1MK3_Temp_21 (9508132x, 0x911524x) */
/begin MEASUREMENT crt_PT_911524_Temperature_21 "signal Temperature_21 of frame RT_DL1MK3_Temp_21 (9508132x, 0x911524x)" SWORD CONV_crt_PT_911524_Temperature_21 0 0 0.0 0.0 ECU_ADDRESS 0x0000 /end MEASUREMENT
/begin COMPU_METHOD CONV_crt_PT_911524_Temperature_21 "Linear scaling, used for variable crt_PT_911524_Temperature_21, signal Temperature_21" RAT_FUNC "%6" "" COEFFS 0 -1 0.0 0 0 -0.1 /end COMPU_METHOD
/* Measurement point for signal Temperature_20 of frame RT_DL1MK3_Temp_20 (9507876x, 0x911424x) */
/begin MEASUREMENT crt_PT_911424_Temperature_20 "signal Temperature_20 of frame RT_DL1MK3_Temp_20 (9507876x, 0x911424x)" SWORD CONV_crt_PT_911424_Temperature_20 0 0 0.0 0.0 ECU_ADDRESS 0x0000 /end MEASUREMENT
/begin COMPU_METHOD CONV_crt_PT_911424_Temperature_20 "Linear scaling, used for variable crt_PT_911424_Temperature_20, signal Temperature_20" RAT_FUNC "%6" "" COEFFS 0 -1 0.0 0 0 -0.1 /end COMPU_METHOD
/* Measurement point for signal Temperature_19 of frame RT_DL1MK3_Temp_19 (9507620x, 0x911324x) */
/begin MEASUREMENT crt_PT_911324_Temperature_19 "signal Temperature_19 of frame RT_DL1MK3_Temp_19 (9507620x, 0x911324x)" SWORD CONV_crt_PT_911324_Temperature_19 0 0 0.0 0.0 ECU_ADDRESS 0x0000 /end MEASUREMENT
/begin COMPU_METHOD CONV_crt_PT_911324_Temperature_19 "Linear scaling, used for variable crt_PT_911324_Temperature_19, signal Temperature_19" RAT_FUNC "%6" "" COEFFS 0 -1 0.0 0 0 -0.1 /end COMPU_METHOD
/* Measurement point for signal Temperature_18 of frame RT_DL1MK3_Temp_18 (9507364x, 0x911224x) */
/begin MEASUREMENT crt_PT_911224_Temperature_18 "signal Temperature_18 of frame RT_DL1MK3_Temp_18 (9507364x, 0x911224x)" SWORD CONV_crt_PT_911224_Temperature_18 0 0 0.0 0.0 ECU_ADDRESS 0x0000 /end MEASUREMENT
/begin COMPU_METHOD CONV_crt_PT_911224_Temperature_18 "Linear scaling, used for variable crt_PT_911224_Temperature_18, signal Temperature_18" RAT_FUNC "%6" "" COEFFS 0 -1 0.0 0 0 -0.1 /end COMPU_METHOD
/* Measurement point for signal Temperature_17 of frame RT_DL1MK3_Temp_17 (9507108x, 0x911124x) */
/begin MEASUREMENT crt_PT_911124_Temperature_17 "signal Temperature_17 of frame RT_DL1MK3_Temp_17 (9507108x, 0x911124x)" SWORD CONV_crt_PT_911124_Temperature_17 0 0 0.0 0.0 ECU_ADDRESS 0x0000 /end MEASUREMENT
/begin COMPU_METHOD CONV_crt_PT_911124_Temperature_17 "Linear scaling, used for variable crt_PT_911124_Temperature_17, signal Temperature_17" RAT_FUNC "%6" "" COEFFS 0 -1 0.0 0 0 -0.1 /end COMPU_METHOD
/* Measurement point for signal Temperature_16 of frame RT_DL1MK3_Temp_16 (9506852x, 0x911024x) */
/begin MEASUREMENT crt_PT_911024_Temperature_16 "signal Temperature_16 of frame RT_DL1MK3_Temp_16 (9506852x, 0x911024x)" SWORD CONV_crt_PT_911024_Temperature_16 0 0 0.0 0.0 ECU_ADDRESS 0x0000 /end MEASUREMENT
/begin COMPU_METHOD CONV_crt_PT_911024_Temperature_16 "Linear scaling, used for variable crt_PT_911024_Temperature_16, signal Temperature_16" RAT_FUNC "%6" "" COEFFS 0 -1 0.0 0 0 -0.1 /end COMPU_METHOD
/* Measurement point for signal Temperature_15 of frame RT_DL1MK3_Temp_15 (9506596x, 0x910F24x) */
/begin MEASUREMENT crt_PT_910f24_Temperature_15 "signal Temperature_15 of frame RT_DL1MK3_Temp_15 (9506596x, 0x910F24x)" SWORD CONV_crt_PT_910f24_Temperature_15 0 0 0.0 0.0 ECU_ADDRESS 0x0000 /end MEASUREMENT
/begin COMPU_METHOD CONV_crt_PT_910f24_Temperature_15 "Linear scaling, used for variable crt_PT_910f24_Temperature_15, signal Temperature_15" RAT_FUNC "%6" "" COEFFS 0 -1 0.0 0 0 -0.1 /end COMPU_METHOD
/* Measurement point for signal Temperature_14 of frame RT_DL1MK3_Temp_14 (9506340x, 0x910E24x) */
/begin MEASUREMENT crt_PT_910e24_Temperature_14 "signal Temperature_14 of frame RT_DL1MK3_Temp_14 (9506340x, 0x910E24x)" SWORD CONV_crt_PT_910e24_Temperature_14 0 0 0.0 0.0 ECU_ADDRESS 0x0000 /end MEASUREMENT
/begin COMPU_METHOD CONV_crt_PT_910e24_Temperature_14 "Linear scaling, used for variable crt_PT_910e24_Temperature_14, signal Temperature_14" RAT_FUNC "%6" "" COEFFS 0 -1 0.0 0 0 -0.1 /end COMPU_METHOD
/* Measurement point for signal Temperature_13 of frame RT_DL1MK3_Temp_13 (9506084x, 0x910D24x) */
/begin MEASUREMENT crt_PT_910d24_Temperature_13 "signal Temperature_13 of frame RT_DL1MK3_Temp_13 (9506084x, 0x910D24x)" SWORD CONV_crt_PT_910d24_Temperature_13 0 0 0.0 0.0 ECU_ADDRESS 0x0000 /end MEASUREMENT
/begin COMPU_METHOD CONV_crt_PT_910d24_Temperature_13 "Linear scaling, used for variable crt_PT_910d24_Temperature_13, signal Temperature_13" RAT_FUNC "%6" "" COEFFS 0 -1 0.0 0 0 -0.1 /end COMPU_METHOD
/* Measurement point for signal Temperature_12 of frame RT_DL1MK3_Temp_12 (9505828x, 0x910C24x) */
/begin MEASUREMENT crt_PT_910c24_Temperature_12 "signal Temperature_12 of frame RT_DL1MK3_Temp_12 (9505828x, 0x910C24x)" SWORD CONV_crt_PT_910c24_Temperature_12 0 0 0.0 0.0 ECU_ADDRESS 0x0000 /end MEASUREMENT
/begin COMPU_METHOD CONV_crt_PT_910c24_Temperature_12 "Linear scaling, used for variable crt_PT_910c24_Temperature_12, signal Temperature_12" RAT_FUNC "%6" "" COEFFS 0 -1 0.0 0 0 -0.1 /end COMPU_METHOD
/* Measurement point for signal Temperature_11 of frame RT_DL1MK3_Temp_11 (9505572x, 0x910B24x) */
/begin MEASUREMENT crt_PT_910b24_Temperature_11 "signal Temperature_11 of frame RT_DL1MK3_Temp_11 (9505572x, 0x910B24x)" SWORD CONV_crt_PT_910b24_Temperature_11 0 0 0.0 0.0 ECU_ADDRESS 0x0000 /end MEASUREMENT
/begin COMPU_METHOD CONV_crt_PT_910b24_Temperature_11 "Linear scaling, used for variable crt_PT_910b24_Temperature_11, signal Temperature_11" RAT_FUNC "%6" "" COEFFS 0 -1 0.0 0 0 -0.1 /end COMPU_METHOD
/* Measurement point for signal Temperature_10 of frame RT_DL1MK3_Temp_10 (9505316x, 0x910A24x) */
/begin MEASUREMENT crt_PT_910a24_Temperature_10 "signal Temperature_10 of frame RT_DL1MK3_Temp_10 (9505316x, 0x910A24x)" SWORD CONV_crt_PT_910a24_Temperature_10 0 0 0.0 0.0 ECU_ADDRESS 0x0000 /end MEASUREMENT
/begin COMPU_METHOD CONV_crt_PT_910a24_Temperature_10 "Linear scaling, used for variable crt_PT_910a24_Temperature_10, signal Temperature_10" RAT_FUNC "%6" "" COEFFS 0 -1 0.0 0 0 -0.1 /end COMPU_METHOD
/* Measurement point for signal Temperature_9 of frame RT_DL1MK3_Temp_9 (9505060x, 0x910924x) */
/begin MEASUREMENT crt_PT_910924_Temperature_9 "signal Temperature_9 of frame RT_DL1MK3_Temp_9 (9505060x, 0x910924x)" SWORD CONV_crt_PT_910924_Temperature_9 0 0 0.0 0.0 ECU_ADDRESS 0x0000 /end MEASUREMENT
/begin COMPU_METHOD CONV_crt_PT_910924_Temperature_9 "Linear scaling, used for variable crt_PT_910924_Temperature_9, signal Temperature_9" RAT_FUNC "%6" "" COEFFS 0 -1 0.0 0 0 -0.1 /end COMPU_METHOD
/* Measurement point for signal Temperature_8 of frame RT_DL1MK3_Temp_8 (9504804x, 0x910824x) */
/begin MEASUREMENT crt_PT_910824_Temperature_8 "signal Temperature_8 of frame RT_DL1MK3_Temp_8 (9504804x, 0x910824x)" SWORD CONV_crt_PT_910824_Temperature_8 0 0 0.0 0.0 ECU_ADDRESS 0x0000 /end MEASUREMENT
/begin COMPU_METHOD CONV_crt_PT_910824_Temperature_8 "Linear scaling, used for variable crt_PT_910824_Temperature_8, signal Temperature_8" RAT_FUNC "%6" "" COEFFS 0 -1 0.0 0 0 -0.1 /end COMPU_METHOD
/* Measurement point for signal Temperature_7 of frame RT_DL1MK3_Temp_7 (9504548x, 0x910724x) */
/begin MEASUREMENT crt_PT_910724_Temperature_7 "signal Temperature_7 of frame RT_DL1MK3_Temp_7 (9504548x, 0x910724x)" SWORD CONV_crt_PT_910724_Temperature_7 0 0 0.0 0.0 ECU_ADDRESS 0x0000 /end MEASUREMENT
/begin COMPU_METHOD CONV_crt_PT_910724_Temperature_7 "Linear scaling, used for variable crt_PT_910724_Temperature_7, signal Temperature_7" RAT_FUNC "%6" "" COEFFS 0 -1 0.0 0 0 -0.1 /end COMPU_METHOD
/* Measurement point for signal Temperature_6 of frame RT_DL1MK3_Temp_6 (9504292x, 0x910624x) */
/begin MEASUREMENT crt_PT_910624_Temperature_6 "signal Temperature_6 of frame RT_DL1MK3_Temp_6 (9504292x, 0x910624x)" SWORD CONV_crt_PT_910624_Temperature_6 0 0 0.0 0.0 ECU_ADDRESS 0x0000 /end MEASUREMENT
/begin COMPU_METHOD CONV_crt_PT_910624_Temperature_6 "Linear scaling, used for variable crt_PT_910624_Temperature_6, signal Temperature_6" RAT_FUNC "%6" "" COEFFS 0 -1 0.0 0 0 -0.1 /end COMPU_METHOD
/* Measurement point for signal Temperature_5 of frame RT_DL1MK3_Temp_5 (9504036x, 0x910524x) */
/begin MEASUREMENT crt_PT_910524_Temperature_5 "signal Temperature_5 of frame RT_DL1MK3_Temp_5 (9504036x, 0x910524x)" SWORD CONV_crt_PT_910524_Temperature_5 0 0 0.0 0.0 ECU_ADDRESS 0x0000 /end MEASUREMENT
/begin COMPU_METHOD CONV_crt_PT_910524_Temperature_5 "Linear scaling, used for variable crt_PT_910524_Temperature_5, signal Temperature_5" RAT_FUNC "%6" "" COEFFS 0 -1 0.0 0 0 -0.1 /end COMPU_METHOD
/* Measurement point for signal Temperature_4 of frame RT_DL1MK3_Temp_4 (9503780x, 0x910424x) */
/begin MEASUREMENT crt_PT_910424_Temperature_4 "signal Temperature_4 of frame RT_DL1MK3_Temp_4 (9503780x, 0x910424x)" SWORD CONV_crt_PT_910424_Temperature_4 0 0 0.0 0.0 ECU_ADDRESS 0x0000 /end MEASUREMENT
/begin COMPU_METHOD CONV_crt_PT_910424_Temperature_4 "Linear scaling, used for variable crt_PT_910424_Temperature_4, signal Temperature_4" RAT_FUNC "%6" "" COEFFS 0 -1 0.0 0 0 -0.1 /end COMPU_METHOD
/* Measurement point for signal Temperature_3 of frame RT_DL1MK3_Temp_3 (9503524x, 0x910324x) */
/begin MEASUREMENT crt_PT_910324_Temperature_3 "signal Temperature_3 of frame RT_DL1MK3_Temp_3 (9503524x, 0x910324x)" SWORD CONV_crt_PT_910324_Temperature_3 0 0 0.0 0.0 ECU_ADDRESS 0x0000 /end MEASUREMENT
/begin COMPU_METHOD CONV_crt_PT_910324_Temperature_3 "Linear scaling, used for variable crt_PT_910324_Temperature_3, signal Temperature_3" RAT_FUNC "%6" "" COEFFS 0 -1 0.0 0 0 -0.1 /end COMPU_METHOD
/* Measurement point for signal Temperature_2 of frame RT_DL1MK3_Temp_2 (9503268x, 0x910224x) */
/begin MEASUREMENT crt_PT_910224_Temperature_2 "signal Temperature_2 of frame RT_DL1MK3_Temp_2 (9503268x, 0x910224x)" SWORD CONV_crt_PT_910224_Temperature_2 0 0 0.0 0.0 ECU_ADDRESS 0x0000 /end MEASUREMENT
/begin COMPU_METHOD CONV_crt_PT_910224_Temperature_2 "Linear scaling, used for variable crt_PT_910224_Temperature_2, signal Temperature_2" RAT_FUNC "%6" "" COEFFS 0 -1 0.0 0 0 -0.1 /end COMPU_METHOD
/* Measurement point for signal Temperature_1 of frame RT_DL1MK3_Temp_1 (9503012x, 0x910124x) */
/begin MEASUREMENT crt_PT_910124_Temperature_1 "signal Temperature_1 of frame RT_DL1MK3_Temp_1 (9503012x, 0x910124x)" SWORD CONV_crt_PT_910124_Temperature_1 0 0 0.0 0.0 ECU_ADDRESS 0x0000 /end MEASUREMENT
/begin COMPU_METHOD CONV_crt_PT_910124_Temperature_1 "Linear scaling, used for variable crt_PT_910124_Temperature_1, signal Temperature_1" RAT_FUNC "%6" "" COEFFS 0 -1 0.0 0 0 -0.1 /end COMPU_METHOD
/* Measurement point for signal Analog_32 of frame RT_DL1MK3_Analog_32 (8527652x, 0x821F24x) */
/begin MEASUREMENT crt_PT_821f24_Analog_32 "signal Analog_32 of frame RT_DL1MK3_Analog_32 (8527652x, 0x821F24x)" UWORD CONV_crt_PT_821f24_Analog_32 0 0 0.0 0.0 ECU_ADDRESS 0x0000 /end MEASUREMENT
/begin COMPU_METHOD CONV_crt_PT_821f24_Analog_32 "Linear scaling, used for variable crt_PT_821f24_Analog_32, signal Analog_32" RAT_FUNC "%6" "" COEFFS 0 -1 0.0 0 0 -0.001 /end COMPU_METHOD
/* Measurement point for signal Analog_31 of frame RT_DL1MK3_Analog_31 (8527396x, 0x821E24x) */
/begin MEASUREMENT crt_PT_821e24_Analog_31 "signal Analog_31 of frame RT_DL1MK3_Analog_31 (8527396x, 0x821E24x)" UWORD CONV_crt_PT_821e24_Analog_31 0 0 0.0 0.0 ECU_ADDRESS 0x0000 /end MEASUREMENT
/begin COMPU_METHOD CONV_crt_PT_821e24_Analog_31 "Linear scaling, used for variable crt_PT_821e24_Analog_31, signal Analog_31" RAT_FUNC "%6" "" COEFFS 0 -1 0.0 0 0 -0.001 /end COMPU_METHOD
/* Measurement point for signal Analog_30 of frame RT_DL1MK3_Analog_30 (8527140x, 0x821D24x) */
/begin MEASUREMENT crt_PT_821d24_Analog_30 "signal Analog_30 of frame RT_DL1MK3_Analog_30 (8527140x, 0x821D24x)" UWORD CONV_crt_PT_821d24_Analog_30 0 0 0.0 0.0 ECU_ADDRESS 0x0000 /end MEASUREMENT
/begin COMPU_METHOD CONV_crt_PT_821d24_Analog_30 "Linear scaling, used for variable crt_PT_821d24_Analog_30, signal Analog_30" RAT_FUNC "%6" "" COEFFS 0 -1 0.0 0 0 -0.001 /end COMPU_METHOD
/* Measurement point for signal Analog_29 of frame RT_DL1MK3_Analog_29 (8526884x, 0x821C24x) */
/begin MEASUREMENT crt_PT_821c24_Analog_29 "signal Analog_29 of frame RT_DL1MK3_Analog_29 (8526884x, 0x821C24x)" UWORD CONV_crt_PT_821c24_Analog_29 0 0 0.0 0.0 ECU_ADDRESS 0x0000 /end MEASUREMENT
/begin COMPU_METHOD CONV_crt_PT_821c24_Analog_29 "Linear scaling, used for variable crt_PT_821c24_Analog_29, signal Analog_29" RAT_FUNC "%6" "" COEFFS 0 -1 0.0 0 0 -0.001 /end COMPU_METHOD
/* Measurement point for signal Analog_28 of frame RT_DL1MK3_Analog_28 (8526628x, 0x821B24x) */
/begin MEASUREMENT crt_PT_821b24_Analog_28 "signal Analog_28 of frame RT_DL1MK3_Analog_28 (8526628x, 0x821B24x)" UWORD CONV_crt_PT_821b24_Analog_28 0 0 0.0 0.0 ECU_ADDRESS 0x0000 /end MEASUREMENT
/begin COMPU_METHOD CONV_crt_PT_821b24_Analog_28 "Linear scaling, used for variable crt_PT_821b24_Analog_28, signal Analog_28" RAT_FUNC "%6" "" COEFFS 0 -1 0.0 0 0 -0.001 /end COMPU_METHOD
/* Measurement point for signal Analog_27 of frame RT_DL1MK3_Analog_27 (8526372x, 0x821A24x) */
/begin MEASUREMENT crt_PT_821a24_Analog_27 "signal Analog_27 of frame RT_DL1MK3_Analog_27 (8526372x, 0x821A24x)" UWORD CONV_crt_PT_821a24_Analog_27 0 0 0.0 0.0 ECU_ADDRESS 0x0000 /end MEASUREMENT
/begin COMPU_METHOD CONV_crt_PT_821a24_Analog_27 "Linear scaling, used for variable crt_PT_821a24_Analog_27, signal Analog_27" RAT_FUNC "%6" "" COEFFS 0 -1 0.0 0 0 -0.001 /end COMPU_METHOD
/* Measurement point for signal Analog_26 of frame RT_DL1MK3_Analog_26 (8526116x, 0x821924x) */
/begin MEASUREMENT crt_PT_821924_Analog_26 "signal Analog_26 of frame RT_DL1MK3_Analog_26 (8526116x, 0x821924x)" UWORD CONV_crt_PT_821924_Analog_26 0 0 0.0 0.0 ECU_ADDRESS 0x0000 /end MEASUREMENT
/begin COMPU_METHOD CONV_crt_PT_821924_Analog_26 "Linear scaling, used for variable crt_PT_821924_Analog_26, signal Analog_26" RAT_FUNC "%6" "" COEFFS 0 -1 0.0 0 0 -0.001 /end COMPU_METHOD
/* Measurement point for signal Analog_25 of frame RT_DL1MK3_Analog_25 (8525860x, 0x821824x) */
/begin MEASUREMENT crt_PT_821824_Analog_25 "signal Analog_25 of frame RT_DL1MK3_Analog_25 (8525860x, 0x821824x)" UWORD CONV_crt_PT_821824_Analog_25 0 0 0.0 0.0 ECU_ADDRESS 0x0000 /end MEASUREMENT
/begin COMPU_METHOD CONV_crt_PT_821824_Analog_25 "Linear scaling, used for variable crt_PT_821824_Analog_25, signal Analog_25" RAT_FUNC "%6" "" COEFFS 0 -1 0.0 0 0 -0.001 /end COMPU_METHOD
/* Measurement point for signal Analog_15 of frame RT_DL1MK3_Analog_15 (8523300x, 0x820E24x) */
/begin MEASUREMENT crt_PT_820e24_Analog_15 "signal Analog_15 of frame RT_DL1MK3_Analog_15 (8523300x, 0x820E24x)" UWORD CONV_crt_PT_820e24_Analog_15 0 0 0.0 0.0 ECU_ADDRESS 0x0000 /end MEASUREMENT
/begin COMPU_METHOD CONV_crt_PT_820e24_Analog_15 "Linear scaling, used for variable crt_PT_820e24_Analog_15, signal Analog_15" RAT_FUNC "%6" "" COEFFS 0 -1 0.0 0 0 -0.001 /end COMPU_METHOD
/* Measurement point for signal Analog_14 of frame RT_DL1MK3_Analog_14 (8523044x, 0x820D24x) */
/begin MEASUREMENT crt_PT_820d24_Analog_14 "signal Analog_14 of frame RT_DL1MK3_Analog_14 (8523044x, 0x820D24x)" UWORD CONV_crt_PT_820d24_Analog_14 0 0 0.0 0.0 ECU_ADDRESS 0x0000 /end MEASUREMENT
/begin COMPU_METHOD CONV_crt_PT_820d24_Analog_14 "Linear scaling, used for variable crt_PT_820d24_Analog_14, signal Analog_14" RAT_FUNC "%6" "" COEFFS 0 -1 0.0 0 0 -0.001 /end COMPU_METHOD
/* Measurement point for signal Analog_17 of frame RT_DL1MK3_Analog_17 (8523812x, 0x821024x) */
/begin MEASUREMENT crt_PT_821024_Analog_17 "signal Analog_17 of frame RT_DL1MK3_Analog_17 (8523812x, 0x821024x)" UWORD CONV_crt_PT_821024_Analog_17 0 0 0.0 0.0 ECU_ADDRESS 0x0000 /end MEASUREMENT
/begin COMPU_METHOD CONV_crt_PT_821024_Analog_17 "Linear scaling, used for variable crt_PT_821024_Analog_17, signal Analog_17" RAT_FUNC "%6" "" COEFFS 0 -1 0.0 0 0 -0.001 /end COMPU_METHOD
/* Measurement point for signal Analog_24 of frame RT_DL1MK3_Analog_24 (8525604x, 0x821724x) */
/begin MEASUREMENT crt_PT_821724_Analog_24 "signal Analog_24 of frame RT_DL1MK3_Analog_24 (8525604x, 0x821724x)" UWORD CONV_crt_PT_821724_Analog_24 0 0 0.0 0.0 ECU_ADDRESS 0x0000 /end MEASUREMENT
/begin COMPU_METHOD CONV_crt_PT_821724_Analog_24 "Linear scaling, used for variable crt_PT_821724_Analog_24, signal Analog_24" RAT_FUNC "%6" "" COEFFS 0 -1 0.0 0 0 -0.001 /end COMPU_METHOD
/* Measurement point for signal Analog_23 of frame RT_DL1MK3_Analog_23 (8525348x, 0x821624x) */
/begin MEASUREMENT crt_PT_821624_Analog_23 "signal Analog_23 of frame RT_DL1MK3_Analog_23 (8525348x, 0x821624x)" UWORD CONV_crt_PT_821624_Analog_23 0 0 0.0 0.0 ECU_ADDRESS 0x0000 /end MEASUREMENT
/begin COMPU_METHOD CONV_crt_PT_821624_Analog_23 "Linear scaling, used for variable crt_PT_821624_Analog_23, signal Analog_23" RAT_FUNC "%6" "" COEFFS 0 -1 0.0 0 0 -0.001 /end COMPU_METHOD
/* Measurement point for signal Analog_22 of frame RT_DL1MK3_Analog_22 (8525092x, 0x821524x) */
/begin MEASUREMENT crt_PT_821524_Analog_22 "signal Analog_22 of frame RT_DL1MK3_Analog_22 (8525092x, 0x821524x)" UWORD CONV_crt_PT_821524_Analog_22 0 0 0.0 0.0 ECU_ADDRESS 0x0000 /end MEASUREMENT
/begin COMPU_METHOD CONV_crt_PT_821524_Analog_22 "Linear scaling, used for variable crt_PT_821524_Analog_22, signal Analog_22" RAT_FUNC "%6" "" COEFFS 0 -1 0.0 0 0 -0.001 /end COMPU_METHOD
/* Measurement point for signal Analog_21 of frame RT_DL1MK3_Analog_21 (8524836x, 0x821424x) */
/begin MEASUREMENT crt_PT_821424_Analog_21 "signal Analog_21 of frame RT_DL1MK3_Analog_21 (8524836x, 0x821424x)" UWORD CONV_crt_PT_821424_Analog_21 0 0 0.0 0.0 ECU_ADDRESS 0x0000 /end MEASUREMENT
/begin COMPU_METHOD CONV_crt_PT_821424_Analog_21 "Linear scaling, used for variable crt_PT_821424_Analog_21, signal Analog_21" RAT_FUNC "%6" "" COEFFS 0 -1 0.0 0 0 -0.001 /end COMPU_METHOD
/* Measurement point for signal Analog_20 of frame RT_DL1MK3_Analog_20 (8524580x, 0x821324x) */
/begin MEASUREMENT crt_PT_821324_Analog_20 "signal Analog_20 of frame RT_DL1MK3_Analog_20 (8524580x, 0x821324x)" UWORD CONV_crt_PT_821324_Analog_20 0 0 0.0 0.0 ECU_ADDRESS 0x0000 /end MEASUREMENT
/begin COMPU_METHOD CONV_crt_PT_821324_Analog_20 "Linear scaling, used for variable crt_PT_821324_Analog_20, signal Analog_20" RAT_FUNC "%6" "" COEFFS 0 -1 0.0 0 0 -0.001 /end COMPU_METHOD
/* Measurement point for signal Analog_19 of frame RT_DL1MK3_Analog_19 (8524324x, 0x821224x) */
/begin MEASUREMENT crt_PT_821224_Analog_19 "signal Analog_19 of frame RT_DL1MK3_Analog_19 (8524324x, 0x821224x)" UWORD CONV_crt_PT_821224_Analog_19 0 0 0.0 0.0 ECU_ADDRESS 0x0000 /end MEASUREMENT
/begin COMPU_METHOD CONV_crt_PT_821224_Analog_19 "Linear scaling, used for variable crt_PT_821224_Analog_19, signal Analog_19" RAT_FUNC "%6" "" COEFFS 0 -1 0.0 0 0 -0.001 /end COMPU_METHOD
/* Measurement point for signal Analog_16 of frame RT_DL1MK3_Analog_16 (8523556x, 0x820F24x) */
/begin MEASUREMENT crt_PT_820f24_Analog_16 "signal Analog_16 of frame RT_DL1MK3_Analog_16 (8523556x, 0x820F24x)" UWORD CONV_crt_PT_820f24_Analog_16 0 0 0.0 0.0 ECU_ADDRESS 0x0000 /end MEASUREMENT
/begin COMPU_METHOD CONV_crt_PT_820f24_Analog_16 "Linear scaling, used for variable crt_PT_820f24_Analog_16, signal Analog_16" RAT_FUNC "%6" "" COEFFS 0 -1 0.0 0 0 -0.001 /end COMPU_METHOD
/* Measurement point for signal Analog_18 of frame RT_DL1MK3_Analog_18 (8524068x, 0x821124x) */
/begin MEASUREMENT crt_PT_821124_Analog_18 "signal Analog_18 of frame RT_DL1MK3_Analog_18 (8524068x, 0x821124x)" UWORD CONV_crt_PT_821124_Analog_18 0 0 0.0 0.0 ECU_ADDRESS 0x0000 /end MEASUREMENT
/begin COMPU_METHOD CONV_crt_PT_821124_Analog_18 "Linear scaling, used for variable crt_PT_821124_Analog_18, signal Analog_18" RAT_FUNC "%6" "" COEFFS 0 -1 0.0 0 0 -0.001 /end COMPU_METHOD
/* Measurement point for signal Analog_12 of frame RT_DL1MK3_Analog_12 (8522532x, 0x820B24x) */
/begin MEASUREMENT crt_PT_820b24_Analog_12 "signal Analog_12 of frame RT_DL1MK3_Analog_12 (8522532x, 0x820B24x)" UWORD CONV_crt_PT_820b24_Analog_12 0 0 0.0 0.0 ECU_ADDRESS 0x0000 /end MEASUREMENT
/begin COMPU_METHOD CONV_crt_PT_820b24_Analog_12 "Linear scaling, used for variable crt_PT_820b24_Analog_12, signal Analog_12" RAT_FUNC "%6" "" COEFFS 0 -1 0.0 0 0 -0.001 /end COMPU_METHOD
/* Measurement point for signal Analog_11 of frame RT_DL1MK3_Analog_11 (8522276x, 0x820A24x) */
/begin MEASUREMENT crt_PT_820a24_Analog_11 "signal Analog_11 of frame RT_DL1MK3_Analog_11 (8522276x, 0x820A24x)" UWORD CONV_crt_PT_820a24_Analog_11 0 0 0.0 0.0 ECU_ADDRESS 0x0000 /end MEASUREMENT
/begin COMPU_METHOD CONV_crt_PT_820a24_Analog_11 "Linear scaling, used for variable crt_PT_820a24_Analog_11, signal Analog_11" RAT_FUNC "%6" "" COEFFS 0 -1 0.0 0 0 -0.001 /end COMPU_METHOD
/* Measurement point for signal Analog_10 of frame RT_DL1MK3_Analog_10 (8522020x, 0x820924x) */
/begin MEASUREMENT crt_PT_820924_Analog_10 "signal Analog_10 of frame RT_DL1MK3_Analog_10 (8522020x, 0x820924x)" UWORD CONV_crt_PT_820924_Analog_10 0 0 0.0 0.0 ECU_ADDRESS 0x0000 /end MEASUREMENT
/begin COMPU_METHOD CONV_crt_PT_820924_Analog_10 "Linear scaling, used for variable crt_PT_820924_Analog_10, signal Analog_10" RAT_FUNC "%6" "" COEFFS 0 -1 0.0 0 0 -0.001 /end COMPU_METHOD
/* Measurement point for signal Analog_9 of frame RT_DL1MK3_Analog_9 (8521764x, 0x820824x) */
/begin MEASUREMENT crt_PT_820824_Analog_9 "signal Analog_9 of frame RT_DL1MK3_Analog_9 (8521764x, 0x820824x)" UWORD CONV_crt_PT_820824_Analog_9 0 0 0.0 0.0 ECU_ADDRESS 0x0000 /end MEASUREMENT
/begin COMPU_METHOD CONV_crt_PT_820824_Analog_9 "Linear scaling, used for variable crt_PT_820824_Analog_9, signal Analog_9" RAT_FUNC "%6" "" COEFFS 0 -1 0.0 0 0 -0.001 /end COMPU_METHOD
/* Measurement point for signal Analog_8 of frame RT_DL1MK3_Analog_8 (8521508x, 0x820724x) */
/begin MEASUREMENT crt_PT_820724_Analog_8 "signal Analog_8 of frame RT_DL1MK3_Analog_8 (8521508x, 0x820724x)" UWORD CONV_crt_PT_820724_Analog_8 0 0 0.0 0.0 ECU_ADDRESS 0x0000 /end MEASUREMENT
/begin COMPU_METHOD CONV_crt_PT_820724_Analog_8 "Linear scaling, used for variable crt_PT_820724_Analog_8, signal Analog_8" RAT_FUNC "%6" "" COEFFS 0 -1 0.0 0 0 -0.001 /end COMPU_METHOD
/* Measurement point for signal Analog_7 of frame RT_DL1MK3_Analog_7 (8521252x, 0x820624x) */
/begin MEASUREMENT crt_PT_820624_Analog_7 "signal Analog_7 of frame RT_DL1MK3_Analog_7 (8521252x, 0x820624x)" UWORD CONV_crt_PT_820624_Analog_7 0 0 0.0 0.0 ECU_ADDRESS 0x0000 /end MEASUREMENT
/begin COMPU_METHOD CONV_crt_PT_820624_Analog_7 "Linear scaling, used for variable crt_PT_820624_Analog_7, signal Analog_7" RAT_FUNC "%6" "" COEFFS 0 -1 0.0 0 0 -0.001 /end COMPU_METHOD
/* Measurement point for signal Analog_6 of frame RT_DL1MK3_Analog_6 (8520996x, 0x820524x) */
/begin MEASUREMENT crt_PT_820524_Analog_6 "signal Analog_6 of frame RT_DL1MK3_Analog_6 (8520996x, 0x820524x)" UWORD CONV_crt_PT_820524_Analog_6 0 0 0.0 0.0 ECU_ADDRESS 0x0000 /end MEASUREMENT
/begin COMPU_METHOD CONV_crt_PT_820524_Analog_6 "Linear scaling, used for variable crt_PT_820524_Analog_6, signal Analog_6" RAT_FUNC "%6" "" COEFFS 0 -1 0.0 0 0 -0.001 /end COMPU_METHOD
/* Measurement point for signal Analog_5 of frame RT_DL1MK3_Analog_5 (8520740x, 0x820424x) */
/begin MEASUREMENT crt_PT_820424_Analog_5 "signal Analog_5 of frame RT_DL1MK3_Analog_5 (8520740x, 0x820424x)" UWORD CONV_crt_PT_820424_Analog_5 0 0 0.0 0.0 ECU_ADDRESS 0x0000 /end MEASUREMENT
/begin COMPU_METHOD CONV_crt_PT_820424_Analog_5 "Linear scaling, used for variable crt_PT_820424_Analog_5, signal Analog_5" RAT_FUNC "%6" "" COEFFS 0 -1 0.0 0 0 -0.001 /end COMPU_METHOD
/* Measurement point for signal Analog_4 of frame RT_DL1MK3_Analog_4 (8520484x, 0x820324x) */
/begin MEASUREMENT crt_PT_820324_Analog_4 "signal Analog_4 of frame RT_DL1MK3_Analog_4 (8520484x, 0x820324x)" UWORD CONV_crt_PT_820324_Analog_4 0 0 0.0 0.0 ECU_ADDRESS 0x0000 /end MEASUREMENT
/begin COMPU_METHOD CONV_crt_PT_820324_Analog_4 "Linear scaling, used for variable crt_PT_820324_Analog_4, signal Analog_4" RAT_FUNC "%6" "" COEFFS 0 -1 0.0 0 0 -0.001 /end COMPU_METHOD
/* Measurement point for signal Analog_3 of frame RT_DL1MK3_Analog_3 (8520228x, 0x820224x) */
/begin MEASUREMENT crt_PT_820224_Analog_3 "signal Analog_3 of frame RT_DL1MK3_Analog_3 (8520228x, 0x820224x)" UWORD CONV_crt_PT_820224_Analog_3 0 0 0.0 0.0 ECU_ADDRESS 0x0000 /end MEASUREMENT
/begin COMPU_METHOD CONV_crt_PT_820224_Analog_3 "Linear scaling, used for variable crt_PT_820224_Analog_3, signal Analog_3" RAT_FUNC "%6" "" COEFFS 0 -1 0.0 0 0 -0.001 /end COMPU_METHOD
/* Measurement point for signal Analog_2 of frame RT_DL1MK3_Analog_2 (8519972x, 0x820124x) */
/begin MEASUREMENT crt_PT_820124_Analog_2 "signal Analog_2 of frame RT_DL1MK3_Analog_2 (8519972x, 0x820124x)" UWORD CONV_crt_PT_820124_Analog_2 0 0 0.0 0.0 ECU_ADDRESS 0x0000 /end MEASUREMENT
/begin COMPU_METHOD CONV_crt_PT_820124_Analog_2 "Linear scaling, used for variable crt_PT_820124_Analog_2, signal Analog_2" RAT_FUNC "%6" "" COEFFS 0 -1 0.0 0 0 -0.001 /end COMPU_METHOD
/* Measurement point for signal Analog_1 of frame RT_DL1MK3_Analog_1 (8519716x, 0x820024x) */
/begin MEASUREMENT crt_PT_820024_Analog_1 "signal Analog_1 of frame RT_DL1MK3_Analog_1 (8519716x, 0x820024x)" UWORD CONV_crt_PT_820024_Analog_1 0 0 0.0 0.0 ECU_ADDRESS 0x0000 /end MEASUREMENT
/begin COMPU_METHOD CONV_crt_PT_820024_Analog_1 "Linear scaling, used for variable crt_PT_820024_Analog_1, signal Analog_1" RAT_FUNC "%6" "" COEFFS 0 -1 0.0 0 0 -0.001 /end COMPU_METHOD
/begin GROUP RT_SB_INS_Vel_Body_Axes "All signals of frame RT_SB_INS_Vel_Body_Axes (215, 0x0D7)" /begin SUB_GROUP /end SUB_GROUP
 /begin REF_MEASUREMENT crt_PT_0d7_Validity_INS_Vel_Forwards crt_PT_0d7_Validity_INS_Vel_Sideways crt_PT_0d7_Bit4 crt_PT_0d7_Bit7 crt_PT_0d7_Byte2_Bit0 crt_PT_0d7_INS_Vel_Sideways_2D /end REF_MEASUREMENT
/end GROUP
/begin GROUP RT_DL1MK3_Speed "All signals of frame RT_DL1MK3_Speed (8392740x, 0x801024x)" /begin SUB_GROUP /end SUB_GROUP
 /begin REF_MEASUREMENT crt_PT_801024_Validity_Speed crt_PT_801024_Accuracy_Speed crt_PT_801024_Direction crt_PT_801024_Speed /end REF_MEASUREMENT
/end GROUP
/begin GROUP RT_DL1MK3_GPS_Time "All signals of frame RT_DL1MK3_GPS_Time (9175332x, 0x8C0124x)" /begin SUB_GROUP /end SUB_GROUP
 /begin REF_MEASUREMENT crt_PT_8c0124_Validity_GPS_Time crt_PT_8c0124_Validity_GPS_Week crt_PT_8c0124_Accuracy_GPS_Time crt_PT_8c0124_GPS_Time crt_PT_8c0124_GPS_Week /end REF_MEASUREMENT
/end GROUP
/begin GROUP RT_DL1MK3_GPS_Pos_LLH_2 "All signals of frame RT_DL1MK3_GPS_Pos_LLH_2 (9175844x, 0x8C0324x)" /begin SUB_GROUP /end SUB_GROUP
 /begin REF_MEASUREMENT crt_PT_8c0324_GPS_Pos_LLH_Longitude crt_PT_8c0324_GPS_Pos_LLH_Altitude /end REF_MEASUREMENT
/end GROUP
/begin GROUP RT_DL1MK3_GPS_Pos_LLH_1 "All signals of frame RT_DL1MK3_GPS_Pos_LLH_1 (9175588x, 0x8C0224x)" /begin SUB_GROUP /end SUB_GROUP
 /begin REF_MEASUREMENT crt_PT_8c0224_Validity_GPS_Pos_LLH_Latitude crt_PT_8c0224_Validity_GPS_Pos_LLH_Longitude crt_PT_8c0224_Validity_GPS_Pos_LLH_Altitude crt_PT_8c0224_Accuracy_GPS_Pos_LLH_Latitude crt_PT_8c0224_Accuracy_GPS_Pos_LLH_Longitude crt_PT_8c0224_Accuracy_GPS_Pos_LLH_Altitude crt_PT_8c0224_GPS_Pos_LLH_Latitude /end REF_MEASUREMENT
/end GROUP
/begin GROUP RT_DL1MK3_GPS_Speed "All signals of frame RT_DL1MK3_GPS_Speed (1234, 0x4D2)" /begin SUB_GROUP /end SUB_GROUP
 /begin REF_MEASUREMENT crt_PT_4d2_Validity_GPS_Speed_2D crt_PT_4d2_Validity_GPS_Speed_3D crt_PT_4d2_Accuracy_GPS_Speed crt_PT_4d2_GPS_Speed_2D crt_PT_4d2_GPS_Speed_3D /end REF_MEASUREMENT
/end GROUP
/begin GROUP RT_IRTemp_Temp_7 "All signals of frame RT_IRTemp_Temp_7 (9504549x, 0x910725x)" /begin SUB_GROUP /end SUB_GROUP /begin REF_MEASUREMENT crt_PT_910725_IR_Temperature_7 /end REF_MEASUREMENT /end GROUP
/begin GROUP RT_IRTemp_Temp_RR_2 "All signals of frame RT_IRTemp_Temp_RR_2 (9963557x, 0x980825x)" /begin SUB_GROUP /end SUB_GROUP
 /begin REF_MEASUREMENT crt_PT_980825_IR_Temperature_29 crt_PT_980825_IR_Temperature_30 crt_PT_980825_IR_Temperature_31 crt_PT_980825_IR_Temperature_32 /end REF_MEASUREMENT
/end GROUP
/begin GROUP RT_IRTemp_Temp_RL_2 "All signals of frame RT_IRTemp_Temp_RL_2 (9963045x, 0x980625x)" /begin SUB_GROUP /end SUB_GROUP
 /begin REF_MEASUREMENT crt_PT_980625_IR_Temperature_21 crt_PT_980625_IR_Temperature_22 crt_PT_980625_IR_Temperature_23 crt_PT_980625_IR_Temperature_24 /end REF_MEASUREMENT
/end GROUP
/begin GROUP RT_IRTemp_Temp_FR_2 "All signals of frame RT_IRTemp_Temp_FR_2 (9962533x, 0x980425x)" /begin SUB_GROUP /end SUB_GROUP
 /begin REF_MEASUREMENT crt_PT_980425_IR_Temperature_13 crt_PT_980425_IR_Temperature_14 crt_PT_980425_IR_Temperature_15 crt_PT_980425_IR_Temperature_16 /end REF_MEASUREMENT
/end GROUP
/begin GROUP RT_IRTemp_Temp_FL_2 "All signals of frame RT_IRTemp_Temp_FL_2 (9962021x, 0x980225x)" /begin SUB_GROUP /end SUB_GROUP
 /begin REF_MEASUREMENT crt_PT_980225_IR_Temperature_5 crt_PT_980225_IR_Temperature_6 crt_PT_980225_IR_Temperature_7 crt_PT_980225_IR_Temperature_8 /end REF_MEASUREMENT
/end GROUP
/begin GROUP RT_IRTemp_Temp_RR_1 "All signals of frame RT_IRTemp_Temp_RR_1 (9963301x, 0x980725x)" /begin SUB_GROUP /end SUB_GROUP
 /begin REF_MEASUREMENT crt_PT_980725_IR_Temperature_25 crt_PT_980725_IR_Temperature_26 crt_PT_980725_IR_Temperature_27 crt_PT_980725_IR_Temperature_28 /end REF_MEASUREMENT
/end GROUP
/begin GROUP RT_IRTemp_Temp_RL_1 "All signals of frame RT_IRTemp_Temp_RL_1 (9962789x, 0x980525x)" /begin SUB_GROUP /end SUB_GROUP
 /begin REF_MEASUREMENT crt_PT_980525_IR_Temperature_17 crt_PT_980525_IR_Temperature_18 crt_PT_980525_IR_Temperature_19 crt_PT_980525_IR_Temperature_20 /end REF_MEASUREMENT
/end GROUP
/begin GROUP RT_IRTemp_Temp_FR_1 "All signals of frame RT_IRTemp_Temp_FR_1 (9962277x, 0x980325x)" /begin SUB_GROUP /end SUB_GROUP
 /begin REF_MEASUREMENT crt_PT_980325_IR_Temperature_9 crt_PT_980325_IR_Temperature_10 crt_PT_980325_IR_Temperature_11 crt_PT_980325_IR_Temperature_12 /end REF_MEASUREMENT
/end GROUP
/begin GROUP RT_IRTemp_Temp_FL_1 "All signals of frame RT_IRTemp_Temp_FL_1 (9961765x, 0x980125x)" /begin SUB_GROUP /end SUB_GROUP
 /begin REF_MEASUREMENT crt_PT_980125_IR_Temperature_1 crt_PT_980125_IR_Temperature_2 crt_PT_980125_IR_Temperature_3 crt_PT_980125_IR_Temperature_4 /end REF_MEASUREMENT
/end GROUP
/begin GROUP RT_IRTemp_Temp_32 "All signals of frame RT_IRTemp_Temp_32 (9510949x, 0x912025x)" /begin SUB_GROUP /end SUB_GROUP /begin REF_MEASUREMENT crt_PT_912025_IR_Temperature_32 /end REF_MEASUREMENT /end GROUP
/begin GROUP RT_IRTemp_Temp_31 "All signals of frame RT_IRTemp_Temp_31 (9510693x, 0x911F25x)" /begin SUB_GROUP /end SUB_GROUP /begin REF_MEASUREMENT crt_PT_911f25_IR_Temperature_31 /end REF_MEASUREMENT /end GROUP
/begin GROUP RT_IRTemp_Temp_30 "All signals of frame RT_IRTemp_Temp_30 (9510437x, 0x911E25x)" /begin SUB_GROUP /end SUB_GROUP /begin REF_MEASUREMENT crt_PT_911e25_IR_Temperature_30 /end REF_MEASUREMENT /end GROUP
/begin GROUP RT_IRTemp_Temp_29 "All signals of frame RT_IRTemp_Temp_29 (9510181x, 0x911D25x)" /begin SUB_GROUP /end SUB_GROUP /begin REF_MEASUREMENT crt_PT_911d25_IR_Temperature_29 /end REF_MEASUREMENT /end GROUP
/begin GROUP RT_IRTemp_Temp_28 "All signals of frame RT_IRTemp_Temp_28 (9509925x, 0x911C25x)" /begin SUB_GROUP /end SUB_GROUP /begin REF_MEASUREMENT crt_PT_911c25_IR_Temperature_28 /end REF_MEASUREMENT /end GROUP
/begin GROUP RT_IRTemp_Temp_27 "All signals of frame RT_IRTemp_Temp_27 (9509669x, 0x911B25x)" /begin SUB_GROUP /end SUB_GROUP /begin REF_MEASUREMENT crt_PT_911b25_IR_Temperature_27 /end REF_MEASUREMENT /end GROUP
/begin GROUP RT_IRTemp_Temp_26 "All signals of frame RT_IRTemp_Temp_26 (9509413x, 0x911A25x)" /begin SUB_GROUP /end SUB_GROUP /begin REF_MEASUREMENT crt_PT_911a25_IR_Temperature_26 /end REF_MEASUREMENT /end GROUP
/begin GROUP RT_IRTemp_Temp_25 "All signals of frame RT_IRTemp_Temp_25 (9509157x, 0x911925x)" /begin SUB_GROUP /end SUB_GROUP /begin REF_MEASUREMENT crt_PT_911925_IR_Temperature_25 /end REF_MEASUREMENT /end GROUP
/begin GROUP RT_IRTemp_Temp_24 "All signals of frame RT_IRTemp_Temp_24 (9508901x, 0x911825x)" /begin SUB_GROUP /end SUB_GROUP /begin REF_MEASUREMENT crt_PT_911825_IR_Temperature_24 /end REF_MEASUREMENT /end GROUP
/begin GROUP RT_IRTemp_Temp_22 "All signals of frame RT_IRTemp_Temp_22 (9508389x, 0x911625x)" /begin SUB_GROUP /end SUB_GROUP /begin REF_MEASUREMENT crt_PT_911625_IR_Temperature_22 /end REF_MEASUREMENT /end GROUP
/begin GROUP RT_IRTemp_Temp_23 "All signals of frame RT_IRTemp_Temp_23 (9508645x, 0x911725x)" /begin SUB_GROUP /end SUB_GROUP /begin REF_MEASUREMENT crt_PT_911725_IR_Temperature_23 /end REF_MEASUREMENT /end GROUP
/begin GROUP RT_IRTemp_Temp_21 "All signals of frame RT_IRTemp_Temp_21 (9508133x, 0x911525x)" /begin SUB_GROUP /end SUB_GROUP /begin REF_MEASUREMENT crt_PT_911525_IR_Temperature_21 /end REF_MEASUREMENT /end GROUP
/begin GROUP RT_IRTemp_Temp_20 "All signals of frame RT_IRTemp_Temp_20 (9507877x, 0x911425x)" /begin SUB_GROUP /end SUB_GROUP /begin REF_MEASUREMENT crt_PT_911425_IR_Temperature_20 /end REF_MEASUREMENT /end GROUP
/begin GROUP RT_IRTemp_Temp_19 "All signals of frame RT_IRTemp_Temp_19 (9507621x, 0x911325x)" /begin SUB_GROUP /end SUB_GROUP /begin REF_MEASUREMENT crt_PT_911325_IR_Temperature_19 /end REF_MEASUREMENT /end GROUP
/begin GROUP RT_IRTemp_Temp_18 "All signals of frame RT_IRTemp_Temp_18 (9507365x, 0x911225x)" /begin SUB_GROUP /end SUB_GROUP /begin REF_MEASUREMENT crt_PT_911225_IR_Temperature_18 /end REF_MEASUREMENT /end GROUP
/begin GROUP RT_IRTemp_Temp_16 "All signals of frame RT_IRTemp_Temp_16 (9506853x, 0x911025x)" /begin SUB_GROUP /end SUB_GROUP /begin REF_MEASUREMENT crt_PT_911025_IR_Temperature_16 /end REF_MEASUREMENT /end GROUP
/begin GROUP RT_IRTemp_Temp_15 "All signals of frame RT_IRTemp_Temp_15 (9506597x, 0x910F25x)" /begin SUB_GROUP /end SUB_GROUP /begin REF_MEASUREMENT crt_PT_910f25_IR_Temperature_15 /end REF_MEASUREMENT /end GROUP
/begin GROUP RT_IRTemp_Temp_14 "All signals of frame RT_IRTemp_Temp_14 (9506341x, 0x910E25x)" /begin SUB_GROUP /end SUB_GROUP /begin REF_MEASUREMENT crt_PT_910e25_IR_Temperature_14 /end REF_MEASUREMENT /end GROUP
/begin GROUP RT_IRTemp_Temp_13 "All signals of frame RT_IRTemp_Temp_13 (9506085x, 0x910D25x)" /begin SUB_GROUP /end SUB_GROUP /begin REF_MEASUREMENT crt_PT_910d25_IR_Temperature_13 /end REF_MEASUREMENT /end GROUP
/begin GROUP RT_IRTemp_Temp_12 "All signals of frame RT_IRTemp_Temp_12 (9505829x, 0x910C25x)" /begin SUB_GROUP /end SUB_GROUP /begin REF_MEASUREMENT crt_PT_910c25_IR_Temperature_12 /end REF_MEASUREMENT /end GROUP
/begin GROUP RT_IRTemp_Temp_11 "All signals of frame RT_IRTemp_Temp_11 (9505573x, 0x910B25x)" /begin SUB_GROUP /end SUB_GROUP /begin REF_MEASUREMENT crt_PT_910b25_IR_Temperature_11 /end REF_MEASUREMENT /end GROUP
/begin GROUP RT_IRTemp_Temp_10 "All signals of frame RT_IRTemp_Temp_10 (9505317x, 0x910A25x)" /begin SUB_GROUP /end SUB_GROUP /begin REF_MEASUREMENT crt_PT_910a25_IR_Temperature_10 /end REF_MEASUREMENT /end GROUP
/begin GROUP RT_IRTemp_Temp_8 "All signals of frame RT_IRTemp_Temp_8 (9504805x, 0x910825x)" /begin SUB_GROUP /end SUB_GROUP /begin REF_MEASUREMENT crt_PT_910825_IR_Temperature_8 /end REF_MEASUREMENT /end GROUP
/begin GROUP RT_IRTemp_Temp_9 "All signals of frame RT_IRTemp_Temp_9 (9505061x, 0x910925x)" /begin SUB_GROUP /end SUB_GROUP /begin REF_MEASUREMENT crt_PT_910925_IR_Temperature_9 /end REF_MEASUREMENT /end GROUP
/begin GROUP RT_IRTemp_Temp_17 "All signals of frame RT_IRTemp_Temp_17 (9507109x, 0x911125x)" /begin SUB_GROUP /end SUB_GROUP /begin REF_MEASUREMENT crt_PT_911125_IR_Temperature_17 /end REF_MEASUREMENT /end GROUP
/begin GROUP RT_IRTemp_Temp_6 "All signals of frame RT_IRTemp_Temp_6 (9504293x, 0x910625x)" /begin SUB_GROUP /end SUB_GROUP /begin REF_MEASUREMENT crt_PT_910625_IR_Temperature_6 /end REF_MEASUREMENT /end GROUP
/begin GROUP RT_IRTemp_Temp_5 "All signals of frame RT_IRTemp_Temp_5 (9504037x, 0x910525x)" /begin SUB_GROUP /end SUB_GROUP /begin REF_MEASUREMENT crt_PT_910525_IR_Temperature_5 /end REF_MEASUREMENT /end GROUP
/begin GROUP RT_IRTemp_Temp_4 "All signals of frame RT_IRTemp_Temp_4 (9503781x, 0x910425x)" /begin SUB_GROUP /end SUB_GROUP /begin REF_MEASUREMENT crt_PT_910425_IR_Temperature_4 /end REF_MEASUREMENT /end GROUP
/begin GROUP RT_IRTemp_Temp_3 "All signals of frame RT_IRTemp_Temp_3 (9503525x, 0x910325x)" /begin SUB_GROUP /end SUB_GROUP /begin REF_MEASUREMENT crt_PT_910325_IR_Temperature_3 /end REF_MEASUREMENT /end GROUP
/begin GROUP RT_IRTemp_Temp_2 "All signals of frame RT_IRTemp_Temp_2 (9503269x, 0x910225x)" /begin SUB_GROUP /end SUB_GROUP /begin REF_MEASUREMENT crt_PT_910225_IR_Temperature_2 /end REF_MEASUREMENT /end GROUP
/begin GROUP RT_IRTemp_Temp_1 "All signals of frame RT_IRTemp_Temp_1 (9503013x, 0x910125x)" /begin SUB_GROUP /end SUB_GROUP /begin REF_MEASUREMENT crt_PT_910125_IR_Temperature_1 crt_PT_910125_CRC /end REF_MEASUREMENT /end GROUP
/begin GROUP RT_SB_Trig_Final_Condition "All signals of frame RT_SB_Trig_Final_Condition (9242402x, 0x8D0722x)" /begin SUB_GROUP /end SUB_GROUP
 /begin REF_MEASUREMENT crt_PT_8d0722_Validity_Final_Speed crt_PT_8d0722_Final_Speed /end REF_MEASUREMENT
/end GROUP
/begin GROUP RT_SB_Trig_Initial_Condition "All signals of frame RT_SB_Trig_Initial_Condition (794, 0x31A)" /begin SUB_GROUP /end SUB_GROUP
 /begin REF_MEASUREMENT crt_PT_31a_Validity_Initial_Speed crt_PT_31a_Validity_Initial_Heading crt_PT_31a_Initial_Speed crt_PT_31a_Initial_Heading crt_PT_31a_MFDD_Start_Threshold crt_PT_31a_MFDD_End_Threshold /end REF_MEASUREMENT
/end GROUP
/begin GROUP RT_SB_Trig_Direct_Dist "All signals of frame RT_SB_Trig_Direct_Dist (9241890x, 0x8D0522x)" /begin SUB_GROUP /end SUB_GROUP
 /begin REF_MEASUREMENT crt_PT_8d0522_Direct_Distance crt_PT_8d0522_Path_Distance_2D /end REF_MEASUREMENT
/end GROUP
/begin GROUP RT_SB_Trig_Forward_Dist "All signals of frame RT_SB_Trig_Forward_Dist (9241634x, 0x8D0422x)" /begin SUB_GROUP /end SUB_GROUP
 /begin REF_MEASUREMENT crt_PT_8d0422_Forward_Distance crt_PT_8d0422_Deviation_Distance /end REF_MEASUREMENT
/end GROUP
/begin GROUP RT_SB_Trig_Path_Dist "All signals of frame RT_SB_Trig_Path_Dist (9241378x, 0x8D0322x)" /begin SUB_GROUP /end SUB_GROUP /begin REF_MEASUREMENT crt_PT_8d0322_Path_Distance_3D /end REF_MEASUREMENT /end GROUP
/begin GROUP RT_SB_Trig_Accel "All signals of frame RT_SB_Trig_Accel (9241122x, 0x8D0222x)" /begin SUB_GROUP /end SUB_GROUP
 /begin REF_MEASUREMENT crt_PT_8d0222_Validity_MFDD crt_PT_8d0222_Validity_Average_Accel crt_PT_8d0222_Validity_Triggered_Time crt_PT_8d0222_MFDD crt_PT_8d0222_Average_Accel crt_PT_8d0222_Triggered_Time /end REF_MEASUREMENT
/end GROUP
/begin GROUP RT_DL1MK3_Measure_Time_12 "All signals of frame RT_DL1MK3_Measure_Time_12 (9833508x, 0x960C24x)" /begin SUB_GROUP /end SUB_GROUP /begin REF_MEASUREMENT crt_PT_960c24_Measured_Time_12 /end REF_MEASUREMENT /end GROUP
/begin GROUP RT_DL1MK3_Measure_Time_11 "All signals of frame RT_DL1MK3_Measure_Time_11 (9833252x, 0x960B24x)" /begin SUB_GROUP /end SUB_GROUP /begin REF_MEASUREMENT crt_PT_960b24_Measured_Time_11 /end REF_MEASUREMENT /end GROUP
/begin GROUP RT_DL1MK3_Measure_Time_10 "All signals of frame RT_DL1MK3_Measure_Time_10 (9832996x, 0x960A24x)" /begin SUB_GROUP /end SUB_GROUP /begin REF_MEASUREMENT crt_PT_960a24_Measured_Time_10 /end REF_MEASUREMENT /end GROUP
/begin GROUP RT_DL1MK3_Measure_Time_9 "All signals of frame RT_DL1MK3_Measure_Time_9 (9832740x, 0x960924x)" /begin SUB_GROUP /end SUB_GROUP /begin REF_MEASUREMENT crt_PT_960924_Measured_Time_9 /end REF_MEASUREMENT /end GROUP
/begin GROUP RT_DL1MK3_Measure_Time_8 "All signals of frame RT_DL1MK3_Measure_Time_8 (9832484x, 0x960824x)" /begin SUB_GROUP /end SUB_GROUP /begin REF_MEASUREMENT crt_PT_960824_Measured_Time_8 /end REF_MEASUREMENT /end GROUP
/begin GROUP RT_DL1MK3_Measure_Time_7 "All signals of frame RT_DL1MK3_Measure_Time_7 (9832228x, 0x960724x)" /begin SUB_GROUP /end SUB_GROUP /begin REF_MEASUREMENT crt_PT_960724_Measured_Time_7 /end REF_MEASUREMENT /end GROUP
/begin GROUP RT_DL1MK3_Measure_Time_6 "All signals of frame RT_DL1MK3_Measure_Time_6 (9831972x, 0x960624x)" /begin SUB_GROUP /end SUB_GROUP /begin REF_MEASUREMENT crt_PT_960624_Measured_Time_6 /end REF_MEASUREMENT /end GROUP
/begin GROUP RT_DL1MK3_Measure_Time_5 "All signals of frame RT_DL1MK3_Measure_Time_5 (9831716x, 0x960524x)" /begin SUB_GROUP /end SUB_GROUP /begin REF_MEASUREMENT crt_PT_960524_Measured_Time_5 /end REF_MEASUREMENT /end GROUP
/begin GROUP RT_DL1MK3_Measure_Time_4 "All signals of frame RT_DL1MK3_Measure_Time_4 (9831460x, 0x960424x)" /begin SUB_GROUP /end SUB_GROUP /begin REF_MEASUREMENT crt_PT_960424_Measured_Time_4 /end REF_MEASUREMENT /end GROUP
/begin GROUP RT_DL1MK3_Measure_Time_3 "All signals of frame RT_DL1MK3_Measure_Time_3 (9831204x, 0x960324x)" /begin SUB_GROUP /end SUB_GROUP /begin REF_MEASUREMENT crt_PT_960324_Measured_Time_3 /end REF_MEASUREMENT /end GROUP
/begin GROUP RT_DL1MK3_Measure_Time_2 "All signals of frame RT_DL1MK3_Measure_Time_2 (9830948x, 0x960224x)" /begin SUB_GROUP /end SUB_GROUP /begin REF_MEASUREMENT crt_PT_960224_Measured_Time_2 /end REF_MEASUREMENT /end GROUP
/begin GROUP RT_DL1MK3_Measure_Time_1 "All signals of frame RT_DL1MK3_Measure_Time_1 (9830692x, 0x960124x)" /begin SUB_GROUP /end SUB_GROUP /begin REF_MEASUREMENT crt_PT_960124_Measured_Time_1 /end REF_MEASUREMENT /end GROUP
/begin GROUP RT_DL1MK3_RPM "All signals of frame RT_DL1MK3_RPM (9767972x, 0x950C24x)" /begin SUB_GROUP /end SUB_GROUP /begin REF_MEASUREMENT crt_PT_950c24_RPM /end REF_MEASUREMENT /end GROUP
/begin GROUP RT_DL1MK3_Freq_4 "All signals of frame RT_DL1MK3_Freq_4 (9767716x, 0x950B24x)" /begin SUB_GROUP /end SUB_GROUP /begin REF_MEASUREMENT crt_PT_950b24_Frequency_4 /end REF_MEASUREMENT /end GROUP
/begin GROUP RT_DL1MK3_Freq_3 "All signals of frame RT_DL1MK3_Freq_3 (9767460x, 0x950A24x)" /begin SUB_GROUP /end SUB_GROUP /begin REF_MEASUREMENT crt_PT_950a24_Frequency_3 /end REF_MEASUREMENT /end GROUP
/begin GROUP RT_DL1MK3_Freq_2 "All signals of frame RT_DL1MK3_Freq_2 (9767204x, 0x950924x)" /begin SUB_GROUP /end SUB_GROUP /begin REF_MEASUREMENT crt_PT_950924_Frequency_2 /end REF_MEASUREMENT /end GROUP
/begin GROUP RT_DL1MK3_Misc_3 "All signals of frame RT_DL1MK3_Misc_3 (9896740x, 0x970324x)" /begin SUB_GROUP /end SUB_GROUP /begin REF_MEASUREMENT crt_PT_970324_Misc_3 /end REF_MEASUREMENT /end GROUP
/begin GROUP RT_DL1MK3_Misc_2 "All signals of frame RT_DL1MK3_Misc_2 (9896484x, 0x970224x)" /begin SUB_GROUP /end SUB_GROUP /begin REF_MEASUREMENT crt_PT_970224_Misc_2 /end REF_MEASUREMENT /end GROUP
/begin GROUP RT_DL1MK3_Misc_1 "All signals of frame RT_DL1MK3_Misc_1 (9896228x, 0x970124x)" /begin SUB_GROUP /end SUB_GROUP /begin REF_MEASUREMENT crt_PT_970124_Misc_1 /end REF_MEASUREMENT /end GROUP
/begin GROUP RT_DL1MK3_Aux_31 "All signals of frame RT_DL1MK3_Aux_31 (9707300x, 0x941F24x)" /begin SUB_GROUP /end SUB_GROUP /begin REF_MEASUREMENT crt_PT_941f24_AUX_31 /end REF_MEASUREMENT /end GROUP
/begin GROUP RT_DL1MK3_Aux_30 "All signals of frame RT_DL1MK3_Aux_30 (9707044x, 0x941E24x)" /begin SUB_GROUP /end SUB_GROUP /begin REF_MEASUREMENT crt_PT_941e24_AUX_30 /end REF_MEASUREMENT /end GROUP
/begin GROUP RT_DL1MK3_Aux_29 "All signals of frame RT_DL1MK3_Aux_29 (9706788x, 0x941D24x)" /begin SUB_GROUP /end SUB_GROUP /begin REF_MEASUREMENT crt_PT_941d24_AUX_29 /end REF_MEASUREMENT /end GROUP
/begin GROUP RT_DL1MK3_Aux_28 "All signals of frame RT_DL1MK3_Aux_28 (9706532x, 0x941C24x)" /begin SUB_GROUP /end SUB_GROUP /begin REF_MEASUREMENT crt_PT_941c24_AUX_28 /end REF_MEASUREMENT /end GROUP
/begin GROUP RT_DL1MK3_Aux_27 "All signals of frame RT_DL1MK3_Aux_27 (9706276x, 0x941B24x)" /begin SUB_GROUP /end SUB_GROUP /begin REF_MEASUREMENT crt_PT_941b24_AUX_27 /end REF_MEASUREMENT /end GROUP
/begin GROUP RT_DL1MK3_Aux_26 "All signals of frame RT_DL1MK3_Aux_26 (9706020x, 0x941A24x)" /begin SUB_GROUP /end SUB_GROUP /begin REF_MEASUREMENT crt_PT_941a24_AUX_26 /end REF_MEASUREMENT /end GROUP
/begin GROUP RT_DL1MK3_Aux_25 "All signals of frame RT_DL1MK3_Aux_25 (9705764x, 0x941924x)" /begin SUB_GROUP /end SUB_GROUP /begin REF_MEASUREMENT crt_PT_941924_AUX_25 /end REF_MEASUREMENT /end GROUP
/begin GROUP RT_DL1MK3_Aux_24 "All signals of frame RT_DL1MK3_Aux_24 (9705508x, 0x941824x)" /begin SUB_GROUP /end SUB_GROUP /begin REF_MEASUREMENT crt_PT_941824_AUX_24 /end REF_MEASUREMENT /end GROUP
/begin GROUP RT_DL1MK3_Aux_23 "All signals of frame RT_DL1MK3_Aux_23 (9705252x, 0x941724x)" /begin SUB_GROUP /end SUB_GROUP /begin REF_MEASUREMENT crt_PT_941724_AUX_23 /end REF_MEASUREMENT /end GROUP
/begin GROUP RT_DL1MK3_Aux_22 "All signals of frame RT_DL1MK3_Aux_22 (9704996x, 0x941624x)" /begin SUB_GROUP /end SUB_GROUP /begin REF_MEASUREMENT crt_PT_941624_AUX_22 /end REF_MEASUREMENT /end GROUP
/begin GROUP RT_DL1MK3_Aux_21 "All signals of frame RT_DL1MK3_Aux_21 (9704740x, 0x941524x)" /begin SUB_GROUP /end SUB_GROUP /begin REF_MEASUREMENT crt_PT_941524_AUX_21 /end REF_MEASUREMENT /end GROUP
/begin GROUP RT_DL1MK3_Aux_20 "All signals of frame RT_DL1MK3_Aux_20 (9704484x, 0x941424x)" /begin SUB_GROUP /end SUB_GROUP /begin REF_MEASUREMENT crt_PT_941424_AUX_20 /end REF_MEASUREMENT /end GROUP
/begin GROUP RT_DL1MK3_Aux_19 "All signals of frame RT_DL1MK3_Aux_19 (9704228x, 0x941324x)" /begin SUB_GROUP /end SUB_GROUP /begin REF_MEASUREMENT crt_PT_941324_AUX_19 /end REF_MEASUREMENT /end GROUP
/begin GROUP RT_DL1MK3_Aux_18 "All signals of frame RT_DL1MK3_Aux_18 (9703972x, 0x941224x)" /begin SUB_GROUP /end SUB_GROUP /begin REF_MEASUREMENT crt_PT_941224_AUX_18 /end REF_MEASUREMENT /end GROUP
/begin GROUP RT_DL1MK3_Aux_17 "All signals of frame RT_DL1MK3_Aux_17 (9703716x, 0x941124x)" /begin SUB_GROUP /end SUB_GROUP /begin REF_MEASUREMENT crt_PT_941124_AUX_17 /end REF_MEASUREMENT /end GROUP
/begin GROUP RT_DL1MK3_Aux_16 "All signals of frame RT_DL1MK3_Aux_16 (9703460x, 0x941024x)" /begin SUB_GROUP /end SUB_GROUP /begin REF_MEASUREMENT crt_PT_941024_AUX_16 /end REF_MEASUREMENT /end GROUP
/begin GROUP RT_DL1MK3_Aux_15 "All signals of frame RT_DL1MK3_Aux_15 (9703204x, 0x940F24x)" /begin SUB_GROUP /end SUB_GROUP /begin REF_MEASUREMENT crt_PT_940f24_AUX_15 /end REF_MEASUREMENT /end GROUP
/begin GROUP RT_DL1MK3_Aux_14 "All signals of frame RT_DL1MK3_Aux_14 (9702948x, 0x940E24x)" /begin SUB_GROUP /end SUB_GROUP /begin REF_MEASUREMENT crt_PT_940e24_AUX_14 /end REF_MEASUREMENT /end GROUP
/begin GROUP RT_DL1MK3_Aux_13 "All signals of frame RT_DL1MK3_Aux_13 (9702692x, 0x940D24x)" /begin SUB_GROUP /end SUB_GROUP /begin REF_MEASUREMENT crt_PT_940d24_AUX_13 /end REF_MEASUREMENT /end GROUP
/begin GROUP RT_DL1MK3_Aux_12 "All signals of frame RT_DL1MK3_Aux_12 (9702436x, 0x940C24x)" /begin SUB_GROUP /end SUB_GROUP /begin REF_MEASUREMENT crt_PT_940c24_AUX_12 /end REF_MEASUREMENT /end GROUP
/begin GROUP RT_DL1MK3_Aux_11 "All signals of frame RT_DL1MK3_Aux_11 (9702180x, 0x940B24x)" /begin SUB_GROUP /end SUB_GROUP /begin REF_MEASUREMENT crt_PT_940b24_AUX_11 /end REF_MEASUREMENT /end GROUP
/begin GROUP RT_DL1MK3_Aux_9 "All signals of frame RT_DL1MK3_Aux_9 (9701668x, 0x940924x)" /begin SUB_GROUP /end SUB_GROUP /begin REF_MEASUREMENT crt_PT_940924_AUX_9 /end REF_MEASUREMENT /end GROUP
/begin GROUP RT_DL1MK3_Aux_10 "All signals of frame RT_DL1MK3_Aux_10 (9701924x, 0x940A24x)" /begin SUB_GROUP /end SUB_GROUP /begin REF_MEASUREMENT crt_PT_940a24_AUX_10 /end REF_MEASUREMENT /end GROUP
/begin GROUP RT_DL1MK3_Aux_8 "All signals of frame RT_DL1MK3_Aux_8 (9701412x, 0x940824x)" /begin SUB_GROUP /end SUB_GROUP /begin REF_MEASUREMENT crt_PT_940824_AUX_8 /end REF_MEASUREMENT /end GROUP
/begin GROUP RT_DL1MK3_Aux_7 "All signals of frame RT_DL1MK3_Aux_7 (9701156x, 0x940724x)" /begin SUB_GROUP /end SUB_GROUP /begin REF_MEASUREMENT crt_PT_940724_AUX_7 /end REF_MEASUREMENT /end GROUP
/begin GROUP RT_DL1MK3_Aux_6 "All signals of frame RT_DL1MK3_Aux_6 (9700900x, 0x940624x)" /begin SUB_GROUP /end SUB_GROUP /begin REF_MEASUREMENT crt_PT_940624_AUX_6 /end REF_MEASUREMENT /end GROUP
/begin GROUP RT_DL1MK3_Aux_5 "All signals of frame RT_DL1MK3_Aux_5 (9700644x, 0x940524x)" /begin SUB_GROUP /end SUB_GROUP /begin REF_MEASUREMENT crt_PT_940524_AUX_5 /end REF_MEASUREMENT /end GROUP
/begin GROUP RT_DL1MK3_Aux_4 "All signals of frame RT_DL1MK3_Aux_4 (9700388x, 0x940424x)" /begin SUB_GROUP /end SUB_GROUP /begin REF_MEASUREMENT crt_PT_940424_AUX_4 /end REF_MEASUREMENT /end GROUP
/begin GROUP RT_DL1MK3_Aux_3 "All signals of frame RT_DL1MK3_Aux_3 (9700132x, 0x940324x)" /begin SUB_GROUP /end SUB_GROUP /begin REF_MEASUREMENT crt_PT_940324_AUX_3 /end REF_MEASUREMENT /end GROUP
/begin GROUP RT_DL1MK3_Aux_2 "All signals of frame RT_DL1MK3_Aux_2 (9699876x, 0x940224x)" /begin SUB_GROUP /end SUB_GROUP /begin REF_MEASUREMENT crt_PT_940224_AUX_2 /end REF_MEASUREMENT /end GROUP
/begin GROUP RT_DL1MK3_Aux_1 "All signals of frame RT_DL1MK3_Aux_1 (9699620x, 0x940124x)" /begin SUB_GROUP /end SUB_GROUP /begin REF_MEASUREMENT crt_PT_940124_AUX_1 /end REF_MEASUREMENT /end GROUP
/begin GROUP RT_DL1MK3_Pressure_5 "All signals of frame RT_DL1MK3_Pressure_5 (9438500x, 0x900524x)" /begin SUB_GROUP /end SUB_GROUP /begin REF_MEASUREMENT crt_PT_900524_Pressure_5 /end REF_MEASUREMENT /end GROUP
/begin GROUP RT_DL1MK3_Pressure_4 "All signals of frame RT_DL1MK3_Pressure_4 (9438244x, 0x900424x)" /begin SUB_GROUP /end SUB_GROUP /begin REF_MEASUREMENT crt_PT_900424_Pressure_4 /end REF_MEASUREMENT /end GROUP
/begin GROUP RT_DL1MK3_Pressure_3 "All signals of frame RT_DL1MK3_Pressure_3 (9437988x, 0x900324x)" /begin SUB_GROUP /end SUB_GROUP /begin REF_MEASUREMENT crt_PT_900324_Pressure_3 /end REF_MEASUREMENT /end GROUP
/begin GROUP RT_DL1MK3_Pressure_2 "All signals of frame RT_DL1MK3_Pressure_2 (9437732x, 0x900224x)" /begin SUB_GROUP /end SUB_GROUP /begin REF_MEASUREMENT crt_PT_900224_Pressure_2 /end REF_MEASUREMENT /end GROUP
/begin GROUP RT_DL1MK3_Pressure_1 "All signals of frame RT_DL1MK3_Pressure_1 (9437476x, 0x900124x)" /begin SUB_GROUP /end SUB_GROUP /begin REF_MEASUREMENT crt_PT_900124_Pressure_1 /end REF_MEASUREMENT /end GROUP
/begin GROUP RT_DL1MK3_Angle_3 "All signals of frame RT_DL1MK3_Angle_3 (9569060x, 0x920324x)" /begin SUB_GROUP /end SUB_GROUP /begin REF_MEASUREMENT crt_PT_920324_Angle_3 /end REF_MEASUREMENT /end GROUP
/begin GROUP RT_DL1MK3_Angle_2 "All signals of frame RT_DL1MK3_Angle_2 (9568804x, 0x920224x)" /begin SUB_GROUP /end SUB_GROUP /begin REF_MEASUREMENT crt_PT_920224_Angle_2 /end REF_MEASUREMENT /end GROUP
/begin GROUP RT_DL1MK3_Angle_1 "All signals of frame RT_DL1MK3_Angle_1 (9568548x, 0x920124x)" /begin SUB_GROUP /end SUB_GROUP /begin REF_MEASUREMENT crt_PT_920124_Angle_1 /end REF_MEASUREMENT /end GROUP
/begin GROUP RT_DL1MK3_Temp_25 "All signals of frame RT_DL1MK3_Temp_25 (9509156x, 0x911924x)" /begin SUB_GROUP /end SUB_GROUP /begin REF_MEASUREMENT crt_PT_911924_Temperature_25 /end REF_MEASUREMENT /end GROUP
/begin GROUP RT_DL1MK3_Temp_24 "All signals of frame RT_DL1MK3_Temp_24 (9508900x, 0x911824x)" /begin SUB_GROUP /end SUB_GROUP /begin REF_MEASUREMENT crt_PT_911824_Temperature_24 /end REF_MEASUREMENT /end GROUP
/begin GROUP RT_DL1MK3_Temp_23 "All signals of frame RT_DL1MK3_Temp_23 (9508644x, 0x911724x)" /begin SUB_GROUP /end SUB_GROUP /begin REF_MEASUREMENT crt_PT_911724_Temperature_23 /end REF_MEASUREMENT /end GROUP
/begin GROUP RT_DL1MK3_Temp_22 "All signals of frame RT_DL1MK3_Temp_22 (9508388x, 0x911624x)" /begin SUB_GROUP /end SUB_GROUP /begin REF_MEASUREMENT crt_PT_911624_Temperature_22 /end REF_MEASUREMENT /end GROUP
/begin GROUP RT_DL1MK3_Temp_21 "All signals of frame RT_DL1MK3_Temp_21 (9508132x, 0x911524x)" /begin SUB_GROUP /end SUB_GROUP /begin REF_MEASUREMENT crt_PT_911524_Temperature_21 /end REF_MEASUREMENT /end GROUP
/begin GROUP RT_DL1MK3_Temp_20 "All signals of frame RT_DL1MK3_Temp_20 (9507876x, 0x911424x)" /begin SUB_GROUP /end SUB_GROUP /begin REF_MEASUREMENT crt_PT_911424_Temperature_20 /end REF_MEASUREMENT /end GROUP
/begin GROUP RT_DL1MK3_Temp_19 "All signals of frame RT_DL1MK3_Temp_19 (9507620x, 0x911324x)" /begin SUB_GROUP /end SUB_GROUP /begin REF_MEASUREMENT crt_PT_911324_Temperature_19 /end REF_MEASUREMENT /end GROUP
/begin GROUP RT_DL1MK3_Temp_18 "All signals of frame RT_DL1MK3_Temp_18 (9507364x, 0x911224x)" /begin SUB_GROUP /end SUB_GROUP /begin REF_MEASUREMENT crt_PT_911224_Temperature_18 /end REF_MEASUREMENT /end GROUP
/begin GROUP RT_DL1MK3_Temp_17 "All signals of frame RT_DL1MK3_Temp_17 (9507108x, 0x911124x)" /begin SUB_GROUP /end SUB_GROUP /begin REF_MEASUREMENT crt_PT_911124_Temperature_17 /end REF_MEASUREMENT /end GROUP
/begin GROUP RT_DL1MK3_Temp_16 "All signals of frame RT_DL1MK3_Temp_16 (9506852x, 0x911024x)" /begin SUB_GROUP /end SUB_GROUP /begin REF_MEASUREMENT crt_PT_911024_Temperature_16 /end REF_MEASUREMENT /end GROUP
/begin GROUP RT_DL1MK3_Temp_15 "All signals of frame RT_DL1MK3_Temp_15 (9506596x, 0x910F24x)" /begin SUB_GROUP /end SUB_GROUP /begin REF_MEASUREMENT crt_PT_910f24_Temperature_15 /end REF_MEASUREMENT /end GROUP
/begin GROUP RT_DL1MK3_Temp_14 "All signals of frame RT_DL1MK3_Temp_14 (9506340x, 0x910E24x)" /begin SUB_GROUP /end SUB_GROUP /begin REF_MEASUREMENT crt_PT_910e24_Temperature_14 /end REF_MEASUREMENT /end GROUP
/begin GROUP RT_DL1MK3_Temp_13 "All signals of frame RT_DL1MK3_Temp_13 (9506084x, 0x910D24x)" /begin SUB_GROUP /end SUB_GROUP /begin REF_MEASUREMENT crt_PT_910d24_Temperature_13 /end REF_MEASUREMENT /end GROUP
/begin GROUP RT_DL1MK3_Temp_12 "All signals of frame RT_DL1MK3_Temp_12 (9505828x, 0x910C24x)" /begin SUB_GROUP /end SUB_GROUP /begin REF_MEASUREMENT crt_PT_910c24_Temperature_12 /end REF_MEASUREMENT /end GROUP
/begin GROUP RT_DL1MK3_Temp_11 "All signals of frame RT_DL1MK3_Temp_11 (9505572x, 0x910B24x)" /begin SUB_GROUP /end SUB_GROUP /begin REF_MEASUREMENT crt_PT_910b24_Temperature_11 /end REF_MEASUREMENT /end GROUP
/begin GROUP RT_DL1MK3_Temp_10 "All signals of frame RT_DL1MK3_Temp_10 (9505316x, 0x910A24x)" /begin SUB_GROUP /end SUB_GROUP /begin REF_MEASUREMENT crt_PT_910a24_Temperature_10 /end REF_MEASUREMENT /end GROUP
/begin GROUP RT_DL1MK3_Temp_9 "All signals of frame RT_DL1MK3_Temp_9 (9505060x, 0x910924x)" /begin SUB_GROUP /end SUB_GROUP /begin REF_MEASUREMENT crt_PT_910924_Temperature_9 /end REF_MEASUREMENT /end GROUP
/begin GROUP RT_DL1MK3_Temp_8 "All signals of frame RT_DL1MK3_Temp_8 (9504804x, 0x910824x)" /begin SUB_GROUP /end SUB_GROUP /begin REF_MEASUREMENT crt_PT_910824_Temperature_8 /end REF_MEASUREMENT /end GROUP
/begin GROUP RT_DL1MK3_Temp_7 "All signals of frame RT_DL1MK3_Temp_7 (9504548x, 0x910724x)" /begin SUB_GROUP /end SUB_GROUP /begin REF_MEASUREMENT crt_PT_910724_Temperature_7 /end REF_MEASUREMENT /end GROUP
/begin GROUP RT_DL1MK3_Temp_6 "All signals of frame RT_DL1MK3_Temp_6 (9504292x, 0x910624x)" /begin SUB_GROUP /end SUB_GROUP /begin REF_MEASUREMENT crt_PT_910624_Temperature_6 /end REF_MEASUREMENT /end GROUP
/begin GROUP RT_DL1MK3_Temp_5 "All signals of frame RT_DL1MK3_Temp_5 (9504036x, 0x910524x)" /begin SUB_GROUP /end SUB_GROUP /begin REF_MEASUREMENT crt_PT_910524_Temperature_5 /end REF_MEASUREMENT /end GROUP
/begin GROUP RT_DL1MK3_Temp_4 "All signals of frame RT_DL1MK3_Temp_4 (9503780x, 0x910424x)" /begin SUB_GROUP /end SUB_GROUP /begin REF_MEASUREMENT crt_PT_910424_Temperature_4 /end REF_MEASUREMENT /end GROUP
/begin GROUP RT_DL1MK3_Temp_3 "All signals of frame RT_DL1MK3_Temp_3 (9503524x, 0x910324x)" /begin SUB_GROUP /end SUB_GROUP /begin REF_MEASUREMENT crt_PT_910324_Temperature_3 /end REF_MEASUREMENT /end GROUP
/begin GROUP RT_DL1MK3_Temp_2 "All signals of frame RT_DL1MK3_Temp_2 (9503268x, 0x910224x)" /begin SUB_GROUP /end SUB_GROUP /begin REF_MEASUREMENT crt_PT_910224_Temperature_2 /end REF_MEASUREMENT /end GROUP
/begin GROUP RT_DL1MK3_Temp_1 "All signals of frame RT_DL1MK3_Temp_1 (9503012x, 0x910124x)" /begin SUB_GROUP /end SUB_GROUP /begin REF_MEASUREMENT crt_PT_910124_Temperature_1 /end REF_MEASUREMENT /end GROUP
/begin GROUP RT_DL1MK3_Analog_32 "All signals of frame RT_DL1MK3_Analog_32 (8527652x, 0x821F24x)" /begin SUB_GROUP /end SUB_GROUP /begin REF_MEASUREMENT crt_PT_821f24_Analog_32 /end REF_MEASUREMENT /end GROUP
/begin GROUP RT_DL1MK3_Analog_31 "All signals of frame RT_DL1MK3_Analog_31 (8527396x, 0x821E24x)" /begin SUB_GROUP /end SUB_GROUP /begin REF_MEASUREMENT crt_PT_821e24_Analog_31 /end REF_MEASUREMENT /end GROUP
/begin GROUP RT_DL1MK3_Analog_30 "All signals of frame RT_DL1MK3_Analog_30 (8527140x, 0x821D24x)" /begin SUB_GROUP /end SUB_GROUP /begin REF_MEASUREMENT crt_PT_821d24_Analog_30 /end REF_MEASUREMENT /end GROUP
/begin GROUP RT_DL1MK3_Analog_29 "All signals of frame RT_DL1MK3_Analog_29 (8526884x, 0x821C24x)" /begin SUB_GROUP /end SUB_GROUP /begin REF_MEASUREMENT crt_PT_821c24_Analog_29 /end REF_MEASUREMENT /end GROUP
/begin GROUP RT_DL1MK3_Analog_28 "All signals of frame RT_DL1MK3_Analog_28 (8526628x, 0x821B24x)" /begin SUB_GROUP /end SUB_GROUP /begin REF_MEASUREMENT crt_PT_821b24_Analog_28 /end REF_MEASUREMENT /end GROUP
/begin GROUP RT_DL1MK3_Analog_27 "All signals of frame RT_DL1MK3_Analog_27 (8526372x, 0x821A24x)" /begin SUB_GROUP /end SUB_GROUP /begin REF_MEASUREMENT crt_PT_821a24_Analog_27 /end REF_MEASUREMENT /end GROUP
/begin GROUP RT_DL1MK3_Analog_26 "All signals of frame RT_DL1MK3_Analog_26 (8526116x, 0x821924x)" /begin SUB_GROUP /end SUB_GROUP /begin REF_MEASUREMENT crt_PT_821924_Analog_26 /end REF_MEASUREMENT /end GROUP
/begin GROUP RT_DL1MK3_Analog_25 "All signals of frame RT_DL1MK3_Analog_25 (8525860x, 0x821824x)" /begin SUB_GROUP /end SUB_GROUP /begin REF_MEASUREMENT crt_PT_821824_Analog_25 /end REF_MEASUREMENT /end GROUP
/begin GROUP RT_DL1MK3_Analog_15 "All signals of frame RT_DL1MK3_Analog_15 (8523300x, 0x820E24x)" /begin SUB_GROUP /end SUB_GROUP /begin REF_MEASUREMENT crt_PT_820e24_Analog_15 /end REF_MEASUREMENT /end GROUP
/begin GROUP RT_DL1MK3_Analog_14 "All signals of frame RT_DL1MK3_Analog_14 (8523044x, 0x820D24x)" /begin SUB_GROUP /end SUB_GROUP /begin REF_MEASUREMENT crt_PT_820d24_Analog_14 /end REF_MEASUREMENT /end GROUP
/begin GROUP RT_DL1MK3_Analog_17 "All signals of frame RT_DL1MK3_Analog_17 (8523812x, 0x821024x)" /begin SUB_GROUP /end SUB_GROUP /begin REF_MEASUREMENT crt_PT_821024_Analog_17 /end REF_MEASUREMENT /end GROUP
/begin GROUP RT_DL1MK3_Analog_24 "All signals of frame RT_DL1MK3_Analog_24 (8525604x, 0x821724x)" /begin SUB_GROUP /end SUB_GROUP /begin REF_MEASUREMENT crt_PT_821724_Analog_24 /end REF_MEASUREMENT /end GROUP
/begin GROUP RT_DL1MK3_Analog_23 "All signals of frame RT_DL1MK3_Analog_23 (8525348x, 0x821624x)" /begin SUB_GROUP /end SUB_GROUP /begin REF_MEASUREMENT crt_PT_821624_Analog_23 /end REF_MEASUREMENT /end GROUP
/begin GROUP RT_DL1MK3_Analog_22 "All signals of frame RT_DL1MK3_Analog_22 (8525092x, 0x821524x)" /begin SUB_GROUP /end SUB_GROUP /begin REF_MEASUREMENT crt_PT_821524_Analog_22 /end REF_MEASUREMENT /end GROUP
/begin GROUP RT_DL1MK3_Analog_21 "All signals of frame RT_DL1MK3_Analog_21 (8524836x, 0x821424x)" /begin SUB_GROUP /end SUB_GROUP /begin REF_MEASUREMENT crt_PT_821424_Analog_21 /end REF_MEASUREMENT /end GROUP
/begin GROUP RT_DL1MK3_Analog_20 "All signals of frame RT_DL1MK3_Analog_20 (8524580x, 0x821324x)" /begin SUB_GROUP /end SUB_GROUP /begin REF_MEASUREMENT crt_PT_821324_Analog_20 /end REF_MEASUREMENT /end GROUP
/begin GROUP RT_DL1MK3_Analog_19 "All signals of frame RT_DL1MK3_Analog_19 (8524324x, 0x821224x)" /begin SUB_GROUP /end SUB_GROUP /begin REF_MEASUREMENT crt_PT_821224_Analog_19 /end REF_MEASUREMENT /end GROUP
/begin GROUP RT_DL1MK3_Analog_16 "All signals of frame RT_DL1MK3_Analog_16 (8523556x, 0x820F24x)" /begin SUB_GROUP /end SUB_GROUP /begin REF_MEASUREMENT crt_PT_820f24_Analog_16 /end REF_MEASUREMENT /end GROUP
/begin GROUP RT_DL1MK3_Analog_18 "All signals of frame RT_DL1MK3_Analog_18 (8524068x, 0x821124x)" /begin SUB_GROUP /end SUB_GROUP /begin REF_MEASUREMENT crt_PT_821124_Analog_18 /end REF_MEASUREMENT /end GROUP
/begin GROUP RT_DL1MK3_Analog_12 "All signals of frame RT_DL1MK3_Analog_12 (8522532x, 0x820B24x)" /begin SUB_GROUP /end SUB_GROUP /begin REF_MEASUREMENT crt_PT_820b24_Analog_12 /end REF_MEASUREMENT /end GROUP
/begin GROUP RT_DL1MK3_Analog_11 "All signals of frame RT_DL1MK3_Analog_11 (8522276x, 0x820A24x)" /begin SUB_GROUP /end SUB_GROUP /begin REF_MEASUREMENT crt_PT_820a24_Analog_11 /end REF_MEASUREMENT /end GROUP
/begin GROUP RT_DL1MK3_Analog_10 "All signals of frame RT_DL1MK3_Analog_10 (8522020x, 0x820924x)" /begin SUB_GROUP /end SUB_GROUP /begin REF_MEASUREMENT crt_PT_820924_Analog_10 /end REF_MEASUREMENT /end GROUP
/begin GROUP RT_DL1MK3_Analog_9 "All signals of frame RT_DL1MK3_Analog_9 (8521764x, 0x820824x)" /begin SUB_GROUP /end SUB_GROUP /begin REF_MEASUREMENT crt_PT_820824_Analog_9 /end REF_MEASUREMENT /end GROUP
/begin GROUP RT_DL1MK3_Analog_8 "All signals of frame RT_DL1MK3_Analog_8 (8521508x, 0x820724x)" /begin SUB_GROUP /end SUB_GROUP /begin REF_MEASUREMENT crt_PT_820724_Analog_8 /end REF_MEASUREMENT /end GROUP
/begin GROUP RT_DL1MK3_Analog_7 "All signals of frame RT_DL1MK3_Analog_7 (8521252x, 0x820624x)" /begin SUB_GROUP /end SUB_GROUP /begin REF_MEASUREMENT crt_PT_820624_Analog_7 /end REF_MEASUREMENT /end GROUP
/begin GROUP RT_DL1MK3_Analog_6 "All signals of frame RT_DL1MK3_Analog_6 (8520996x, 0x820524x)" /begin SUB_GROUP /end SUB_GROUP /begin REF_MEASUREMENT crt_PT_820524_Analog_6 /end REF_MEASUREMENT /end GROUP
/begin GROUP RT_DL1MK3_Analog_5 "All signals of frame RT_DL1MK3_Analog_5 (8520740x, 0x820424x)" /begin SUB_GROUP /end SUB_GROUP /begin REF_MEASUREMENT crt_PT_820424_Analog_5 /end REF_MEASUREMENT /end GROUP
/begin GROUP RT_DL1MK3_Analog_4 "All signals of frame RT_DL1MK3_Analog_4 (8520484x, 0x820324x)" /begin SUB_GROUP /end SUB_GROUP /begin REF_MEASUREMENT crt_PT_820324_Analog_4 /end REF_MEASUREMENT /end GROUP
/begin GROUP RT_DL1MK3_Analog_3 "All signals of frame RT_DL1MK3_Analog_3 (8520228x, 0x820224x)" /begin SUB_GROUP /end SUB_GROUP /begin REF_MEASUREMENT crt_PT_820224_Analog_3 /end REF_MEASUREMENT /end GROUP
/begin GROUP RT_DL1MK3_Analog_2 "All signals of frame RT_DL1MK3_Analog_2 (8519972x, 0x820124x)" /begin SUB_GROUP /end SUB_GROUP /begin REF_MEASUREMENT crt_PT_820124_Analog_2 /end REF_MEASUREMENT /end GROUP
/begin GROUP RT_DL1MK3_Analog_1 "All signals of frame RT_DL1MK3_Analog_1 (8519716x, 0x820024x)" /begin SUB_GROUP /end SUB_GROUP /begin REF_MEASUREMENT crt_PT_820024_Analog_1 /end REF_MEASUREMENT /end GROUP
/end MODULE
/end PROJECT
